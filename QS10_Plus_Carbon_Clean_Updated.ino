#include <Arduino.h>
#include <Hash.h>
#include <FS.h>
#include <LittleFS.h>
#include <ESP8266WiFi.h>
#include <ESP8266HTTPClient.h>
#include <ESP8266httpUpdate.h>
#include <ESPAsyncTCP.h>
#include <ESPAsyncWebServer.h>
#include <ESP8266mDNS.h>
#include "FS.h"
#include <ArduinoJson.h>
const float version = 2.1 ;
const int service_lock_timeout = 240 ; //power connected hours
float powered_sec_counter , powered_sec_dif , service_remaining_time;
int powered_hrs_counter , powered_min_counter, Last_calibration_hrs , Last_calibration_min ;
String powered_hrs_counter_s , powered_min_counter_s , Last_calibration_hrs_s , Last_calibration_min_s  ;
int count = 0 ;
bool start = 0 , old_state = 0 ;
bool ota = 0  ;
bool service_mode = 0 , service_lockout = 0;
int mydata;
unsigned long t_count = 0 ;
String outdata ;
float t_sec , t_diffrance ;
int t_min ;
int t_hrs ;
int num ;

String t_sec_s , t_min_s , t_hrs_s ;
String hostSID ;
int serial_con_status = 0 ;
int start_led_buf ;
int start_led;
uint32_t heapfree;
uint32_t heapmax;
uint8_t heapfrag;
const String locked = "xxxxxxx" ;
IPAddress ipa ;

// Replace with your network credentials
//const char* ssid = "SUDU-2.4GHZ";
const char* ssid = "SuduUAE@Admin";
const char* password = "SuduUAE@2023";
const char* PARAM_STRING = "passcode";
String inputcode;
bool x ;
bool ledState = 0;
const int ONPIN = 12;
const int OFFPIN = 13;
int esp_leak = 0 ;
int mchtype = 1 ;
int engine_size, timer , clean_time;
float temperature1 = -99 , temperature2 = -99 , temperature3 = -99 , pressure = -99;
float level_1 = -99 , level_2 = -99 , flash , leak, level_buf , level_2_buf , flash_buf , leak_buf  ;
float temp1_buf, temp2_buf , temp3_buf , p1_buf, p2_buf, CRC_buf, CRC = 1 , current , current_buf;
int error_code = 0;
unsigned long lastTime = 0;
unsigned long timerDelay = 1000;
unsigned long lastTime_control = 0;
unsigned long timerDelay_control = 500;
unsigned long lastTime_counter = 0;
unsigned long timerDelay_counter = 5000;
String newHostname = "SUDU QS10PLUS";
#define LOG_FILE_PATH "/OLog.json"
// Create a JSON object
StaticJsonDocument<7000> jsonDoc;
JsonArray dataArray;
JsonArray entry ;
// Create AsyncWebServer object on port 80
AsyncWebServer server(80);
AsyncWebSocket ws("/ws");

//data:image/png;base64,iVBORw0KGgoAAAANSUhEUgAAAoAAAADXCAIAAAAFu3cSAAAACXBIWXMAAA7EAAAOxAGVKw4bAAEdTUlEQVR42uz9d7RtyVXfi3/nnFW11trppJv7dpK6pVZWSwghJEQGg0FgkDHxGR7GmJ/9/ACbh/0bztgm+PfAJCGiJRCIoIAkBBaSUATlVit37laHm+8JO61QVXP+/tjndregr9AVLbmR12fUuHePce84Z+/atepbc9YMZGbo6enp6enp+ezC/RT09PT09PT0AtzT09PT09MLcE9PT09PT08vwD09PT09Pb0A9/T09PT09PQC3NPT09PT0wtwT09PT09PTy/AnxGWADJgQMISCkwT6q6fl56enp6eTw3qC3F8emREwDfAMCeIIUly7KD9maanp6enp7eAP4MIugTUAKgFCMoAYMt+Znp6enp6PhVcPwWfLqFAmwHj4RSYuAu63NPT09PT01vAnzkaeMR6ALl1hi/9v//bjEFos4Z+Znp6enp6egH+DKIAEs3gvufHXn3TMiQAqE16C7inp6enpxfgzyQFUlOuveBd599z3hKPoZDen9/T09PT0wvwZxrR+jzhX7/0j2M59irNNpB9b//29PT09PQC/PDQANBtQ9wBOmuR550CmkHld7/kjqq+zMVzS7dx08f+Yk+Q+/nq6enp6ekF+OGboIKACnAUwBIozzv96My/4S1vWXpwCODwrtvuc0hO+wnr6enp6ekF+OHAA6AhMkoDgZAVuc2l/+6f/CMUHnlBRCD/xo+dqKC9CdzT09PT8ynSxw399XSEQIC1rRYli0I/NsX77lIeqeq8nbUo+ca9BYNA/Wz19PT09PQW8MOivnGZAIPCMgmMpePBj//SK3WJ4twC9bTI0dV7rUxqFbi2n7Genp6enl6AHwaC9wUSmGsIAFV/doFX/+FfFIvTxbQb7O1i0cju2fn5+Ma33hzRt2Po6enp6ekF+OGAosr8XMyxpVAgCfDi334PlpVr79GluHndtVYs5pjixb/11tz7oHt6enp6egF+uKbotS/9TcdCTMgJGS944UuvPnadxjNNR9Zk6yzPl6EN73r3XQl9a6menp6enl6ALwkD8vYC2AYQFy2waBNsvvsfvuvax1+3Q7SWm5m4u+7CyZ32zK1vLxbrVXu3mxdrO1MyCouztU9v/8hdiqiazAyGlRwb1JD6Ce7p6enp6QX4IcgUgc0BdFPRei66OQp37pf/n/ff8tHHPOWLBujAZYD97M+8Yr3iiidWt2iXnJbWLKzrAvmS1n/yP/0qwMQwyyB90CT389zT09PT8wn0aUj7LOHHEqmRtkSBog11+v2f2n7ra9rJlRhslNiNZAX8n77hnZUuRC8LtJvyXFgBLtil1M122w9u39slQGMZHLC6Ee6lt6enp6ent4AvTgRgijIXpufAxY1vWLzq33keDh59Xc1AREaDFtu7O8szi1xXQxwqopc2hq7rdnfzbI87czr5tV/5HR+qZBFIq55J/Tz39PT09PQCfFFGGUsqMuqp0vCuD973iz8ifjPZ8glf+rwEkK0Dy/e8E1HrwJdV5eGhu0psjDZTzAU0cBs4ivJ/+8nfUIWQ31ff/aisvkZlT09PT08vwA9FMDikeedH+e7dn/5+07jdbUolW9d/sSHCkKH//Td+L5SDau2x1fpl5fiqMNxS9pQ9q5HWyEuLabkY//ZvvbnL8olVKXsB7unp6enpBfihiBZDu1wL7en/+n3W3SppVK1juysR1hwUgoEdfP2Nf+H9enno0X7tCE/GPKrMi/iSKTgCw0idl2M/9mO/4IQJ/kHT26cn9fT09PT0AvxQeJ/2isnuC354dOodLY7xaO73TjSjK5JCAAh0jpnska6VG4dGG4e1YBSgwL6snBQihXDB5DUO7rvn/O/93v/c3d2zB6a3t4B7enp6ej6Bz9koaDOQrYQvghUsDVwHDNC6XGQ5D5QSBd6AyrKq6Nof/oezH33jwg9GXXtCNq/TMy8bPPYdHz6/22237uB4WY3l4LkDY7+55VUKd9C1xyzcFGnWuVGmTDn6VPiyubZ8wnf8xKt/5ClfGe+eIXVrbcewy+vbN9cmlx89fPzQgaGjAibIhNyhdCA2ggKEbDEKAexRMxzBIzMAEMAw9KW2enp6enoBfmRDVGfiyBLhBSiAMqHMgOdtSZvdFkLdolSgyid35Ojah/7nTW999aESyMLTJpiPJsutw7OM7AcZvu7I/LAIW7K2RmnI1nI7pLJSA2kBypShjEEu7qT5YOH+6EUve9a3fM0Wl9OS1o3/pPqiAnlwstk8Ma1m5494u3xSHdtce8KRJUSMXBJFNi9B1KCW3HB1i0wChhIUMDKAfL9qe3p6enoBfuTSQRmugCtXFakY5pK6LMuiGmAvdGuxWtLdu3de8ac0bj72u897208fpHNNahJ50ThUjep2No4vqSRkWKh3G+UhTzZ1bRQjCi2orbSsKJtaUMqWzZg0UR6G9WW6/Y/f/cXf9Lxz6EbDcmG4YnFCfMjkFhTqA486TfKuqHqWB/feeIzCk4cb129sHp+UqBSuqzmWOgGDEIHWoBkeqIz6xO2enp6eXoAf2QQdgmCERApSQmaoALOBDaf0ngU+cM8H7uVjp/zZq+fxn7z3F6v6bk219+uzWrcGvm7mFbgZbjagglzh/JmdUyaehoM8QsywBNSFFSVHYgSmDkmJ/TYtQq25CEcbfvlPvfB5P/GD7XRqwVlxTC0jNUQdxWXFOeSGxTQ+5cyA/pjaPzx7bnRi7zEiX3Tg0JMPb8DNYZKoaDFSwAMlFJZ7C7inp6enF+BHNJEBA+XaCbqcTUZL4PaPT9974u6PyxXQ7qMHHnvddpnK3e993bdt7r6vCWuggmJViZvqvCnNlubdgIgEmTVN97YtEK8FjEAZlCB1Qb4kkBgbq3JG9FqGjYU1pBDSO0/efeNHrnzMlaVxTeeZWIOYFR0GHRyElSgMYybVZCwbNU1uUrv1VC7P7F2d733iFZc99Wg1REJKSGpFlcmLGRGZmZkx9zF0PT09Pb0AP8JgJEudI4EW907bd5/evmGnnhZr7ZErZbeu8sYXnMrvPrj3w+/5t5Y+osXxBVrSXLQiSi1TawBARB4spkDsLObK6yToCJY70+DqgqshIQs4U4I4kGcO7cAGXV4MVRRvf8FLH/3C/9ie3uVhaQQBG6BksGQEBmdp2SAKygBzpBSHfkE4n665+d7pu2696ekb/vOuOjocBUM0iCoAMDNRH4/V09PT0wvwIw9pXFe69253b7nrrvs0NMU4j8ddp4dOnZ6tV3556s5w5BtvedlTPvBHi4G/t6LJQjqOjpbOfNYczIm6zhObM5AxOidxUPjxII9Bkc3AbYVhYTmB1JgtO2UnVrbOhK0VtXoxXOCtv/na533bN+hibqRKmlkNlkmNoKQR6wz1ZoTEuRsJUteppkJkZnLz6NG3du4VN5x5wrj7kquqazaIeJOIVLUX4J6enp5egB+JvGwx+8gHT82w3rjLOxaJqcJykJa7wyuqeTcd1k8686KvvOE3/GD30BLyhV+89+d/3rmYxTinoBaSJ+PGk1cGOSWfvItFmQclVSDnDEATUAVtwVBjUYWxQ3astju2sk3tgNum/vgfv/u2r/3S9bEDmAxiIAMbk8IBAbUSFC6xMxTzzsjIOV/HVgJna1RiLNMdbnDrRxeTEP7pNTuTyYSZzazX4J6enp6/vfwtukRsgQhoBhKQAUBhKUdEQ4t5izPAXBV/djL+mw+e/uMToylf1pYxcxrjrPq9YWrPDo8ciie6wtaWp//hO//HVjzZNMWp534/nvosqHQsPvuGyo7dILVqTYjmeYGilBgTp0xBnE3HkSZJhogHxmGwOVJkbzEMChpX7HIQDeIJyROc2GRIB9bf8/MvK5BCiqWaNxIDQUHJqMvkDI4AMXUWK5/KEB0vC5edxQpSalmFjUWumuGBM37yr+9IL/jQqRvvOW2UItoEqAEZSDBDB3RIQAu0GanpC4D09PT09Bbw35AligqgrEIRTAmcwQI2P2eQTwN0o/dMm5eduPM8qg2sD3kvs5vxwcPx7MfLYxt5unA43J69jw6V7uQPvOW/ZtweSM494SkHvvIf4fR7AWXAjJRAgLInZl3W2Ug1w7gaDhC8OpKBQzRkiK/CxiifdQgEIZgZQ5DNDBkkzCqwbGanT59+w6te/03f/M2z5SxbYicAyAC4S61RedAGN/P4Y2cXjz9z6uuunFx9UAGDlNvII1BIDDiISwQHlayQPlCrp6enpxfgvwGy+osYxBlYZeYAECjZ5GNTvOre87fXOiiOe82nXD7a5XPFeNK1U7c+1Ei5Ak2jVQjp73/wdw7XLx7Pjn18g489/2fnUYvBAUWGrjy6SpDMDiyY7piZGQEYjAcInILyEJrIEhhONodt6cwJxNQMjpAFyMgMy9pGIbaUh6P1m9/5sduuvfXQVYeH6+WiXcJEzJGx0aUZqSe5Cp2Zm3zEVffdun39Hee/5Lqja+txAzXgzRVkDIUzQBjSW8A9PT09j1D+1phHRY5kmhgdAfvqq5nSsp38j5vP/bePn7iFR0LrhVJJ7cSmS54Q0iC1Sx4c7E5M4qIW3/Do797zZ0+/41+JXT09MDv23W/3OsP4MdAzSsrKMFFkBhIHBQbLbQCr29aiKuEQJbWV1lVEBYyI1soUBN6ROHZeHWsQ9d68V3EoCwvevEvAJBx49e+/elwMt8+fB3RVJJPtki9xh1r7YllyM+p4d3D0jWvH/98b73nXR+bUrpMNO7iWFKIQBaHt63b09PT09Bbw35TsjXNEF2CSCBZmnt9zdvqms24W/YTLsjGmHKkjTgPIXPzBfG90Rw/o+eTWCkhbjJ954i3P/sC/mbhDu/XZ6df8Vp4UG/PDmhOKTSNjXSXZqrZqXhzrYOcUFb7NnQcfOnAQglY7rriLUQzRbHJ0cxZE2AUDOyWoGMws56iZoGZZCc4se/VdTi9/6Su/9fueP62nxEQGEQHFS/MEFPOqqzoMdgaZabbZqBte/qp2cNM7b33O46997EEIcm0LpkIQiiS9BPf09PT0Avw3019GJnFYitWgwTSHV31k+0MdTUvdyjYknZd1S1RGT1rVjte0LeEd10bSuWonFI+b3fYVN//XTXfnfG9z/MXfN3rsl4nruonfikC4IrNyLhQM5IJ518hys9nsnCNjxwFcACH4TmPyOXuynMlJuTV2k2FulBRsiUBslE2VYSLIamIkSlljp74Y3PrRW97xxnc85RlPFCEWqHblJUYyF/HgzkCTdIfaWEVthdrSgsY7Lr/mrlvv/oLd6ouOb2wWI3QRHr369vT09Dxi+Vvjgo4OAggGDR161/n8og/ddWcMvth44sxJ5bcnRMxjFQ2Sg6wnKTkZb4x5r3PrVbbL05mvuen/d9X0XVMMF09+tlz/L1042/Ag5HJROsjYCKuWQwx1MCISxHFz3kMHIgEIjOA8UpMJVEoqNJaQzUHY2sjBI3gNIZWOWUQcizMR9c68M++yd41YItrcOPq2P/1zneat4Yg1FcEKwiWNWSUbyY52rQiaYhiwPlYUfruZ1XL4shuW+uqbT91+RiEVmOZY9ku8p6enpxfgvxElTkleqMkb70h/vF3cvnm8LcN4sThXeUlhVIeCho7cesojW9TDWeOHA7M6DEfWtaH84hMvfPKdL2n8WMPg8Jf/yN6WgxYBAhpkAEWjANlqNhQ5CZknLbs6MAUvwbEXOAZSUhiYbeC0BI+o2pioY3WsntWxc05EyAl7B2FzbMJwUowH7F3XpFGY/PoLfq1bxOCFWIVxSeOwni6pZVsPed0Rd2XbFcy2cQQ6WnSFTU7L5h/ce/qPTp+bAiO1fon39PT09AL8KdFBgRo2h6UOqAEDoHPDkZu64kV37HygbQulI00cWtes5UK6IF3ByVsrrOrAzOPEE2yTXxRxfVGF62evfspHXpqGReQD1Te/BJOttVg3cWQKCzxBBK5YLx8VZGd7UI6bvFe4UE/vs0dd37yfaE+Wvi7maxRjNUKrMF2M87Kwgdh8He21Ewc/yJUGP2BrS98V3ryH8xwKcx6DqqtCElIXqFjraARef9kfvHatHIaUHcOxsRgzmIIj58kKbj3hIYfyCMLsanGLguJAdaAaKDaVJOfI+yghrx+8ZZpe97F772uGSNMGugCghlwDCwMQ+5Xf09PT0wvwJyJARmU0ArHLbYUUoTWPbjzbvvO2M9PsIYWIBEZgK4i88EOOQFUTqnWpJ4rP/9gvNcXgfLLNZ3zrYDROTQsWEAFs4JXneXDVtaqAmplBiUHMyDH5s2fIY40lwD/q2EGY4PxehjTIKkQBo4Pr0TOCQwjqhGV/iAh7R06UUBQFeTHH2TF7l4Cbb7r9bW9996BaC8yBKbAF5iDmWLyIiFzsc11sDChV3FWUgijBVMqplX9x8303Nd6Dh01rnDrxQEWG3HdU6unp6ekF+K+8IV5VcjKAqYM1S/B7TzXvOdXsua0oIyIJpAEaCCVYCA85iKoRLRZl9Zx7f/dRZ28ouhPdE78ZT/46KSsWn6J6X6x+oYEBwbVPTjEjRWMhiEGVjIzdbR+hEsPUsOHJ1xwFFTi11yovWA2IyLJe8kbZOYIrspTkPPtAPpAPIGEfjMVYuCpQFOZ9ds4Vg2q08epXv+Heu3cCOAAlLFAKMM8qxEzuYp/rYqNALpEDxRKRc1ZXzmi8Gw6+7Y7dD9xxHt5bzgrXgY3AWPRLv6enp6cX4L+MAwqAkI39jEYfOFV/6OS8KccaCk8okSpKBSOQOPaB5SEHGGualPHsu38B1VDD5rEv+7+0VVOYrT75/eHHbGBc/TimkkwzMRGrJkUOLMUdH8wOleWiwhWHBpACu0001JYMBqgbi9us1DGLY1+QEwiTsDlWIQmegktkMqhoUGjhsncNqDM/2Tj2Gy/6A0chsASmilCyFcSOP9nnuthgCeTECQfGqHCsBl+0RUhu8tGob73jXqayNESgg5L25bF6enp6egH+RLJBEElnBjuh5Zs+vrh5ajTe8NyW1g61HSF6JOJMJATnkB9ylDY3bD7h/JtldsuZyPKlP6IL0GBVVQPEZjkymVk2mMGweVmMyjl1MedEjlU5IdvGzu1smYhYsFYChcO0w6JrjNSyAyxg/bIDJrCswQ9USIWyYzjh4BPDhE14kY2qksoye+HhAL6KVmYd/MIvvagalKnVsvDe1CE7mINd7HNdbAClcjBmJvM5DQmBsiDbULb98HYdv+vuaTQUSIwEq/ql39PT09ML8CeiBjOAz0R55x2793ZFdAPPVKAprSs1BWQmIyIic4CAHnKUPm9xvPrOl+zB4Zrn8KO/1Mcm5ZkhwzJrhHVIHXKERSDBr5fVODArMxsTzCiz8vr83hC3s/icMTSMS4fsMW0ii2awIAZMLtukgpxzmWDi4Dw7D3EQx+LhPJxPYGXxkyENiiSSvMvOm6/uOdu85PffPJisaVQm81CP7C7yof66IUZCJN6oMC2t82iSdMFClo0PNfpnd9ytnfrko/Qrv6enp6cX4E/EiXUUTmD4tjt25lSV3nlNQnkV2OTYCxcsnh15RsHZMz/kyDQ5vnz/wZ03LGVz6+nPp9nNqMqYCTmpdaaRtIN10M40whRuNBxMOGcwXag8rWy8mfbKvbMZ4nRWdnjCwXVEh7O7SanLyITI5g74sF6pp8Qg7+AETtg7Cg5e2Ak7IXGZyBz7YYVSzIs6p87VGL/lXR987423iS89i2cKzJ5xsc91sTG2VFIOTMJO2AcSx+TFBkmqnMSyDUdnwsabbj+1l6x3QPf09PT0AvxXiPUUeOtti1k4oOQkzobUiOXMQTkoBaWg7IlIOBbWMdlDjmxUzW8+2H283XoqcijpLPI0YWRIZIk0wxJZJGSzrJoypBpNiuB0f07USMmwhtYv90y9s3pgeMzhA+gM5/ag1KklWAtohXJ9qA4ahIhIeH8Q3Z/AK+zNKOXsi+DLQooA503cYO3w5MCxX/mNF+/uzYiIiQTmYBf7XBcbQ21K7RzAECJn5IjEWMa18wHiO9/pLJYfH2y85757pZ71S7+np6fnf1sBToDCVq8sAQkZSLfY8P137ZbUjmxWoPHCxOqp8RliEVwT1U6Ty0zqMjGoZRMxNVmAa9NikDrjNmDvCXe8cC9fXj7z24TPtnaZaR5oC4vQaNSpNWQdaS1pLnma4xLP+nq3nClyEbs9HwY1J5FxDOn9r9ZJCuUhkfYxRwXe42xCjGedGUJpeTYEHw6VIVsg9mAP9kYO7AmOyYMccwI0wc2pkAOX5fGaMXlYlvlO44utZ/7Mr//P1sFkdzAQbQuzwgjGrXFrlACwsRgaJ5EFJqLsQGCLQbuBzpxGzsytl6XZFJjDasl1y5bVsVTkw9DLkKt78+Slpz8Hlu48Q1vAEGELWHuhw0V6yHEOABboWhg6ANhG3u3zoXse8dSwFlmx6gEHTYgNagMMalBDsv1FrjAFAPsrA/t/GpChCSkhJrQJNeJ+c/UH+qwb+jbinzX+1xULNpcJidQBTg1q0cnJbvGheyyaM190xCABQMgMdfbQi0JJGEZw3golM5eTOiZ3TG/Luye7w086MvJotIEr8lypYlIl48yrMGuAwYQMwOPKK5Z10koSWZGQGQQ1NOHMCa8BWStXHCoRytApsL1ojqwvLY8VUTA+stnIec8e2QhGBCIwkykhgwlGCrUMgNBZHqxPuq7rplNxniV5L+d3Zy/4ld/7kX/67dPZoqomEQpS7KcpO4YDKQEbqTFQFmRCysZAkQmdGtYA4wwzKx2vQr3NzNY0xqixroTXBMfWhptH1oefA3nAVgoxAIUwFQArgYF8kSU9ApArgBOhBRRjCNWCjX4P6HkEk7XC/p1YywCwX97WWBVqqzJFwH57cQKgINAF00ov6G/Y30xYjGF8vzZ3vmawwAt4JcMdJSMr0NcK+NwW4AxzSABBRQnk9hQfOreXwiE1MggUxBAzgjGMQBcTYOLIGlirJJ3KtJG1MvLlZ9+KbkpXfyHq0yslgkWxWlUIBjYjI1MQQ1kJAofJxA82Iy0To+ioZh5oTlRvnr07LjVyIoRRwtVHD958zzmcmDXHNhamh0wi4A6EMCmbRVZhMiPACGZGTGBASZKBoKAMSzn54N3mWm3J5vNyWNbLOoTJ3afnv/vKt3/nN39JaqYOAVCAYALzq0fMOBUdJ0YmZGH2zEl9p5xkz9dEREwsMAOvrsyFinZReVeUfGQyPFSgAnzsqM0o/pYHQpuDQUgTcQsG4KBAdHaRADNykBYMh2JsDFMQM/U7QM8jGrngLcwoCAiGlSmsngEW3L8tXrB97+8vvhLeC/9s5FZdUI1UyfZfQwGXgYxIgIAFECMooY/T/BwXYIYABRTgTnhB+OCp5r5lNfERpiLOk5KRmDESGVouLvZjmBIROeUM7/ncTDYONPHoiTfEMCqPXdvOTxfjg2XeyySitVIJ6EojAYaxAkyERCiCDLe4SQ3H9SRzR2zWcH24PndmsYjjcds2Trrrjk9uvW1XTy8QsaTMyuygI7jNITVzU1JAiaBkoGxqxAojcYa8qs0sZVjkOBkNBMrZmnYRBsG64vx2fv1bP/rEx139+EcNHTmGwRgmq6fKyIhy7cZGIEqFJuvaElivyo2JPzaEEO5/IOnCA1hiTQ1EsNUBGJG85Zz+tj9fLaOwBI0kVcaq81MEFOQvct5DhgOprBa9FiCEfpfpeYTD20DhtHKr3H0GXDR0sp9JeOEO0XiluZF45TR7QHoBBRLAYAYEF/7DaoPoAAYkgaNBE5ySM0HRz/zntgAnVmfqMuB4h3Dj+e5M68pi0/JCQKTmiAEQSOGEyF3EAgYZw4yJM0QkaFaHA+nu4al3ztauWpMYqrImqdL5uT82yrtMK/dMJopGYmCmlUksCH79UdcsPngye3AmOM7U5dJt6fTOez6Wn/RMT8awzzuO10J1alikNII5ArRlro6tn7l3m7ggA5iNoKYwUiIjVlOQF9WomlOCk4XmMBzRWqJpzjEa8WDrmLSD//HSV//Lf/pNh0ZhMhx2bQsogVaCbkQtdS7Hy0eDYxM/EgzcvtYOcwei/efxfr8UAPUAwAqCgRWSIJC/9f6lDigogiJQCRAsISXzQ0J6yP9fJIWsHCmxS9n7EmgJc+Bgvwv0PGLRtEaciWPimGCGghAAPyV4pAGWIU+n99yxc8+dd9/0sbtuu+XI+YXmnFIitRBChpkZMd/jYzVaP/aox171+OuvfvIzdLyZw6gDoyAHeHPcOQKcICJB+G9Rn55egD8dMtQBUIbi4zt72/MYaOSjq1WZHbsA4ayUGAS0QGkPBMyYPdDkxykIiASixrSssmePrfpGlxdy/MnS7sAHaILWnGtYIm0NDEvGnkhW68zYwK5uY3XdtfrO1+tAFCxqyVmyMKLaTnyQP++51E7rSJe3NhhyHX28b+oet7VrnZg4YT5QFqMy1tD9gwMxcYaRgoDsmbKSicCyGgyZXCQebG16R/Wps8G7rBSdQxz+ym++7j//y/9z3rTDotAuwjoFs0GNR64ttXnU+uioB7olcgQnELWyef8zS7TyXSkAL3n/oAIiQFbXP/jceL72Q0Y8AG3NDd5xb3rhS18CgIiIiPmBDykpdezNVJAU7Fz4ksdf9l1f9bR+C+h5JLPtpIRUgNPCpQgHo8W56ba+9jW33fKx3TtvLpfba2kxSvVj0T2B8nYFqNEq5KoxIgITO/n8eyOXZXfnB/Ze/7Iby+o88cIHN54MvvC51z312Ucf9wWtGyaAs1bUQTvwej/5n8sCLACIIQzCtVtrx7f2RWGJcUyYLjFt4qzNTTJlTyCmB0TX8MBrMRj5jg2uhpRlVwZgMn/XggflweMUFxkqjIhiEE9Ft0G5I2IjITVj3rcTjZA1alMdP+yTAalj8lm6AJfH7Lb55IeNUbjc2cbR+sy1jzl68233xJO1XIvdkA4ZEWBrGK0P99razKAK5gyFgYiMyUgYBs1ilg0wZiVimntM1tfdMsX5oo6zInDU9ZPb3Qte+Hs//MP/YL67DAw2CEwhZMQRinD7fWd3K75sY62kYnWRWeR9mYXdX2STAXQMQAXKAEE/Zw62BVaugSIDkg2Up0Q//boPv/yewwBABCIuHnCkKRbIA2RDbhBC4eX99574ui9/7kbvhe55BHOgiRBaepdZhzy989Uvu/uPXlaevHed7t5wxeXVsFFtjWrn5zzJJGPNZKuILKgqgJw0dnb3oQ3ORik60kE7GxNTZ6jPl3947uTLX/beoopXPfpRX/41l13/DNq6PKMa9lP/uS7ALgMmIGBgNqQM02xpnRw5FyfcTfzM/O7Slkm7jPNLepAAP+gDmGWwChE6AqTzkhDqW+Z+7XBZaOq0q33QPbe+3pxs/OGBLdWYGUaArsxfggIxEoDRoAp+x7rIkITEqLQ0ZDc/FRWkbXA42NSPu45vv91V88ZSXhbmCGqwEoPJeO90vbLAYEZEtLLGQEpEBsesqmKmaqzGxNFZNjlw8PC55q7RxM+X9aAYp45uvu3GV7zyz7/u73yhsxYpGxyBAN/lIgvOunw2trecmJfGwSiQv7w665yrirIofBEKXokOEJRBDDAoGUwpGpEC4X/h9f/DQTBAHaRIgBNCjHuMl//FR7GxtS/AgD3IHe0AhTgjuNRJbrvpqd3bFjs7Gwf6OOieRy67pVtHNzh79wd/+b/PPvTOte781a61sJjTlWCdtQm5c5QcNQkLA1JyzOxYBKQ5GhMx2GzS1chAykKui0mDAzsTbmW2sdw9tFfjI7fM7/7Q237nim/677/fjQv08Ymf2wJ8f7mpC9ulA0EozIABEJIFTZW3zaGIwqmkdc3sG+Cmvdl9y0JSKNSymxadnhhtlApif6BeTtcwcdAzZ7u1LZfPZarghjHbUM8kt1HFs8JejKBqLESyCk02phhkHFtIe9aPJnVtVCdBFQdd1axZtcl1DUt6UG15x3DzeUu8hvPhnbh7uj585VrVpdNV5NIPj4i7VTNInUupFlIGRSKiUqwDW3ZkmVY+IiUzSuisY5oPfXn5ke17TgYqjKyr4ml55ivf/IHrrjnyhKuuqLNREV1OVBeuShfOIA7ORSACC2A3byEDLchg1tEFN+yw26ELrE7EK1oBlNhYCcxwlMbQq44dXEMHgNiZ2SoN7P7v65G3eNsOftgwCkRPL3ovsLZJztvKJ0CwB0U5JziXIwI6DMElo+LNx/3Ab7/rNT/wBefC+gHsmLmaxgNNmZ0huj4No+eziCFm+ASUqIEK2Syljxf+qsVdH/iNn9l92x8d6pZHuUrsGyvYUak1bJWiKAohg6xSg0XJoKoKMDPAqxuxTj3D4JBISRyRAplSbpUIVxXhru2w4We3yRVfhMGQ6BxwoP9SPpcF+GKMtTVSCMGRZBWzLLLdTM81bncxX2huhQN7MiipWbGsyqM778/iZ8UTqTxleuRgfbfUJ7cuexpyUjayZMoEI4OyqSWQwCLMKcu+/GcYV9AODuVwYF29cksDIDMi5Bw1RVMTJ0RaBBwb+plKc2YeLh+30hEKAH4thGFRz2szFvFkCTAiIWMiAsEIYALICFhFYhMUSKYbk4kcjufuPRmEVeFDY9j62V9+xU/++386qlDwsGnq8QTLT6F2xAOWN9H8QrqRmcmDo35NxaCZlaBsyTi2y2KvnWwEWmVt7b+1+10Oj7y+HRABwwFIc2z+ymtf56phZiWsJnmVjn3/8cGpRJiubsOV/FLLD91zJvr1EqsQ88Lt+2ZS1ydh9HyWDZLos18UcB2qoJqNrfCX/cFPvfmVrxvH81eTqWkizQQCsbL9Jf2+cNTMD4SrqhKM9v2FHnsKYmMYG8mq1B7AZJ2gbsQ7y1yMn/GVXwvA+tPnZ4tH3o1gJpA05BoUWarsiim5Wxs90ZS7rlhW44RRkSG0jIJIpTKuvOfXw4n3WEDrpVEcn99exLPj9bUUW9Nk2pG2pPVqmM6hc7NadYE8h9bIS9WlpiUsInfVsMyw/bVLCpiQaU6aoxAq7ykn7fDsqw9rWcjZiMW88ylAFEjDNDq4bo4AePYENmIIrwKCSHiFrRykdiEaiklhneUjl1+2dXgrIsFTxl5tgzS69r/98m86X6VFHBZlnfcY9JBj/zG+8FyqmaqmlDoOHYeWfMehNrl/dEadSUuuIzdLVKPoirV797pz02UGRwMR4UJxqUemOyoiCJAcgPa9c9xn85QYziMEOG9uvw0GnId4+EK9My/wBm8o/a4Ue6OtP3j3nSOdZpUOIay+Dsvah4D2fJa3PY+iKzKSAQ2z1Nun/80//NDv/9zlO3cdas66bg5PrXBmsCHki67PYdRh1EFKZdIia5FToanQOGhHVTv0cejSgHNBWpgVZl6UAxZLVxQ5La08cv3nQSAY9N/I/64CLKFBOFPrDfecfsdd22//+PItt0/vi8PGuCFt2GUEb2ZsnRNnOLz4wNZdvztIiQLKtN7S8sDyXhUi59SSacvakTVszepPWDKNlBvWCEvQ1qxl63JeABG5CSEYWM2UQAQyZRhptpy8MEE1Rcf4/KPsCzdckN9rlBAMbEhDLbYqC2bIImIsymLgVRzWKiJRmfDgiDJAFWqWCXuL6fGrr/SDYKTMSsPRqZrumxa//Xt/EgpniAl0UewB9V1JuwHEXHRWRgwyD1WKzu4fqlAjM1OwsiSmOlv21Z2nzteAsegDJewemYXptIQkIEOB8II3n0VZYTg2x8ZkjuEYnuEuDBFIMHHEBMrQZNV41639u9/8n9DOKHQZsJV7P/WV+Ho+++s5B+fSEEC5c+p9//jLBre+VqyMk27XLxcDtwtLzIaVH+0v59rZvsGAVrhladm34hM5w6q7qUyDzAM3TjvXqiwhU5bzLOfJmFG34sVs5rbyxkFQQm8B/28rwJHUA0eqcM3lh/Ow2vWQwbDIHoRAkWEi8MSRQjJdz2c3b/6ljfb8rGtSSoO2G5aDvPf+pT+QUwNkaKdxvrJ9YbVpS7mj3EEzaYfUWoqI0WKDvLRmB5aGw8ps5R1WACxIKRGRiBCRaipCYOBAxojzQT9uz8wDuFRUhERdeZCpsBBc6qKBdWVGX9DGlQuanazCv1UVRmaWYdkUXtrcPeox10jpIYPkWkwGs3zgTe+8870f/nCr7Wi4+cnczhfgCxCREDFAZlB1zPcPL+RIPZmDFkJC5L03IJWTO05OE5AftDbskbdwLSUsUoOkoCX5P/zAHYwBHMN7eA9xcB7E+xawD2CB8yyOxZEIigJcwA13N6+6baczDm71QXn1nff0fFZJsBYtBOH977/lh79uo7ntHqlGablwrMWoS6GkYZHIawZS6/InWM+m+6kWTInn6hfmasXSSRTqApoK7aihceeqFHzrqS3QlpbGloZg8UQppQTUW1e3kJxi7k+g/9sKsKfa5TokHQClV89tSPNJXAA5ZHV5VdgxK/sJNUe2/+zAyT8BDztMPVyw7aCQxYfj8BjlDvue55a0Nm01t6YtcmfaWq41d5QjaUvamka2JVmHB7KNV6dNtVWxaGF28uAZG7E95fABS00+3xVzlIKRwZNz6yjXCrUoIhd6FRlRvpCMREb7RvADTmMls5XTW5OmydrommseZb5KqEmiymDGG7/4269cmj9zqiPgk4y/eihuXXrIQQYGxFSQBElMV6OW4flGz8ySPXB9yo9AlyxJQAiClDK94hZgMCxkhIBVG2Y4D3FUVACD3X7Fb2Z1pUkgEVpVGic/Hxz8uT/5QAZVApAYAPK9APd8tl3QaAZapFtv+OCPfcvmuZt2q4Muj01ma7UbN8W49cNWBtGCpszaygM+NCM455JpSskATVXsBm03EndIbZPoIOig2daZg7OTk53T5e5e2SydZnGUg7dxoylljJg7J4/+yr/nkECuv4H539gFjWBSzYVvOztdzDuJzOQ75igQdaJCSIbWErbS+c07fmuIjMDSLjUhOl9kG+yc8CNv1lLuTDvTRnOruc25TRpV58hLaI08N1uY1WY1bEGpQeosp1VHkdX6JtMMMxIiYnYPLu9GXXP94cqk48a7s7GEjUhLlBhg7cCEKDsmIgMbCZhs3zgVBpOtBHj1w3T1F6tZzIk9z5ezrYObBy876MgFmPlOR+MpH/2Jn/7tI4fDXyNLD1LfCy/4oQcczCntnxHuD+qYJ2fF6OT2bpNtZQ8a+BFoAcPQeCvQJcEP/sG7gFxLURS8asa835LZSTEYsAiY2Wd4Uec1lOY9O2FhOGqrwR/eulwkozTvwBnI5Fy/MfR8dhloizN3feRffc+W3HtisD5ZjiRPzSbFKhCVLbqcpQNlUWb9BBdxlxMAFmnbdivubNp0zaYDm3PaM5spZlH3HnsyX3s2X7UXDzXtGmYu7Op4ey/co4XLWo407hku+8KvCGiE/ao7Tc9ngUfcVjNd+nvq9q75TP3Q8wQZLaH2cGwwz0omSZE8I+zeOzn5prp8FPN9g+S3gcYdqnCKZl04XkMnxAkmgMBUycy8qhI6JZA5kCfLZjACDEZkGZpMdV8SVzbi6gYXLMSsGTA2YgAicuUQ4olSge1IV3cFEFAoY7I+3PXCCaRkTMgru5dXsmFMZJ9QS+R+ffPed103GY2advmUpz2hmS4XOztR6mW2yh+758Rdv/Xil3/L87/hkuazjA99xmpFMkH2PzyUdZWSJBXVyxzAp8+dHx4+wPcHYj3yTIZtycdSPGs4PzmO7Vsw3tQcScr9swjtX7oPBgMA83YPTICDkhmMksFghK47JYc+dsutz7nuiO4rO0QV3FsBPZ9FmskN//nvrRWnt6dbRRHa4nwVC06hCbPWccdkZEFTkdhl72KRuX1gE3duFXT5mMc8pvrGH8Dxq7F1EOLBDswgBRSRYAmzPXz81vz+d53+0A2zez6+TumUb9YwDGmvPHAkHDpK6RxkpMjoEwE+NwQ4AYJEyAAn+HwhAzghEUwAhkFtvypkthtbWdRgGYsR0K3STMaGqLIosqqNO9/5rVzuPe6j/xx+Q3jb8prvdssy20IOppv3KhuVpNTBossdyIM9mTJysEap5NX7IsPKNUmk4KB5McRwWu/WuwS2TMxUe6qQWpGzxeRQJ9OiKbvSa7dkTJ1stOnzB/q+dmv3XHvZdNlN+IAW29yurxdnBkU7NS+UyUBkEF5FPK2Sf8BEloVMFRwTQOAEahO8uK7rKi+xvfsZz3jsm19/Q5AKfrfTc25t86Vvnz35mbc+4erHieYuT6OrVMugCHymw/pDmsIX67ogUBDyhf8nBkBXZSqSlzkmp/NyM+dNWfWheuTFQXtswsEN/sPbEmxPRlcMNM6GS2nL7GoEtk7W7fy2XXX5zr2nD1RwRdkq0DWFAzm0znEXXes4UHXZj7z1xndce6hUwM07TMAt8PB0i8qAWAsgU7GMOvbIOSfxRd4BO1CZIQYmQJAAm2fz4gW2ygFLGpmZwaIeNM9EDYZDKFINdpk9AMncSirUtuGHetbzwcgXL6av0/1q/HnYigFdkYtO6qDlQ+sCU2nYJgyADpgojJVyhDz0b5h2aSJ7II/Ywa8peU7zuR+NtIlc+rwHHnQZgZadrCVccrhtBHw2QI2ZzICcNcvq1EX74Ye03+1ndcRa3aFAoQ6gVUtcGIAYQycCRokkOYJ8w678DC/bBdphKsDacZtQDXKGzHIb8k9/p564a6oSfGKmkCVJUtFMxcHl/NQYEicHd6vFWmoK9W0a1r71ccoLv7bx+C/6enzFt+PYU84FueiqdQlgDI7j8BP4+q89RhmW0C6vPPlWfOgj229+xxQDymf33EEHDLO7ZP1t5nvlcAJqoYpukN1S2EMdzEyZBMZQu9BfdXVnpkaISMkQKKxq9JO1yADzaneagzzcoAPCJZtyHSYABMiKQABa0BT54H4Ym3Yszi60EIeqMHswDEgGyKp9zdxNRyiQCyQgoCVktAVaweRvhwALQCtLEnBIDgxTwAS2KlcEEJizwYjh4D1UdRVD9ODCEd7aSEVpS6VyxvyYe18R52fBq7YKBIukpoDX1pBVVXMkiApovy+gIzMlU9aVdWTGRAJAV0m6RpoUyvVycX+taYJ2FoZcc7HOwYqcGQlwzlJmsmRXX3b8hpv3Um6WMxlP1hJQQnyF9fXRmfmUiR04kxFDzXT1ewlkpkTY71JkILIHwKp+etvo+sB90Rd93hvf8GZfeE/r3OVy5H7ip1/ysz/57zZChnlRR5TASXX0cF0mMEiI1KxNuOu+M+MrDrMm5kdcVGQmLbPeK9Vr3vPncOsQnTmGCTiDPIgI0hhBbT2dXT/+he+961yWVQNKAoFW+d3sEryLy1uWcnLmjk7QYFQajIqH68Qhukg8BOCsHXs/Aw+Ei3SfuUMZpHD7e5Ils0yUR/UuqjVQZeQyQdiRwlQXDqU6JjFDJhaqwNqAC7QQMWRwYvPBoYmp4mbVAfkhPB88WS3sQCjQGGpYQTpP/NDSU+YdpLxeFNx5Dg7GGezkovq+CG6gk8h+dQRgoODsAWPpAM9FSz47hM5MILGBLy/x3LUDlkQhoQRRl2tyHKBF18I5InRZ2RV6oQBFmTtYJmIhWeXrqcr+M+9jhSV3AJetqzIw+MyXanUoQGiYS3hFhPlts807P/SBGz8wGQxzW3NKZA9cIY3T9Pa1jSt3Anhx6qAVS0cdBm5+fpBSOHz9838UX/qNtnlgG7HC/IAm8NZFbmyAC64s8p4MUIP4nWv/fnj0N21+U3rKbN7Ilt8/eNbApRajHDmAOngxYYZChBlc48JtG8FEE1JCBiygAtgMHgFNy96YCIraF+LgDDUhA2sJUG1CLC+xP1PCJKQIRsc+c9zFnLE2iQfP+VjAewAED4YyDE5RE7KaMZjRUceODESgUTeBAU67EJm8AxdaIBWXfiD4XyTAZNgvhQiFGSzvZ7ZosbKsjCkCiVADZ3Zm07okeojdL2hsuXBat8IBzaNu/mWgXXX1YTBrBzUzDNIerFNNllsQkTmlDHJEyciDyFYqqASwMq3aeIEECkuE5JezuRhlqMAElqgkO+3GV2ZOZUut69SGhITImvPxrWpCWhMtzi+3LtsQRgUWhwOHxudP7cLYGROZsrGxwQwGhdKDAouN9/v+glcCvAqKLsIoaz0Yuac+7bEf/OBtseGg6oSq6rEvfPHv/qt/9p0hSUpddjOCy1gDuofp+8ogUnDHfrfW7WV7cFCQdaDwiBJghYnG12y7uRNmBnWoKk6F+QwqoBkcOg7w1XOPk3vC+nvvmUavYhmsUGVmIwcWcJnTLG0+9r+/+eaf/IbrIoal1R1VD1c7NuOhW71f8sjdWEwRGnfZuYR33XDLq//s7Td87O4lDxp1Gd4XZbOsv/r6R3/rF1z1NU855oKCC8iocTxARHOeinLEW7VCiBW8AEotoGDHSDRwoIaCc6inqEYX90jBrbptayQOJ1qUw4PrF1k/e7JRCurUrHP2+xF5SBffOI5qi+4MlZctwPutTpA84urOxYgTYGoIHt284G3giks8eQ07CasaUE1dV0WJ2JotX/6x+qbbbrvhQx/96B0fl3LcJHTJlLhD8mSV5JGkJ119+Auf/Jjnft6Trjh8cGwzh0HCOAUExCLXYJ/4M379XxhMWkWR4Mo0axNvuvKG//LDBVG7WBTCD146ICw9Ds3d0hUmbRFrOHLZn4Fuffm3X/E937tXHWmxtWnYWjqURS3L6qLPy74/5sL9DDMxl9VGCwuy13XVeCtkQAGHTtylPu1dCUELZ8SAMdgIiA123vG7Z++9977bbt09cc/Q4HJLsaWcbCAJFH1lo43xFdcefvxTL3viUydHjs0w3FBowtADOSWXa/hxKi5VqcSQnHcaA+Yt/LpuIOG+gGNYNGfP3v6ed3z0Ta8ft3O32LXljGLLOSdx7WDYTtbrydbaY5/wqKc985onPXXhN4kUaChnL54MMJh/2FyCn4U74GRwHZDBRAAJXcgt7RKWTbdom2XKsy61OSt7LgeqSkQPbnl0wZhAy0XLuHb2lsG5GxflOlELcwywNZJNySZpt0OjFsUaMjHOREqmasysALGuXB0giNrqBQMRUEoEHeS6Zqv22wUTiEgt2uiKqKkw1wi75JhAms3yxOFAYTsk3V4qW5cLrFKP1iYSvHWdrWKJiSyvopKJiBWrHFsmrPoD237zLzNSQM3MUC8zlWljY3z1VQc/9pE74ANyJGq2Z+6dN971rg/ccf01l5cuOkWGeziDpDSTMIlTK8LaoTtPnV5/1PFg6ZEmwA4C7/7f192DMFYjsQxjI2/cAAJVItYwQOm+7IoxH8NPwSCUjQEiRJOczAHCQ+/DxnS5/K2T537ym/abTj+M11/dftPrDACcYPxndy3/8S++7sS0MzDcehweNHIAQxVmWIsvvSf97kfffphnTztS/PS/+O5r1+elLuZ2uBgcU433Gp77vb9goGD13I1bgRg65iq3S/PrmM5563ueufFz3/v3HvL9DJEAg7bgEaiawn/9f/z9s4uds/GhLdEB6oKK48WZd/3cj7ZASRAoX9xOnHFRFpf96g2zH/q5l3IolPwgL2seCGJHRdC4lFGhbZnmpvldv/wD113yDhQSEAy8bH7/9W96yVtv+9D5cnewpbEh5zuaaPUkuBJFADnkDJPVxArnD9/evurOPXr5Gxj5io3FL/7j5z/nmrXE7YxGQXyR1dFZ8Ge4PaWik2JgmFKatL4dinvd66q929kNzMhiLsqQUtovMwmEOCFaLHwMWYi9pDbn0ZF/+qOjr/qebLoWCaxZeFlhkLmKI5QX9UTaJ5jCTokBFb+r1PlAjAga7DfLvvQ84AbtAC24mtXpY6995c47/9BO3HB57gZzWYMdcsQaNXfCCsqqSXYqZjZQFL9387uat7/io0TRu+FVT3/MD/zQ+LInuw7wcIhj8zsOl1qxfUpYs5Vl5YtczDzG7ix+8cdveOcb02xaQZ/OLJaIkMi6lIImZyJ7YtsfD1KkD72j+a1f2qmGbyqPHn729U//hm9cu/qJU6AglKRED9sV1WdegCl3cHfs1meny1XuTUbI5AnNfs8sgiKYK9Q5A1PO9AmFoi6sWymcWk1lSTsHP/DfsxskFKXuKK1BuXSrKGmTnTuZWucA7YyYVYDElAGBJiIxcxdcrZnAWMVYGYPqQCW6VDqfI4yFkFlVaNm6YnLVEzsildAJyiajQE4mxKHDdUc233f6bFqS7sXikEtIRm4yxmAktgvJnjl2pKICJaX95r5EZkZgRlZc+LzKpDAjMYDEMWu93K3C+Hl/9yte9ao3EnHXZDcaSLj6l//Hn/zUv/2uakKIJXORuHu4IpVXNT2gWYmnXR7J4Mzu3uXrj7jmKBbx/sS3n4vOh1QYErukiQUsMGLKUNbM2LvzS5/06DsBNHNUQ6gQ1IGMAWKY53a3dcOCcW7jyj++6e6vfcxxcOE+mY13qRZPbMnDqKB019w//9+/6LZ8aJ6LHKoHdVM3IEIA6ERPzfN6nlxzgssTbfP2H3nxtz31wL/41q+8YqReOFMHCicmR4FR0dUtbe5HM5hvqVXwLC8WfrNZNhefuLzahjvAwzfADYsCuBrlQwe+NpmAgcb6/lg8QQT8xXy1Y0RYLdW4C5sIHlx1msAFrAUoIYNGbV50blhQ3Pw0/Ay8+9Ov+9jvvOnjd927XW9ugq7BmOCWcGtgAsvq1AwwzBAEtFjtMtkMajNVmJDig81j/u7PvuY6+/i/+oYv/ntf/aU7miFSLAef8RpQ0q680AEt3GCM6c7v/jokMRkxAZKiAqvIKbAhpHIv7G2gXnhXsj+T/GN+5N+sPePbUAMBnQeAYBgA5rX1Wl5s3RoT7Z8s7UIzOgI3tI59/yRs1bcFWiJfqi9+gGL7JS+++y/+YHn645dnvZz2MkHi2u4wAliufi85I6yKDCqcV/UZIaeBoYzLEbMlTje99p5/fsOtj37ao7/3nz3tsU+nukyVlt0CYXxJ72fNUFNTIcCK5OPNv/ZvwxteNUjtwWSiEAOyZuJOuGNORZn2oy6UoUoRIB1igeXzzt9735vvvvltf3p+7fLpU571zd//gyjLKdLkYVoOn/FQTzWtgfv2ujqsLWW4lOHCDeaumPvBPAyWvmykTBwyF0ZB2V2s0FPHrgA87OjshoM7b9vlTaPgsL+bkNZsgCQ/O1UEZI2wlrRWbZBbzTW0RW6Ql8gNUke5RepIW8oNUkvaAB26BvO5Nt2qP7ARyEBa7/J6OHYcSlGQE47TfensbV6ceHGxuXzTC5vTcnl6VgETUEEoKkzWCsfwxEIsBAYJwxGv8k8fqB9JK9vXsuH+e+AMy6SmRFlI43ioX/Lcp+Q0J+JsTUK52xS//OKXJxRMFcE5p/QwARYhc6RMKq5QNzixs2weedHy0eMX3n0vBBU7QLLzQTPIQQtYMlJQhrlHd/cMhmsHgKvHXrRFzkwlzGXaTzUTzmDHRNH7//KqdwBscNCHMw2jQCSiX3/HfY/957/zPn/9XhqV3Pm8EJ2J1UALyXAC5+GKub8SvAbrOO/yckbr1/z6++05/+UdN7z//bAkujteXdFRdFaLJpbzcGfAU3W7JGeZ5/DTid11sTfTUpGoAAbt6iYYgCQYYPmhB/bAWqCT1DgkEAC1i+8bCR7sF54R1rEqOgYg1UACWtEItF7r1X9e/ysVnf5a/rxd/7evuvtjyyO+2CKLgMFK+AFCAe/hHbyQJ/bZhxR8hD8OfxT+CPxBuC2RjUBjz+M1PjfFoXcP/853vfrsV/2Ln6mnewVaG3zGD5oJkIgWKLNrCqOPva+954aUGVAjvb+gFVbV8kh3wnwjj88vOmh9/nx93Y/+VHzOP0AGilUcDRRIpJlTRmTET34dAgMMq6p5KydqGVG2KGuECAISkn1aOUju3S/RX/vXx+9936aaWTXzfum19dErQkaReBDduC0mTbGxqDYW1biLVcxFzmKAOYOHFYqi0K2hnv2C2//n7N99xx/8zA81XLvWVeGSv5eG2iqXanz2rve87f941rFX/PJW3K5hZ8vR6Wp4tqp2Sr8InBhiqcjRWSeWvMJlDqkIsSq6se/G9200udi9trnv6efvHNx8g7dsrS4uEmDxiBRgqk7tdtENWzgDi6mzzAZnzpk4EwcRrKqDq4NdTBjUSMFH8plDd/wBHBdETqEmq4XF2rKBxWzvZFlySlFzbdpRbi23qo3lZpUQjLwkW5guTef7VaB1rrpE7pC6tL3jVwmyIIDYSCTNiuO0ebAgHzGvol6x97bt971mVTrDI2+UKLwEqZbn5mZdCSopC2Nza7xSXE/MQo7JAY7gCEwm+2bvhYyn/RhpqFE2U6OMnI1NA5kJTx/3uMNXHN8K5MnQaV1MNj9w0/n3f/BkOWSg0fSwCbCSJzKP5C2TUMsSXXViWj/SBPgs8IpbW1/FNneUBVS0rgMIVrFF4whKSPjuJx+CDUa2/LaveIwtdyCSo9kq/YqUTbMEUFfLGqS72V9+7zkjxMwP1xUwluRb+F967fv+0c+/vhs8Bk3NtFg0MQ6O5+pYLrcQRvBBvHnXBem0WNdiTKGkUPCg3IsxDye7XP6dF7zxX/z+Bzo5HgHYBnjUOJcLx7mABc4VrCItkEewSRU/uRMU+01yNFYGUOu1ZUv3D9LIlgRZkAuq4dk7rFpLPziW52ICAyAz4Eu3CrWFeosgJ5YFHSw6i8aSUDi0lzqf15c4vlkFY+vEeAhec7wGrlBUKIcohygHVgy1GMdirSvWvD8lfoeKKcoOA5/Ho26y1U0O7oWwVjpqpgvZeL176jP+r5f8xYdPEU5/ptetwMNHAZCLAsuzv/vLad3Gfs34gvqC7z/fkGHowlKiG03q5ejo9/6Qf9bXbyWuB7bDmAOEWGLhUAuyQ+E/iV/0/oLxpPsDatDWL1JRo4rmY0YEjCCwSw+6fPJz243LlkFatKCYpTbuOlGvWZBBMbp2XrQ7g/bsuD49rjtMWh4sXTEPtiwWXdgxf5rdfTmWrqgWfvro9u6nv/7lf/oD37K3e0d76TrlEFtJePvrd37gOx6/e8veerEt1SjjYHdiI5+s7DzRPHPqhDuuEg05jyVXrI6gRAuSHXKnxZ2ciZsGmVfuRKGP//av7wITiiMd/a0R4ARs7zXOu9zBw0rrKu0G1lUZg2ylWqk5WHbIjrKjdPFSxzkrHcqn1u75s4WsDeLUpWhc7HuqLe3n+zQziKkmMkVOhgxLpFk1ma4O9Y1aa1bDWtMlrCbroHWKrea42J16ueCjNgbggovDw1qGoeNQ6Lrk7pbXbcxvB6DIwbMniJDnMtVdbOsC7EDEWFsbCIz381HtQtcEMNH97mIyXAgF3zd/73+hyGZC6qGWu9lifuobv+HLckylhGqIveWuC8f+y4//6nTegGum8uGzgJlBDllI66Yh9irlzjI90gT4pgZ79TB2O53kkBzY5VIBQL0grhJPvNE/+pLPy8CQmi8+io2qRIzgAHMrxwNbShRgNWQN1OxUR/7onR+D1u3D9z4r4IVvvecHf/vG4sDlwU75fF4NKMdBT3vb9jQVieQk+0EMa125wW4J31phueQURNfHeVg2pewevf6X3/yRn3nhH4yB0AGpDpiCdxMDDGWCkDI6ETg2Sp/EHA+m0JYBWGIADIUoivuHoVAUGUWmsnVrKA42fgNUtHBxFRtxcQkuAFgtBAg5UmYGl0oleJC56qgCio4L8FqSSXfpF2kBeNqzntBpaxtrKAUhF25v4E67fW9iJDE4hnMIDj7E8mgOm+bX4Cpic2gLnYW8i+JRex6jcG6UztNsMbvsMc/7Dy+44bbP+DqnxFPsuojWg5rtsze98wwlq7MCSvsDD7RiQ71ACJ2P7cnHP+PoN/3zcu7hYo1uo9NxVg9vGMKG0MLwyezfvMq+Il01LTRohiq0sKGzyuABL5BVK6V86fqSy4OjK6+RqgygQeQiVq7bRHdlpDJbyVr45Mctby1xaIGjc5uk2TjWVepCEpeGEjdcd9C3R4vy5qZpKD52lq4Qz9ct7nrND3+Xze66ZN1pB8UH3/yWn/pOOqw75WFeVEOVmhXpINKW6QRWiFmh9TjtTtI2ZBc8N64BgxWW1ywdzPnwxiwfbMvRdLTmrrnmC//ejkzggdA+8gTY1IALxfFbs9qgneFDSyxDYG1HriayTsokjsiMU2bNjMSceb+6BYAq12LJCMoKih61t9Zb3IqhHc+P3/KyKpxvKLBGo1HjEIuYaDjBCYisLeo93m1KGvCuaE225LxgXbAuXZ65PHN5rtaa1qaNWWsakVvLjeXGacjlfO+Wczkj63CiJzpvra92dM1f+YSYMc3tNE0ONTf5j/7xk+Pb82J3BO7YNlt83mWHZyVZHrWnY4WuBFewsmgmow1C8rIsaOhZvZAQCUGERIT4QiwLQQ0KNnCGrbowibEittIlcmKToQ1lufft3/yUKW9R145drnnCW9f9+otfNhlVdZyxMZuwMSMx1YLaWwx5FWh/CSOgJUYDSeBhEcishj+TqrOLeQO0ljNg+8U59LNQJDoDyLsZgKYaQDcDsAC+85VngT3IARmO2zIiR7QTQiJOkRTYECseZyeO6Dw7ZLjnoD1y7JogipiFZuAOgiRDUOdzgSodblodjH/iToDmBHT3h4zavt2Xod0nc5kuGgCphaEBgGkNxBh//MP4Ty99U7m+mTI6GkQqUAQEVhdiGMfyQC7KgVuOeQbPqA6o32TvnWRmht8AjREc/BxULIcbP3G7f/7v32cDhaDmI9RFAMgDcFvEJeCjZLTThfskwuZBOftijJRl2BF8U2SXQRGIsLS/V7MhECpBNYY/X/oSyA4IUOgnU00ygEIWYFDEwZoWIwTkkGE7FNnnBCxZBbpHOLufg3BJlk2O/+LvPBqwuRnCJhwvBtXSXQMakozMV+YCvENgiIAZ/jT8kogrGwx0xDRuq81udAhuRq5auqPLaoNLLOeL9ujTv/Jn/vzkQlHPp8gJgE5bRDMA8WFd0AfhW1Pg9ttZ94JtoWRRJ8qiEFOCrooUGBw5r3WcJn30P/lRcwVGKZrfREqBTZhMCWqkiaGrXFl76CEGMewXjDZH5sScmINhSVMyjQAwReIZeJW5fomGVrX1rd8VT7WVNotRV3bsl9FwltzUZNdCra6LPjWSlhwX3E5LmSshuqAQ1MRLpZzh53TUuRDs/NDXKhRjfHzaO/Fv/hHaukvYw1lEJAWw26BGBBIWaIEpMjKgVu8qotal3vzOn/vP14SS6r1Wag1MGZXpopoylJBYtoln1I26dPhUNYE4I7ZMpExq4BZhSX6uvKXqa1/ftCHAxuFuAd6eoXjkCfCDDk1ZjchlUDLM9lqyVXYpX6yV3oOHsicShglMQEarnkIuAoe7u2a7H8hpkxHBhch50kqyJ+NSp0An0hS6xxDK7v77VFW1nNSyasq5tdxajtBouYM+MCzNqj1L05hJgRzZJzGxSOjG1z6r7jDQRSEIH375Mot1y3T7W5KUgTPlfOUmQlqUHnu7czIUgEMeV+VkXIL0/gYJRMRyoUIT6f31KR9sAa980WZmSnnVxsEs5k4cZU2PufZR1x73JGXC2IWWuPvjN9747vfdPRp4QgeKgAJM5nChDwTdf+XzqY0UCSYlJKSu6mYHuH70mJ98wA2Cd4AQP6h6B38W6nNkAMQGZHaVwcIY+fwtwN5s6ooSOed8f26FAjAshIfQlPPsnz33seChAKJSgH/wa0cdV8RdpIqTQQvSSIYohBinIWDebpO89WPbnNMDUUa0X76BAfmkzwsDkALaEtBZqGx2N/uf/qUXzZU6puwMnhAcvIcPqTpM4gMaBLcYHZ9Vl3umyu7GaKmhINpyNBJWIiXbdN11NBiG4aRlftf7b4TzJG7/2ngVw7WfwXahhOqnc4B+UPLpqpanCETIOTh5yMzATxrKBzgR7yg4coFWzTBkv1fz32jn4fRowaMPpHJr4PO05Fnh9tZxX6qaNIgYsYw9xFa9N+BDoU8DHTGPbtwt1lK3xihSkRfwZF7Ui3qXnUNVtCTzmH7ov/0qwqCEqgHk6UEtPh8e3GpRW0m2eOufrS57P8m1K0uSYsBXP/naRz0xAzD2QEa48C3zX9rKE7WXNIxh8DA2oIPfX+J0yd/OAjWe+Oj5+hYX46nleeXaUZyPzixzGXk98cTcZsYaY6ukgyM5Muq6cck1x6mThGHV+UJbDWdl5cYiZFIlBWkQO3fvvTf+zq+0DhNU2e9nfSju73y8n+/GUDOrGD43d/7ar8nOdmxaATslUcqEKCgSkwZJQ9W1SKPWRcLpg/FuM28oM5dN8slKSyPqBhKHpqdCmKcDm9d+9fNmDISiQ3gYsyQeZhc0XYikNZCC9pYdMzvnAHzKd5AFEQWzYHAgglMKSo4IR0+/lfIthk1CijwQmkouWAMpDfIO8jy4bhC3CULRrT4b6SrhPMKiolW0yB2tArJSvR+TlRvkJmNPTmqRvAnATUdFYhQaG8j8iueE3FEYPTqecB95TQgBqZvc9bqZwqmx5E3DAWdF4LplbdIAqKBDhwNbXpwSmKCrICwickxE+xcyRKucrAvloFXNLBtl0Oq1ma3MzLqel6Wbzra/79u+kKWwMM5plimVm0/4+V/545EviJVJmTKD6MJds8ol3w2XRaAsonpgWDzp+NoTDg2uGdPxIhW+IFPW/OBw689SjWgWAC0ArWcApPu1j6CNWVU5hL9yv9lq8hC3buf/zycdaJWR94BCsjwbKKqhk1bJhUxQcdaKMpxzsa19WbLr1jd//g23F9KubAtccNatTjafVIDZ7/vuogJGJYDv/7m/mGnQYqTCCISSEAjewZfgaKXrBkP4EdgjSKwGyW0MUmaHOHTdkMU3Zdilwdm0dhLeJ1domCzNqS8sBPIeIaxuDfBggfw0vxXZV04mOAcnCI68cAjwDvKJv+KvLU7KgAsmbMLmGMzwjsUTC+hvtPVMqZoA3/7lT9HcKktTHWjXHr87uQ7+SvjLGVsFRmvD0eZa2FyzwbBGdS+kgR/mauI4j+OizNSW6ygcgljhUASUZWbJvowS3nBXvPHOMx7JE0AFgx7mU6bBgWKXYc2tN7zTSRBLfPHvjLU7M2se8y3/ny66DgoFIWV4elBolYJp3yOlguKSBilKVOhQJABDGA8ViJd8B7wZHXjj0U/7wtgtoquj+HEz2przgUWzHjuf2kyd36zkyCAdKPfKJJOr9uZSZjdqc2Y9NdazwxQ5i4EMBmRGp50ToFmuCW7//RdO69PUlHF/hTuGrMo8Edx+WLcZrYr6Tc+ee8OfbmlTFKFp4VNgZSO0Ygo5O0xnxl0rNFi68dxllG3YGC66ScwTVu9qyK7KafAp9ifSBOfjuZsN137ttygAc8GK4cN3SfXwR7cyQCQJlIC9JgoKzcqAiHxiZtFDr7nIEIggAWpwyrJ6AkraPnDf28Xq5IJTNOKGRkTRKGUaes0hdaVLbLlzhNwyrTYUo1V3BSjUjA2WbZWES/t1QPaDZdBOTq97hBlmgphQOEtFwnRyNW+uVW299NUzPvq7d23fO56YH64dnt1wU06ZwJ586o6U5bm0aGOpyxwqVDAy3VznwsOyd8mUjM0EpisjkkjIFHZ/xrOZKbMaFKb75bFIDdnAzjFpyu0geFdvf/VXP/vlf/Qmb9mU59kvT9evecWbv+rvPgur5AEjwCmJUSJSyZe8H4sjMckxETwAQybLRI7AzGzaEfGqgrV+5ivGegCoHJLCZalKpHPYfMEfvpe31pUAUyQD7b8LI0CTOUcSnjmcSXfGwiFBSJ04smOCqzb4lo45tg2vwXJmBQATwTKhai3bXnxHc2iBPFSAFbQqaQhdnQLsk1iXnlb5OTIQYF7Pb++qN37wXhmOMwhFAUSIgAB24GJo80UQiC/bZLC2ZJBHUySXVDJcB6s6XoMqMAPNzUh9kUjCaFIvl1AzYmQPTiCC4cFG6qeZk7bfI4ThBEIQZ8LqGOJW1Yw+dSUyAoSJAqlfnSehZpltVYHwb6DBQ0Dy2ec997Ife8McQ4ZE6c5/3XXl933jVYeATWACDIEKICTAzsDPgFefxn992z3ntqs5DSwTgkfbwlaBwYSkEM9ESfLu+mP//a/+3it+/PtSWlAYClb+Z3oY90dBJmLMznXbJ3jgqVPiB7kf/tJ+GBeLsFl93leSkxYJYNDcsH7hDPSAF4r+UrGNT9F1zJ0gQoYQH9EKLwQhcekuURq2va/84fFXPm/jja9E1uSPN7R51bOfwN/4vTiwhSLAr3qw7pfER9o9nhd4yxvvevGvjNpTKtnncnO+uVu1q2A0JbgQNLUlOcndMzf9B1/9O5c9/4c4Aj5miF8lqtBqFTEIMGX21Cnuu/VyF+ftdB7YD0fWEu+HB9JGzcpLTm0i2ea1J33jd/hv+WZMxnBhPz++axCXuOmjePtb7/zAjbw922A7VxxGqkqHhqDwg2KBh8kL7R5+9QUMnMELxTQp2FgIq4tD+pQeXdYkpgA6QDOcGLSdNO+vzt+qVGF0Lu+6lpW7dfYLY5gbpizp5B2TI6FNSMiuUrR8YUkb0yr9dlWD40LJfbs/NZ0BcBnO37kbSch5dNkyV2bRRulJXz8mLFw1bLrtP/uVcVV2ZDmnA3YO23fmA1ebdoGLK9bXT85nqsPZbn1waxzNiHg4QFlRNxfKrRNJCiYiU2GCcSZ1bF3+hK1T6YGgaANngwJJzRygBstDDs955uY73hd27yl8OZxRO1hf/83fedOXfNVzy0BG0bNLkcigREaZLrG5rVpisgytTT96Ynfgeehd8DJ05kiHQQhMn8UmWqSamF3OQXQOHtnem+stTLZMQA+KIr//REdcmXW22/0/f/cJCEMCkCoNQEwV4g9/9dr3/9LdLkDdlotnkwOUkbkTRaqsqrHwJ9eu+B9/8o5/9lVfCeJVqVj6FKTC4Ai1ADP4MeKoGv3AC9+K4UDZQwgscEKsRKLsIbIoN1FvT4ZcixZrB9q77/j6Z1/3rc++7EkbGAIGnAdedxIvfuN9t99VDyePbem0kc+Ghh28R07IDmxiOasg55wAYfo0zlsiURUGCIMdgkOQ1RuGsDEhOAn+L3/cv1aAg9PEpg5GZgL25jzBY3WyYQJAl65r84Q1wlHgWUfjdz/viU+9DAeAR+E0cn3BMmcwQ6SF64CDmg5p+08Ol899/uUvuufyX3jtKViL5jTEkwqJqgEoYJQ1iiuyDd55umt5MAhtCzB4P5Pq4bOACep8Ba/raNtOHeWsejGvbwiuW79iUQyGqznj+z/kg3/k6jkwQEkvTRiEad+CTMi+ELS2zOcG7silWsAtFs7j+OPomV/x2O/4ehy7HqMrGhcLlBmcwQYhsAOLAYpYVBlSfMXRq5795XjFr971ey/Khp3RgLRdbYNGUFUhZlU2uHq2eMMfL//BDw0SMrqEojAkUkerxq4CWgWlCDk98aqXWppqxY0Tl7WArELcfMbO0PncHli4W9cPPO1nfgFXXn+GR+Oag0MmJAdzUCA880nFM7/x6tTh/BwffOt6ChBXoG1XdeT4YatK5B5W8f0E9pa6iPCX+FaJQMhsmonJeTblvBhKV556PTRZwZAp26agzqhAy5xyTo2Mhhu77/eWsi+ILefk4GhlWNK+TaDED72DUAbg6tHO1IxbR2Wbm1IKyfVpv7nxRd/qm70dt/aE+17bzXdHBU3dZsAukVX3vQ3HruV2DhscrsAOhYXd3b2UU8liwKDCZK2cTlNga0FClsgERkQMY9jqEvjC5S+ZkqmpUTZaVYRWcDbOBls1blKqm06G9fd9x9f92L/7tUS+8DmnNLeNX3zB7/zrH/2HquiWM+EB4Fbqcak3WEJxdQLtwCEMZynv1ZmaXKYd0XhkfXxoMsCnLEsP270GKYyU2Gjwc2+esc9K8pD3HxaBgVyxPPclVz9uiaLCfqkzSNIOXxbgrE3iwQCl/WOsqjm4DqmiYekWUv7mDWf+ydfw/r+wPtjK+OueprSqInRvi7d+eA++QeUhAvYgrCIATMREIMvx+PhsmWxTRu19r/uRL3/OJlosNmpAAsgeTfXnH6Xv+c7LXnLysv/4sg9YWsJXqEqrm32HMK3yQAUmYHAWEJli/6T5afj5ReBkPxhWGO5+U5jv9zHA/rpyyQYQlAFhMwde5S45qMF7mAPphYIQMLt029IBDR3L8z/9/ieOaI6k2U2gbiFOVpfXq+3YuAAKYMou8nwLzdN3h086Vl7+DUf+7StvgIyjJXZGymAyymbCquQUMZ8vj/zRn9/0Lc8+7lCQIROJPXzhDrQKWYJrZ6U2Mwjd35L0IQ/EigNP/6JV2RgPNlJCcLaKeOAL802MDMvI+vZ/8LhLs4DJAyamkkbTgZvIDsXyWT/xO7j6uks7uFO7EO+OXHnwP/3KUihjPFYq0bUQgFftRuhB1x0O5FsAk8VkMvzOH7yKq4+85vd2+NRh80Zgg646stv+5My77sC9t52777YrDl5jYMDtNxMglVXiFoGIIjgg7nzkhoGgFc7EwQBYEgVQJHfKdcPScVqz53xTffUXivkSqCgit0IS2IElJjjnU/ZM2D5cHPjy5w3ZR0QPdeAiAebhPzOq+bDcARsoAvOmgy8uGm91ISDvL41VPhKxGYsJiKhEU7bnNrZvUCk7PxUbEDRYrVyrlRVNKnCdu+rka/3HXxmdBZBL5QPRqxcCaXg/xf2hF3u+LzurMpI1IHHEGZLPHrk6Dw90RleHub7l56kYGznkzkHVuwP3vSUTBtJmwwGPQYFBjtNZappWiBlgtrX1ARsCM9FKd4mIHIGIHPHq7udC5S8oTGHJVAEz1ZUGG7KaZlIFlKgU1zRXb4Yv+qLrQ5nR1mSuK4ZveOMNd3x82dSdDyyUHIwJzi46zxcdoAupU1K30eAkVMQB481cjrabNgL5QfFJn2mMmVcXX+TG0I+getvt28WqtcuDN/39r1o5OKq7bzgeYbFYRfQKnLWRpXTVFcA/es6TjNehu3r/6ZMz1CWX0HRcKmbbt48e98E7T3QAs2jcD/a2T+rdI4OBOlQjpAz/s390B0YbEHAwBIbz5EsTn72zQAgGjTNVv7ZxnOZv/7+f81Vr80GcjhF2quE9wX/ch4WrkJbH8/S7juIF3/GUkc/BMyyj8PCOHcMRfIAX+AstkJl039v0aVwBM3iluH5fhp1n8fABLMaXdhVKBAjBr37a/g8kZhKBrJKwP821s6a7CIOWq4phKSQ3iQBoQ+ABn+Bb+BboKCWKieJkb75l60vbwogC737LUTzj+KArtiyIiVPP5sW8wJN6Uofg2jw+8qJXvQ0gQQtDhHs4gx3owg369HyRu1U3jk9S2ITYrz/+GQNNQArGEWYYiP2lM49lzQCBbCOdvKRxpDm9mU6P7N6tdPeR5vSh9vSGzfLGJTeFosADdIICeX2Q1qrMxjlBCnWFcqkoFMEAoCUsCTswBJihBfbccfz9f+I3jl4fY+YL8RbKZAywEifm6NeOD+Lue/8iBTg4AsBJjIFVZtz+s7nKUgjLnUyezIfkigxG10nKrC7z8db7ab20NH7a9Qv40KDDYlmm7GEOYMDYE1MHl8GKAtTkSUTljROqOTxcmj18vWk+IzaMqibFsoscwqUGAQkpk66qRq+C3TxHavbW4tnkR9Gd4bxOyIysboo8ttpBNUt33N06mL+HC/Oq1npD3s+sVXtgLzd+ILD1gQEAszv3PIIhUsfkQ0RW0frQZY7SXjHZOvnOxa3v5NjOMRjrHhEldmu7H84RnhpHGDOGgQYWY+QYs8OqqnocDEvvvXcsRAwj2pfb1dntwVHQeCAVmPFANjCbrUxNhjkzqCg1OU7TP/i2Z7VxdyTBW9F5Wl+//Bd+4VfXNgegdL+UfhrsV+kycUbDUAqMYnSqu20XxS+TLlP+bIZgtQChNeIlQHr+z04Chrpbgh569WpaFIv8j7/8sR15STEDCYoUIwiKsMT3PLWArLu8q+Qv1N9TnwReBxmzvdNFkO3RVb/ym7/ZAVnhXLFqmfLXXq9luAYQ3YnAr77uAxKs2tzK3iAKxyaizpkIHMFjUhzHoCvm7/7db7n+unoH0rZ+6JLfsPnl3fLKToc5mDuSZHIQ+O5N/OgPPUdTA175TYyZSRjCthJOYRK+/zD3ae0ETMLEDOH9ao4r/zPTX4nA+tSCsCAgguPVj1pZ2CQMeVBM9afRaJr9Hg8WIhIXRJ3bL1vMZWrL3JbWFogFNICdepd9s4bcaqVYOh+BY8APfcV1qM+BRYWUyVYJOivfo0dIe1B38307sLzKPooP74HSsF8FZT4TywoBLnb/CwAxYXj8KspNyktkKDSCYX/5OKSqIIWZw8YljRJFgcBOAsuIKpvHeqYzt3XJAhz9CDB0XYAmOI6E6LJbMFq+EGljENOAFJA2O6mxm8vT63FaZqA6dO3zn3/yzJnMqnR/Ugavrisic3aTyYS23/2uU4jInoG0SoeE8v46UpglAMgTx6xOVIpEZVJCTpITg43ODIzLtEmL2z7y54yIiC0Mi65KGEVUGd4IjeUUUhvauV+MURer+/AWsjqzd7HAI0+A034UQARQs5xtwKGQ3BHnhx5kDzk6J4VaVY+ibycNhm6n5qPX3vXzrXHi24o4ybTbOYp5w9Ka8C57dJ5H9eHQNo0VhRum7FPVsvr7JVZVVbNaVIuZZ5ZGyD4jteoTKedGmq1wcnNn+HHWQ10Rm+ZcjrXtHh1+zbe6LONB1D/79dHYlnL0aLvbSbWUqsvdRPa2du87b0c2tK79/Fh5PPmmcsPZzkKAErYG26zgSVuLTFnI/CpAGSYGBrFhZaqubOALBWAVqpEpw1ijICq6jmOirEYUY1tsWpge7M78H1/zlWfVbXO71rZd2vrwR+/74Ifu1Iz9kpJETKtsrksYKw12MAejnAQmQiQYu2CJxQ2ni2gwaIZF1c+4AJfaLlAl9ZOmWfLB/+8bzqCsvY1hGZT3H1MlMoIJqIA96jFr9z2xUm+hcb7AtOh45keDnBJjt+quAIpmoLw2QELZghSm0SkillIiHGjJEPf+QD5f95ZGAMVGAIuUPqnbSeG0FgCktwNdOYTNas3gIaSAA5zCC3wBLmBuqoo4/PEnj5+xAa7IdKtIYu48aIQwQODVrZYDAkDADwGff/21mLgxZ/NXerdtZVl2A/WeEeBCWzhIAIDCf5LIO3sglXnVFhg5Z5CDJwtijiC0X8iCxVhAjP0K2+5BOwb/NTsKAyIgB2KIQBzc6qzgwc4VJRVVtvT/Z+/P43W5qjph/LvW3ruqnvGcc8fcm9zMIQwBCbPYiIi2gCKCY+PYatva6ts2tFMPatvOtrZTd4s24Pg24tDiAMggKoogyhwgIYRAkpvc6UzPVFV7r7XeP3Y9554M58JNH2h+P7NTuXlyP895Tj1Vu/baa63v0FxI8jND0LvCw84BYMVwUAE3SByEJw4NzOAVpCJm4mAeysvTCa6awyF3oQucurwP9A/CHNgheDgP84QSqMC92aDvmM+sHQb6sKFxGmkXMfcnABMC1AE4eSYxBqlJzLp3K9Cc7196FTzMORACtLCmdpDMZ6KUuw4Fl9sAFok9LuowX8Uq9WUllo5lbsOVYkjjC7S9O59lFaggGRKQYMkCAApaFzpjB9XQotc6EBpDbBGVBQQYk3ifPDwKGns7yjZ2DgkzetSjjwyvKZJ3yvlCZW8aZ1qIOttut7yd/eAhBPCCACCYA7QnWLiGF2C4zXEEONRM83IxiA1R3C7hlccNKzArsLI9LZrB1nDU/O0bZu94xWJ8ZgI1QinTAg2gClTsfPKllQUGLQ4SUFpC1TQ8JTRW9Ir20y8A7y4HOmA+X+SKK2dptU/8QKsIbWFBquinGscH022T6bpaSyZ5uWQHI80UHTNRiCEaaVF6ctiV9XYuQ2Tny6VsS8g+Je8MAuLB9NRMODkpDdEZeuxKV55cO370ykdtB7ri9ndOPvD2FtdacU/Dpbg2iGODY2yffm/lSzVTodU1qAQzm88Xann9RBnQ6xe8ozP1QBX7+1GBO1fgXIIWMzNSIzVTWISqNSyeJHzZCx5+aNVXoVIf5ovtIvT+56/8r9F4FVBwS6asfv927kZsIGpiBAicjR0/6VmwRMn+ZqD2rQvMzn4U6lxZ3h+C0nUo0x1fdcNV8KmlWZVLx8VsiDRzyXPTx8ZRbL/4C4KmpqjFTVb2XGcGg197ywcKQ4vgIcYlKMYLlxYzHoTCB85AJElMCAWYszZaRxbKBzPibLVdf+GzP0dzY5MykHPPEO8N3/P0NWxPF+TAbeQ+iOpKc+YKZmJm9vm3fOJ5sKIry+TOw/L0fPeiazbTg0msiXj3V84EJ6bzH/gJfybvOmYYJGrg1sGbnkwxmqHcZpqjN0FvTkVDCorgKews9FRhJVJJCYUC2kdbHQSuztDxXSdmRDn7J2IliOnuCs/+znLaXXaw/AX1Ar15rwpywA6q9FPR+rngPMeyKLe8LcQUUaM8y+MtHjR+wjwtLAHox7JqQtkEVmeEljFztuU1sc6hNSUUaIAFPA4dvnU8uuCEohij3W9yaFdv6bDQAhpccTVpaJxnDTC/XTgFjRsISzPuNcMC8+mTt+T0i3/0b77yhe9/+c+sT2663Q3XUTYAsA0+Bz81a4sExrZQgnmkQZWGfXOK1OyfM5zf71lFCm4UMQl7T47oIveOpRqoaHubIa5J0YRmuLr+puAWqGvjlCFL3rOIaTID2ImZwEDOyl5hLqVl8TlHByUiMjJYTjPVAwmIZGpoWRywsnlqI3DwsddydK15omShecqzZ+iFwsq/+JVxGz/ih73+1qwYK3wliOxBsTnz1iGeBcDBrfTh3SDadDaNllS9EnG/wnAQtmZ0L9RX54e0FOUwJSJVFZCZJaMid4C5K0EnU1WospklZYeaUo9I63n8yuc/9SUve+M80so4aFu97a0fuvXmjcsvrUA1LAAVsD/qekymRAQXk7YKz0xkn4IiNIWqTfXAa1uW//737vCFJV/ViwV6O505Wi5MCsNIt7/m4U+oyQRUJsCNtzmuRJ/CCLH24UBC/SWX48e43DShcgh9YOOgZjD+zZs+9qIvmAhGIbsKcrIl5X+PByAjznt//Oe3uF4lAUiGwmNZJYbrIjEz49D4C8J0zdKcPFASQQhub2lGb3gC4Ybjx993bg7UicdQj0rQMjMLGQmzd7CgIPvEhBSyDTV1JWLuUND5Nbsu+vKDCcBEHfEfzFDLapld2RzIlW264McuYTv3XT4GAKSEleIRKTK2Bi0jFig2wGGGcFdN//DhO081OLkxPbO5HWc3DWQT4JkbW1pUXE9XrzlXByr7ptZtMtTIMUShpExQcL5TmWhH+x99DQCxgpC/5t4PkpoLsTGsoKs7+wtitj75mAzSzkTOOoGabPAuQT30IHLReFQDRkaYTQIFmJc2nTt75/tvSlsbk9OnJpvn2qlOy5YNw8aLcVs2V/s2LuYXMLpX1Rgj3bfv011Wv9zIJrhDn/2cya/96laJQYteoo3KG+lKraWkQ83gJE3qkW/adbSbj6h58mevfN+f/a9NoSuf8yWXPfsr4iXXExAU3mr22x4lYODsnw2Yd6SMxaenHaECLMCsBrNPZp7J7OJmi9cAcsnboEWyXk8wPP22XkWLaUNJDAoj78icqSlAZimniOyJApEjAGzY+b1kahmpbmoEUm8Ws+uud0rUw7TcPiUjZpcK47lXtpS2fY+e8qzFdvMwPtW8+0+DDFZH6xZ7dSFlGkgRA7FZ3Zu9x+fHFqFHdUmVunlsWYQM0QUfHIrKCI7MlhF3+QASdTjoTN3KVGAjGBuxQcUgRgpDlsQiiFFLKLEgHZL6fjn74s+/4jd/TWU4mK3fwZGPHn74z/zUr/7CL7yIeaHmSKj77v/Hw7FGMyMW4iZpVRAjY7c/uasBqwVfeb3rPXzpW++clP1B8s71BoImx97zZDODU70h3HOixAwWZxuoDgBgzGCrw5iAipM1bnQ54chatVmkduM9GBx/wN+7mMX3N70PnV6/7miVKJQGUPB727QZgUAOaNB7x4dPkgOyJuL5NmreoxPYGZFNznzTcx6Bdm7lWBAcmoTgNOwV3xXpEq2/6EmXvO81HwNPIAOYgFuQMybAWU7gEoHIPuGb0vlSIxPj8w8uFTko47btQQKmKM89AlN3m/JuPF+Qrhz1cc6N7t8oTj45gOCtcTKFH99C4df/9uQr33d7Y9T4ak7ljCvzBdwhMENayDpIQGMED7SYlBivoD2DnSyciZS6hjc7GDj4vAPYMZ/YL7472a5iHEEJbHC2p/yyKriZNjjokEBgOJCGB9U937clHkq21A5ZxuDSIigClDBogIEBd73n5j95+bm3/Y22TZFSz1IhbZD2sKVLGFy7SRkBHTXem59yKly6WuNJHNor/U0p2f3CiS0T32zMCIKC8IwvKl76P0BIXgc196OflG4RsFLjYzSvBn1r60br8rLBVnu2v9i8PmKbt8o//bU7/+iPzgxPrDz1GY/+0i9PR44kFKWxIzhsGzlxAyCzGfatcrxvAThXURSmwGQ2Zxc8MTTRRaqaOQnJC9mAOQbtH+S7e9t3N3HLUkNsEAaRQTlw8MHMGMnMiJgDq7VqSmpGIGNDBjo5Mihpt2szZiQYiQa1yK3JphvQSCkFhTEIZlSc6h8bXfuoE6ne+p2fG/vUHOCB3R316BSDVUmTQgbihbDa3K4CX5Ql+aGLhbMFTBo/3ZofPlolkBnGY28izF7NHMF1fgxL74OdGcWcg4nCRPMGgnNIzoKUpjAjJW9WGywSz6ebpZTf9M+e+/Mv/d2VYS9NKUa7+ebbt7fb4cDKwqVsULFPyDpP3sDwxdnNyejISjZS/uSnwOQAcPXKm1s437Tk2qmEEqzZOwYMpIiyoLapQC9+/tMQFi1648Fo3s1MRoAjbANjTY7C0Xn9vTde8uJX39Ub9Ra6x7I3OsRl7+f/9B9+6RsvEcBLk3zpscAeVWIBPNhbnFH48JmJFCV4ABBcLj67LgyzywVPZnrcUQ9tlovIx1lRI7sybjztiuFPEMGErAjatJnf4TwsEbOByTsg5ETzE4m+BDDnji8bcpq+VN7IrCmmB7nNUt2BORpnWVR470SVmFUNZiKCwBdY6HONXFJyPoiYwuAnDBKUH0vlz/7hu/5yg26iXhwNMLoC1nWOycRj7mSbktU87kGBtLAaUrKkUhdsWzNXdbxaIygpdSpg5IJ5p/HBgsk/gRQ4uyb4yy8X6oyPaG86lgfd8fd/vfKFVww7/DS7/7sl6HxnMpkqii8cAYS0oFK1HBD86Y++7eU/ZR9+h1+/ayW4SxZD5HSfvBFHV9WsRiiJm5CMzDF59dHx1OEc6SA1ewXgqqqK+yrfLc8mqwJEsixP6VarR147/OAH23Y67w+8chVdy6512B47anS1ZlBvwtZUmCn1HUq5WnSxyndfsn0HveZdt77p1z989MSJ53zhE5/5jRaspT7DvArghLEFt/Lp1wNWhSm4NSh5Y0dkHnCgizqIAE5FKs1ZmVBsvQUW43RKCUgEcRCOMYq2QCIHDo6DQyCjjrdjRqTOzGAGJVMyM8ovlNgys96TlqTEfrhxchLUQUtwbeaEU0tl+cTPrxhrJ/8u/d3vz6tB7+Ftz1dEDcsa8dQygoVpVJ+r67OmIGiVcHBIoAQr20UypAD2hEGfvSvuM5mIiO9XerIsgmpQsOSmr5EZCUyR9YTMlKE+cR0p+rDSt/T8f3q0wKwRRXBNI7DyF3/+ZSujg2ZU7F+Bg2EgVYKBo1n6lOlQmhbABg7+8p+9h3UB7XlTWJvTXzaGMbyDtIOqLES+6OgKYrtmyUXpIfbVBsJILWIKANJGkeaQ+fOuBoblYrj2gO1uAJinul286vZmbqUzAEkuGCWt+0GtgUXoEcuy6evOu8Sz2+k7jqMe7CtcWSwTeAe2C4F9CBSOAfCBkcFRGXe2bGjs6Fgx6QVoLfdbv9BRjLgLSB0wYR9Svm5vmT+fKCd84IumKTvvm5jMhUhFaLdmGP7AG++48b+//efnl75rcEV0g952TdgiTIAGJEYuUdnQoOYhqLfgAws6CIxBA+VxQ+OE6j79lfPn2Z03YxdHgvc1AEeIAjhwQIjPd0/2GBXj3M3vbKFsREicOUv2fy38LuHMMIIvnEp02hSWIjCYnX3fT37XW7/1Wcff/seXb9552BEE8/6pRe9UW542v068XWC7L/NBmucXfZ05mjraLLBdYOLoom1PXVZoz+QlH3LNDNXBg9/3Q4kPrPbW5j1NLo0bFIJpwZdMrR+R2DdcOCnLWIZUJComvXnyUQjTEtNRW9DJx51+58Ff/IE/euHjbn/Vb0bx2wg1C/ScS5PB/gkA7tvU6iDhoCgwzto/xHTRBzkztsqiohhw49bfBhe1biGgxJa8dsUaFUSRmEQUopCIJFAV2DLW2jL65he0A3CyaOpMC8CjtenGgkShPXULmBOSqfLoqc8ZzaeLt/3+gbCQajE+nrQ3Shg42laiUlhZkrkVkdn0NjPnYWX0B1fztfDzWQ2VjDLtVeTZuWVf7H4P5L2fPeNdNCTqQFhKaueTYFOfqG5cWy+KHkJo8S+//gXeFyklV5Av+q977V9PtwFzSer9sinMOBUQKTtzvm7TpwiE5T3J5G/mONcaayJpGxRwi/MFPQCxBTObnrjk6JlJe5usnNyQj6Tq5Dx8NKbb2+E9rb+nqU7GeFc6eIemk6MDG4brL41YP3Xf0Nu5W5rTCGnvGV3+39/wbq8JvswAqws8AWYGjS0AX7GzZdBddlK7BjCBGcy9RSOUmqJymgBAgzfEvf1xWQEaHgCQIriCT613cAWcNyY4B+4MP85HlE9w47yblbuEBS5f8INYCPboCZ+fLhcDJrL8rwvVQgyMt9192dN/4s9/8qat9bUjpcwObtxzIGFBK4YVoxG4D6o69DVl79ttuBZOgRo2Axp1qfG6G1J0L4DYDnJzJ87ZfmacZp2IBnwQYgVfeDtCqT31ofeErsIYM3z0/2IAzhdMAQESjB1gCk3jN/7uG7/xc4fveMUluLMucM6PmzQcLbjflL22LNueT6WTkrQ0KwVlpOC05DQQ9BouFRSEq3jRGYMzEFggBlVyhlSwtdxD72EP/94fPYmKpsZqysImyi0hCafISkAV0U9K0Dqk1SYBul3pPKDemg+jcy3HUDwZpz/00h97zfd+0+zmdxGS+D7gfNy3G7CfIKx8UkmXm/KsUXuxs5dbIiqxaCgUfA6T26MtKCkIxgxlECTV5JSZiZ2I0LKplKWV8wY7Q7Byn9WWG3IiNWTrGJh5IieLSOpIkqlXmsPWhC25anDdY/zZ2z/0ht+5ZOxOnDBdLIpLjsatMYebIo5V0qSgAu4T1/G0KTkzSzzs5bMIbVvndoUDQsHOOUjaafrmVb7rB5vtXL+sxWFEO25/Rrz0R8qT3swAK5S2IjuH8eaZe1YPDZ7/Rdf98q+92jkCiYj0q7W/+ev3fM4zHq3cYJ8kWyhfW4DA3hVN21qoPgW1sBoYUP0/3wyIqbNC6qZcA84C/fPG5f0+0qJuZP1svOrXP5Lo4Crmm6NyuN1OqzlwtGy3EgbOnWvtmgK3S//Qwe3JaeZCr2395AF/b6FR10bNrPzNN7/73z7jkok72kM0CnSh62OIkVxOHxVMBO1EJ+638Roo15AElJKUO9qMurgXuCMooh/2AIgaO6OkhYc4IIEYpkROl+inT7yY2D0jO33ZnR7w7jD84LsH99K9MQITfcKlE92VF7osQvPO937o6X++ieEakrlFarTXDFZgDVwdajKQMAzcbWrJAPXaJuqBmFQcYiKPzHU3uf8WYefS7Wws950lorCu9506ybmPc41Ts3XPHQZAE5yyPRiz3n2tSJ3v+8KStwTIP7zutfTy/+cy6lk7ZB1UdfJui53VQaIbkhnbTnFBAc1GbV48jFrHyimoFGJkmsg/iFMygsKippKhTS1l38JRetJTn/Di7zvzIz/UBjnb00J1GCUyEiM6KJSBoFKIjltlGfSNQvRKrD7NWA0JQU55d2J6cvWjb7rp37/vxH/57emV1yaPEeJ+tYH3b4KpGYIA00VrpEwJpEp8bxbfxz8MKNuy8TzzuGz2joqMTzWJRJRVAFUWeK1crFwqXCSAIKyRKXoWz+JJmc3lFxAyZbKlnIV5MjY5AIqBz3HTm98dSg7mqGpWK561cmRtXr7zssNlgUO/972XDQfTQ/f0DzuNCGHh/B1lfQWANjSskcoVgg3ueLtV1DKxzkY9OGaq4mYdWnhCCgrvGj8omECWyBSWGEa5vWtCak7PZyyqKqrZL6JL3wnKUELeLItRQ8lkWLbeqEnjsSKs1rPPfuzDSsOipWnckHTlr/zySwYDKrjw0H05hAsPrdAExNZsJizEKvtoYB6bjNjWGSzOgBkAawYxfYQPv+oDtyEMV9pZ0ytBc98egCSh2LoEEiQFqtoPPubKVB1Eic2yj9ZNqx5wEEhNMZACrTsIv9n6VWnT6aqHomyryb1z39y2UJgteuidOkvpyHtWjt1ydhwAL3oB3nPKsTZDZolDnm6BO+VsYuxgfIgAFBQqBI9sj6N5exUu8Dxq8po8wJQIkdJBQOCb84GTSL0X58AufLwSWdYwzJBu1zlBU1ZH3eVLSDCYzWED8tLSgg1Qbrm5UOGjxQYUCUiujIIihQiYkXFWEUG0SApLwSy6PS+ogAlTpGAagLOFTf/iNjz9zzaRCiQPV4klUIM0gwoixVgkLk1loOcQaiwCb1jhFyk6NEeAwqpNKQvQALPp+OzdD9x3yOmumwmFzGwUeHC0/VsnWRFg4wYormp6ZUwlpe2C99wlp/7W9Ytj5970mmmoBQOqkWAzjugE6VgIlhamzTgZykIkPuCx4Qopjo4md295qotF6wAL/kFAuUwQOdN1yiZscK99w6+u/PK3j6RiseSkDZqYYUG1MO6N090L2apDIbEsrJyLbMuCiErZMrOq9i4ujk2ligO2Axv90YUqNVmdYzmBKS+KlCHQwSFU7Amey34PoAVqOoSnPvvwS1/ev+rhw3umPcF6wKSsBbFaxF4NL0GsLzaEjGfVYl40yTdMsz4W/dQEJZKeaRGG4y2jR7T3/PUPPnfyD3/eS2DsGxF4/zJgZjU1YhEB8302khezI3BkINAQWGycKlJM9cxpgidjUjEAZKYEM+Mlhp/IlMAgI80Gm1nQO4c05ixST8ysHA0GAQFsrpm1jKAaF707RvXhnm0vQjtq/PC9b9784Ds2bXr1VccBVVXPu76SMbOaCRFRMzUDw4jIA6YEoE3StqnXc2bYMWTExwWE065q5k69vJPEgmKXW7DBzGKMZaCoMijdv33Rs5/7nHeEEp6Pxmb9Azed+tAttx85dij4/ZFt6Yxmu3SdzFT/T3SX9iiFAgD53NpZiuaWr75pHbMpItf9CtqA/MVC6z9uWbD7bpIDsJGJaZrR2DXnEhc//Ft/+Fv/9suiKTS6PdbKAA8TcF7TRMgDDNPzZNN7j+3CGPCAFU7A3mXt270X4sJ5mUww1qIimxg3EILzgOxONOkTJ4ctC5lGuhSBcfetxufeMAHgApoIIBTgCyXZhD44tYCXvKsQvvdGnxjZxWbZbdnjegIozedsduUuKr/95b+L0VV7rlir59CMfFPMygFGfahXtZYC8SnTc75ZoFmwm2mKxaFD25uje9Hzln2HnTDMn7QarxIbyDnQoLz8Cc8486Y/r8EzbYgf+Itpceiy8uQbf//XPusZnzsUtR5XKZhvdtcwnPcmQkYI9PDffuseC+spnI0nv+9rpKYewYkCAkqwcLELNAweKBFQYe2eW//4F3/hyQcObM0emM63tbjuwCA2izNlJT1X0kY9FxseHmzqyrToTRkT76OjWPBVnvSeD8vo+L5c5/ngTF/7sKPx8NG1n37i2tvftP2KX2o/8Jb+6NBCohVUMHNbA9o4TAp1Wmq2/CY2lwhqUKY4argp4JMuvB/E9Le/9F9f8N8/e8oY8qdZAM5LQOoC3tKe5uJXaAMRzBn34yxt3NVr5m2sS0jLgfI6oVlECqBOq4KIQGykqkpLeyo46dZVIhg7C82sZYBWIoyNyMxDfIzRw5GhLTbj7HApWzMqjsT5yZd875WT6eJhPBz2YtwwFlUFiUId1IiXfrFAvc4Kcsbs+4SsH6mpadq26vWM4JiKe6Gh2MiyyHhnYkLLB99sKeADMRWYAGKmAmVTztojkK4fTOoBdkQqyS47jGsuv+zc1qk4Z1Qbg/KqV77y1d/9fd+kaZ9iFXXE5Vw7V01JreT9DITLXZuDIWQQrNl2wC/9yT8AA/TKBXmktvP9tF39Rvo/jr7IZlOWLafMDNpKcZgXdwC915xuZtOmP6ouYAPFeablGjVHYQ+AlXWZnt4naG1XweBLaRtXAPAutlSGvT3OWpDH7DTG4MIU6qZFLFqyHQyBdTyi8/r1e56pCXZpQUpXUDzv1AuTbmUwc1aKEzNCMvIAFOIat/eJFqmEq2ugENSGxEoGY7sf1oHNk+6ZqZMAHITgCTXK7/+j9901PJIds6EGh+X+YBl/p4vN/tGUehz9pZuzL7/xxPNuxBA4hssVGAJk1y8IPeB24Gm/9s7tuLJEE6G772owo/NR+JPSYEm52+SjVxt/wdeuv/p3Uq/vPPaqBYQmTMtzx29+x+SuD84ufdQgKZynVOb7wzsPp/OAQbUdXPaAn9OgHB3GuehL41Jhhsah9da/SGdbAXN2vJASbnLqF3/isaPyzjtOjw6MH7iudQhxtlG6eh2uOnzdI577PDz96Tjav7Q+hp4HKbiGejDh7B23feuXj21/kssCbOxtjuBQl0N56ueNn/AZ43fetP6HPxNv/RhvbZZDbATMg3NSlMl5iwYWhhAJe2eJoaxaxd681NJ04UJvNrlq85a3vOynH//t3/9pB8JSUyKOLQS2hO10yJ2LGgYmTkY8aO9BfQ5xniw5GBlDGAoTgjpLDAkQh2UBjYVIHSmxcEdGsO7QxjgV7UTaTWElUoKymYOypQ7xWLTjRVEzWrPR4fbcVfOTC0uDK+skczXxHMyyAW4yQtcPNQFR1W7AxFkCuapzGnZJLSYTsBKMyPklBLRLg3mvhHjpjAQYd/AxI+2qLRCYGAEdP9gUMUZRwHGaN8/9gifXWzW0IfCRwyf+4HfeVAS/byAsgGkJus1exar7u0a5bgfmQeyQCAJ2HwNunvQLZh88uCRpM9gYat3SuVRcefA9LRhMl58mlIOxL7SeJ5PC/ObBq/7sH24nxPbC208D4EogaC1UwDJrk+7VZdwJwND1GUMXcWn3ZPcD5N33QVU7i2xh68ELmAMC6Hy43UEdf5x9Ly21c7FjM6HnE6rzJ2HdltCsASHlxnaEcrrQ5Wwg5SwBToVRJALZvXNr7JhwX2j9IQixRwPTU8Ar3nI7ZKzS7JzXfVrJm+4xaNNnjO56zZcfv/Ubr/uZx+Jp2tyIxTHEQ8BKxDjiIDCeT48A2/chm+584LLWTJ+0GJyNlRVNYuCyG/u90O+tJtlTY83qzXvm9qjD/Q//6PfPAKg3Sq2/z+mxmIpZMiugD3gAhyE9JxQMgLYOc0/Twl18wCABnMEcY3524+9eXc9PXXJkz7S1TB8RM1zxWTf+3Gsv/4U/PvvCFy0ufTzoEQirjRuC+y0OCB/YxBqsWq3r/brOCxy0VHJQ+JoRHcpZuLx+8rMP/Kc3XPWbf3fFf/ttf8MNpTZH5vVK2zpDoRo0ldIEi2yaNYLZUAc4U8orQtMeGW03b3/j1sbs0y4AE3kFmtgWRUGMLIjnQBerRSwM9a0Qj+hMz80WZ+9BGQBm6w4HBwWZM4EmosiWDEKkzMImbAIWpxGW8kEOgaLjNqB2zZaylEgMQDT6wueQV80P1GHeegvaltuzJkW6llYvqXJtO7YqYqFwICHqMghmFtiQFz5HVi7LGJnZlMRcnXK5HGqpLJ2kDiVuZqoq2QneOqEMVc0bbzNLpqpqnNP6ziLJzDq1dTOxzPjKmGgSmIgEq7/iBQ+nxFE2gzuwtX3ay+FTJ09f7PXf6+ClT4MDFc4BaNt9NSoH51Ci55MwWqD3Y6/4e6N+WqQ0mwJCJkiqmqAG6TRHO/HRT1yYq+t05kO77EdzmR+mCk2oJWAOP9Zmrly+5I0fgOLj9QJV4HvAI04cAnsQyDEs13Tud3pF//f+5mbAMRCgGU96AZpTpQCN/+zmBUQBB4qJ7TxKeelruQPx+8TLVhoTJHXqrSbLemyeoPmK2JRKVOOOmKsPIFC1K5almfFbbz4NWOLcWJDzLYzuUic00WNvSBtgnGoI2gWgb9xAlBW3bfDa3eidY/ngwN/1FSfa17/wkZ97eCtgKhSVXefUgIjQtAVmSChm5/dD+aarwYxBZAY1VWUfbJ+bHPcqOQY4BzA8wnjl4Z8R4PzepC/r+6N88O528ti77rzjVS+fF6Do77nXU5P/40GeXHFv4c7zRx+AphKN0VzZDOzVD9qLXv8pgZCSoIbg917pe9Pp0OrZfK/3H9o8Uj7z647/zCu3jz95IONDLXqG2gHlImEGzAOaTIxGL1pvvo+BLXq0Aa0rCrgq8UARACu2pRo2133+of/4mqt//cMnvv9llzzqxl46c64WMPUDYTENqmSU3ZG2S1TRC6EQhFCeonsOn7mjPXvq0y8DzhtpXZp9krEp7XTOP+EDQHDC5N327d4mWNQL7dRXMq8XStQdTJo9S9iiWWJNRsly3GVxlAjKJjChthZK3kk5O2s68x5BYgtIb1S2qSH2DLD0EpHjjUH/wLm+HXw8NdvJDCas4k2ZGcSi1MGpc8G8itsU2DGZQ8Upg1HVKOpST5aU3bL4bIZlwrZcOc7Xopfl6I5wJLBOEVqhO2VnmHaN4Y4fnMU6enDHD+Haa05UZdEuElBbKn/jJb9zsdd/r4Pzn1ki3+CcSyL7OH8EAVC3CyNbw28Af/KuW8GmWgAKmag6qMISVLvVU/ReK/JFFZ/vdchyRRaYIQKoIc60Qbt486n0obtb2lvXU5bV7BGaZ33m40EFVGK990659a+86TR8RZkaitIDuEBuKTjrh6/+21t7ToCSjTTo7izQdqlGXSB62L2jrwPGgz7A0ISsqi5ZaX+5pyFzSafV4GNzI7AAYBR7+0Ix/KbH+89soUGEJRA0Qs0EUDNRaEKKkCY1835xoVKngiDR2P/yq94KcodSiySQ5X1X292rPjJ91//4/KsPTzbWsXISQ5eCi17QQINHELimC3/9lFvMuwO5qKpa5jOqZc7ffRa3/WzUqcu8MXiUX/9vzp49K82e11OsJ25RtD5ps/GSn7rjHa9DQh+zXWar9+oDSWeTcN/DoKCorhFOCnhxo4YPPYh4x8wqyaPC4iOvfpX0ixkFtT0L2W+4/Korv/V7REbjBtAGxTmh7QpqKEsMUI8pDXzEEEA7Smm0X9d5oJptqYsEJE0+iYsuNS28Mymjgqyp+vEJn9f7/t868Vt3PO7f/ud42XUfObd5YHXFmToFQEIsLGzOCIQELrcqd5z05r99/addAF76lphzblm0JHfxjnglUeWsALmtuzHfdlFVCS2TSedIYLZ8ks2MLBkEKqzJNJkkMoEmo5YpOUoMYQhi3ULYGYdmZbEh2hhIjZv+qCCHqDIvp1WCM4aF9XT24OMGTbt50I1NoEIqToWZOV8wIjJiECU4L7OuCc0ooMysqgJrowi6QikzBKY7SEsju2CoMDMV7DCYk6mYiua/Q2cS3BWos1SWSbSoeN4LPmsxI7GpZ98L/rWv+pv9K0GbW1oamxkzi8g+LkzLFSgRoCIWYwP8xa2YuFGxOAcUEOG0BcsegsvwILtSIr3IAHyvGCzdp5lAFaIUU6TATSumqBdp5cjP/e7bHSYXOn/KZmiLf/oYoGmgDS4UYfy7cOCmM1uUO3R5mee9S3A+/VmD25sB6rOggrSASzC9Vw2CPqGNcvc+g4M64OpLL+WUoDnuKjR1mWVOi731kta98evedwuMEzwc/IU8+oqbgE3xYyrBpGykAkmkBskNlS6us7UXyKTZOIDhw6bhfTfdBZaFnwDVsl+r53NfM5g959jDDxjQdwMsLhVgDhgiBlB1rTppRmhWEpCqOVBNz+3KoW13D9iSqKp90mTOjTr+CwBzwHWfefSyY6Ho73k1I29XcaDtvIhXhtn7f/z7z93ylkMqssx5ljE4r03sEB/waLFcu4wNToiFVemivRaFQdEiQPWkTRsuVivtmq/2vFxP+2ffDCYJulXqPKSE0jBM4CbPeUbtkQIKRJy5Tat9u+zCXLTsG4UX8+LNGG7Dl6X0WypngWtPhfMcDf1eHAV89pc/7Ef++40v+Orbzm7AGFlCgtO4bReuIIOwOKsqOlCynfzAWz/tAnBWgRaRHJ8cHuRC7xK8Ja/AdB2LeWHE6pEIOfQCtHzRRWKD5k1rp7yhJkDX6O0YtaaUkuZ4Fmhltp3aRWOSDNEF4sBR0qxc9HTiUxA5dNXjDvijG0M7KBvrKrlbTKoZgtS5pMlSNhIad5Y2Z0pwOYFV1cysWj7MvFyp7fwis8dzvsxmuuLzvQLz8rsvzYOXLsKJz57dfvYXXVvPCrjpfLutZ+txyvsVgF32tgIRkSmYeX+9CPX8Lg5ERKGMwI/90q/DV1XaRgv2vpT5+VrIztK5s3ruRlRdDHihi76Wb073mYW0oLIf5yCGqBX+j992h9ubfmBQdGTeeACAL0O/orAnyDH0BluHLv9vv/PKFglIibJT4J6fn8h+8k/fHd2ocgnknDqwBFXcn1dLF7H/YOD40UsQlynvzmHLmrqTvi+U3Ste83oYDCQE2N6ZuobX/P0ZcJG2Fp01U46UHZDBoOIdwZEnvYDDMiV4MEI5EcgmoIvtXoQb3vfWL2PwFz2shGvgklMHRjtezIrZIGLmAc/mfN7aSBneHVGn5t51bKP7fOwnbQgEBIE3ICKddisnvurL2O0NhrUUUrk5nK3IJA0Hj8f093/gGz/27o/qHnxqQfmABwCoCyk4dQpfe94udX1w0YinORTmEoDJZN4XN+XhrITbcz70PuOp4HEfTOAeBr4e+sgt4OG9ZcgABNHZDLd8sL+PgBJr6iJtlL5GIC1hgYA1xOS0sDhIbWWxRWrKfoMQrPxYGKJ3SfX8r+4dOZ6YjRSUhGWttrl3bEgukYaxDusU5+t37WNLYp9KK5YA73yZUls6Qico4d1FuvFoMZnwwSvbjxT64enZLfaTtemButewUWa/AOAMJM4XupNzY4BIeWdeqjdOBFAw0ggvQYDodDzfbgej+s4zuPJwQatU3X3s6sWGv/KYNcTDplkU5Qys5aRsSVGUaL2DmhGMHJctUufW5iCRm962j6NCJ3MaDRRNAfWcMGMrY/ItYk2hQYFgBrb72pwpE0kyWAaKYunHwrBCsvAEkwAGNoMZq5Fx3mlkmY5cBSCB1X54aLRZOBwtB3P0dVSEpvHzwbvf9qHPeOIR5wfeF63UoMgyXOIxL2bhIO/MuHODJyixLxYJQ79/E1G3az5YCTacX8Pd57aO3UQnsN1s85DorM7dIhwAJmAP8CASRjJzfcxmP/KVj6k9NgJK2ZsAu0dYOh6nH5ThS/70bmze4qu1Qtq5G5GcFTW07TR4SgtDlRZxvkovefPkX37mysRXI7unoSNz8FqagXxyZaliPJgAY8/XAI85PrplW+Nsjn4J1U7gghxgsBjQRiV4+99yzVPffOvXPOGw9e6YuUs4HfC2Dh6BgiQ4RlwgDGGEb/5guPVuQe/MhhvAtlpXoZHo2k6nybqaEJmYsolcEOnWOPMJXgglFt/9jMN//NYjyK66GQ4tuXWdCGpNOF0yYv/9B57ww7/72h/40qdhMa1Hq8FOO6qAYAhzgME9MBJ+coLffetdnobzlQGaBWSqBNDCqIK2TuuEUluskj7siuPQBfagdVHY2NS1Q1oc8qmteDTfnqTDoLOgEsbEBSRzdh0cYG7uZ5iUoHI6RARG1isoIcw8SiOOKAXW0lyp/xu/9W6MD6NZwAwpQRQqSAmSkMQ3KbVtqhe5sp07127/AoPXMHdaQii6wvkhb+FzvqJ47d/LmTvc+sY8LKpAEX7my5XGSkmzwKUCOpw5YNYsiD43uNkPPefNX/dzz3z2s1D1O3wmgxyiaZkAM0K+LLCACNTaOi5g6Yw/eHR+0gpbuIUhmF50yXekPlWyloCVqjfjNBy4xA3XTh44eha5/uF8QeetpRzgNdTc+NJWaiBGhOmbXvu/Hz0PGz5e5IZmEVFWiUHYcqiQygTzTMSG5NEGFCLsDPAAq9cAYjgAqbRss0oKXD7B5mi0evgyCqGwWYORITS+aahf2MJp2ZftaVW02mvCuUPV8U+7ALyTfjDzLn6IXqxqmmevBsgcURezeQUqCDkCkgKZ6QtQ1k/Pjmq23MwDvNMGUyiMzcQ4i18RsaotioGZEXrDc3dN1g4WTcs89BYltkrqHKHL43NHWk0FUDI27bgZREbEgDoYmWV5wsxHVkDVzLrerSADhYk97XR2c+/WDKqaOzO7unO0bPzs5gHDLPfmOh6wGpmp5cozWFVN2YC6basenviER/7l35/MaBcze+n//PWXPf0/JaHYAL4jOJLp/wHIxDpDxX3NExwAdpXBHEoocOglr3432iwiCFMCEZSQDB6An1UBcR0sX3Pk7n9/1XUAIHfDCrjVC+XY9xsbNF4H/mfcLA4fXswmyQ3QbpkF1RqWIC2lZGJw5Vz9L/3G7/3Lf/J9fQAUDCgBUIFOStkRtA8WWqug3/sV13/1T70dZYRwLheYsGUnFQoJYZgm9dbBs+MnfNc/3NQ/tvaCEyuhPisrh7dRtfAEDIqZw4aN/Blc8rp3nP39N90W1lYXkmP5vTqgpEsJkfu3eR+wuJu7hgQHhbRXH+6hPofSZclHpLxX8FBn3g1nvCjWpaS7e+OfPZk++se3/fTzH32g2Zy7I0Wmo6R2QDaLbd3rv/fOu/7H605uwiVHSAkpkYqlLLHTINWNOo5TVT+ZT775i28EX4CEWlQMgB0EkmZuCEtY1LlXbilmA+bO0E/l9X/5zq/9lhthGyuQkFbQBJS+9SgbZ2VTYF4kt+XHP3bbxp9N65XU2ypm50vuuaAtCk22kwF/kmy+DA4qUEfBAMEAtHL5t33fzd/5eYtDl44W/blte5a1Jm6UYaXxu+etmYUQzMw5d83/+32/96c/cfm3fe9VT/yyQrCSADTO13WRHbjEVDrIZFZnlBY0sSCRzIPLxGRWispFyhq3nAr1ycO3ykhgNaA1v5c535+/6XVf/OX/IhlMkBxiuSB4h5C4raScO5ypcKxo13/uly6540P39DfLuHKR64bPuAQYSqjP4iRADa6aUHmF4yiRq7ANi6BxphN0D4IRdY4ucYQCU9x28/yuU6OBJ6R+QiXlvLBSZBrQ08KpRtkMRr0rr/z06wETqSqjE6RlUDYSvWg5aGVWoF1HVBIFvEHIKJeazTp+kSq6svOSa7TDxtgtpqzLsXOem2RQKrVUdxnPNubqFkaUanbqGcTWtq1JBl6xis+lM1WcF8HoAr96CBlAXpk91BOIvJhmMEc0E5AAsbNY0KTdtkBVZamwce9tf5fMqKqaKUzNNHsDL3+75uK2QnZeg8S0jim2ksRe+MJnkxpMVKEq73z7e4hCXpazuw2DiO3iZbo7XDYvEeA4X13fjwqKokEJSQ3Qx9Y5C7/7DzeD0S2OSaDSYXCSQCImcywIm/N//bznJPTuQC+6I5v+sjkNH/BY0HjnmO861gTX2OLrH3/lYqOhdgEtfDtBYlVCioitpQQVzOYLcadk+OFNuHYTGJJZHwCHfNcSGBBvsQYXiM9YQXlgpagqiLGYMzgV7krl3rgUHpVNm9r5uUuu+opXvuMHXvXhdTvSoh0v3KFGDraxaoF29ezi6He++paveeudMlrZrqMPfZDPmDiYgBRLVAR0ieiG8gV3T5INzA0EgbMKePINl3BsIC1iRIoutUgJCoibkfOyKOoZYm+r94jfvLP6gp/9g5e++6aKoqMGNCWtkcq72/63v+HkZ77mtruSn4USEFgNaXxUFxUtKC58nEMdJEHQ1/oFj167gE6qohgARsSwK48dVhpTmqNpIQkiSIIkXewUheqfTI+/5SyAUQDDk/XQ5o1aGSlNEBU8fvk7t3/m998bB0e2yg2khCSI+YiWJ1US+ySXoCGgXMF3SgSBT8URnLjh+m/8ts3pRh3XD4eVSL15wFoTt8p7bQKqqqrrOvdopufOfdb2xP3gi9759Y/7wG99z213/nnjBVip0d9GtYVixr2Gq9ZKpAHagf7DG+54+c/7OHVV0bJTsFP4i28jCRSCOQDv4Ni1E/gIrfZ6f/yDX8HJd9Yk7FBiu8JmiYU3kLjaQYFj1nzst37plr/4X/0wCUku+nqmwJ2LiVaAMwZDgOHsrtd819f9+a/88B31e5pqG9Degg5tFYUuCpMSKMClcWkoRIp2Bmz3z777fb/0M8fKkSCIi8otrKy9lprqYKp9VkG70QqufsrTPv1K0Lu0eNjAZArOhNmLC+RKDuD2DJS8EaVCYqvM1JkBZE/fLDOd+ZOdzrt2pmJdApAjBM53SZcPNtU2bxMfGr7wF+cvfV7qrQ5sGlFkh2AIArscsDtXcyLL9rz3CpSkBGcKMeGSKHgkjwByYpaIUkbQgSMgoFZ3pq+pmYEVZllDnJZq77sefF2Gto7m2pGRcovSKWXfNZIuGzYz8sH3+2NoetrTAmedDzUznW3L1rltVzLTkDPulTom80XuNImInJESddd/f9cpAqEERYUH7G1nceeGgGYoHURBAV3yt7wDK3MTXCd3P+FAg0aPlwMX0yoUu5347OOXo+cu9m37Xz796Mv+etRvJ7PUhDYll2AEaUkiq4kIQMX4YKTRj77sD1/2nU83lAUBumi5V4AZaPOzZOQJUBuSfMNTT/zqX74fLiiRwjkYWZMhAjBeOKbBfCBNve3lkut/ZCH//SWvfUKVnv4ZV1+2uhrIv/Pk2dfefupDsY/BiRLjBaZUlqluQtm31GYtl+UU0R0cGWc1V7ULttsdCJQF4VIaenzPP3vCl/27j4EDjCEAq0utOAaTBddYwSYuteK2Y4ofOfio7/ybj/6nv3vjWhOrej7zdno8PssHvF1aTB6+GJ4DHExQ1wwxUTOGESVQSjBWG0BnNx6lgwfGF8jWxUJANAQ2euZjrn/p62/30iRyJtrtdpQ7KWwAxhvl4e/4uf/1hy/68qOr7MPccSgMME08iDh0O+NFr3//n9wSq+oRcu4Memehax1AWASipGIiEDH7pBsdGJxBQYrEPY+JYFQM/Ze9+MnvvPnsR998ZuvUmC/Z7s8bvxgk3b1E13Xd7/fn87n3PoSw4epFVR+vNwb/+49mr3j136yunR73Q3VwZXV1uLYCtdn6eru5IdMJt3Elnjvg5BBsXtfS60VGciop548XtQ4YBD4AXIZDx0YfXb+nVxeLYq9I8vB69ts/+OLn/9zL28EJw9hjTAZWOGNnc5z+2Ad//D8uPvK2YqXZkuLgZm9+sT73CgUStHIGceCsvAbc9eprPvhXKyf//oNv+X3R1frIlce+9Lk3PPGpPT6a4BJYACOq8n7W+NQf/doHfuu/3dDMPRVT58UtjJC0ADWAeVVYn107lHY9DK599OM+DUvQrJp24lPWpucHY0frCrSLzdtG23OKouwAZek0iIwdoMRslL1+u0Ko5tfZlj3PcsmYKSMlta5+SUTe6jXX3nrgxtmBZ1z6OV93+m9eYZVBo/rdEGUi6+Q0jTTrx5ORihARsSVLzrFJS6CWSjbn0QTyxMWimRs4wsS5BhaBVq2VLJ2RU/iuRK8EIza1/AtyVTp3hj2RkclSgkNgyHaEubhtJFBbpsVqpEATY1MnUyl9sDZZYiLnA5wMAV+WjvPmuzPKOG9k/4nOc8rOf0Yw8yyaCu9jjAj70yATQqGdchSw+u9+7a94cFhl1pnVmCDtEGoBBc4OEHrf8JmHIT0EGJrtMB4gXkCj6YE30LCaVh4G9Ao3S31OpxcUEOcQxxJJkuQKF6Nt25bc69774YUUBeCWcDyc960jsC8lGVcO+n2f2Xvtu8YfnUxQjDCd4dCqtVusIt0UbS3wjEbDBo0hBn/u+A2vX/BffXBSh00LAEpU1yEwEDHYRhqYAhysTWYmtASBm7KxqOaGiYkgM9X33nt0bOZsku1Kl/RJa3zp2spds4VFB1dIVM+JUBsMyeBZA4Nn4AUqd246QPHYO4K/o5eQ57gKoqjMYn8Bq9DUkIYkqpkaIAlimqBRyKJhFDbf93M/8M0T9EY626sKvUMRduBvetaxl77qHVQmi4SUYLwEchucRzAwo3DvPHHtjS9/7WNH8m3PfMoNJVZG47vNXv+eD73pw3f83aZsVZfBHa5jDU5hQVFbmCFGJCEVtBFtgkQTgvec+JMVfhnZGwswIJXGzrFAWY71/sN/OfLD/6Y5+9ez8vS4Hc1C4HZK4bzClPc+pZQ9ceuDIYhdYqvcsAGjcnZotv4Zkzj3ZbqDhKCMg2beUiHq1WrXp6hG5spSwM5AhgfRhyoAlOgLkquu+oZvu+d7vn27t31JPCJ7RPJVrp968o53f/XzJzc8/oZ/9g3l+NAK+9nW+rv+5s/lA29fu/uWcdp0PqZF6Sy0FV8sNgWUcbBSgkmpdYiIvdi84zVvPDqsNG32RQ61m+H2e7Z+7u13a3FLb6i+TFSK854dt02fkmubSuQxzaLU+WZJQlwmNqAl7SW0TOM2mfFC01p56EMHru8NVj4NA3DXZ2XOjllgU6Ul+P0Tn5/kCmtcOovNGauZFQZddnzP6wURWUfu78ToDQSjHC6z5EUWxCSz89kCoF6wFb3/3H/ReuCJ39l/85+gLHm2aeaBLKFpOdqzAWA1zvQS63Seu7wjwUowwbdWBHZQy+qUbdKkSAZl1wItEA1tUjFNagpKuatslD0XljDp8/oJuYUsXQk6VxZpWbLeHXRNjcRyaKdkqsJF4MEAg7Kaa6TETTMFyne8/T2f/bk3JgH7LAGIzsf64rbtxlmRGp3nHee4uG+VOXUta8UeuAf87g/fBRqDlz19NXAuNhIcyMzauzGff8vnfXHGDXmdgQ+4FJJfXFS3ZRx9TcWqj1/5eVf92mu3tdkGVhATDEgNRGEBRM4aI1YqzxXjV/7tzS/87Mc6p+BlidAQsnA/4GwaadWBr8T0RV983Xe99E2mCStHZWuCnnPWkpEZk/TMAOOafUiMqcbQaFgsaIBYhqn3aNTNGp/gCmAMExicwiBCCksQJTEzNVHAIGq5JJsJzReAm/POpSiSRk82Bl76I8981tf9Mg5fDTGQQSORGgOlQgzGcAV8AThYdJqEJ75xvVg4pZZsUaj4Bl4wXWMVTo2qdLxxEUhDQoaKmi1f0D9/2rWfccRvdbd1rwmhrQsFIiw8ssRVl1enN5t2xogR4pc8Adtp51WxVxcr6+7St8T0ltedLONELEx7Q25mGFxmBfVnqji98A1ckdo1yJTMLAlStJhIlrSrT7bDlwMDBTyQ0zDxAIEZsjm8fvW7X37Vf/0Xd374L6a17+Fg6/ZEJA0Xq0w10VR8Ex3mFDaoJxgfqBsBFCyAMpKFSNm0oMmZJ8BB4VWdgi4AQ7/ADqIjK5S44Z/QsWsrvbUIbrHHJ314NLkiyPX12e0Pnjv7g3/rY1i3bS23q/LYgXbKcbLwhWE8bAqixayaOOld7PXs7GlBTikChIbrKf7q3QcEW0ARTWEM6alwO7+OP2apEDgFMXMwc5JI20aPFZqmBU9KHTQ8aMvEGmghxMkXhYghbpCd2+TH/uvvgsmDcer8pPaAkZFSHWXFiOzBMWA8cxWM4mazsY2kqgxJJjkoacY1kRIk8wCpozcIdWZ+orZjpZv/2MVWNULleucu//zeY54y3G4/otcPH/d1Z8/OiQjqdtQrdxGOZRnz7qtxL8TOOYAjKvNwZGYSFSnlGhnBuQhLQAJak2UHV81MNKs6k+wKuudhbOcTceukNLHsB8NEVTR/DuUPyfQqZlYhIopx8pTHPzG1MaVEhOCGf/2Xf+2d85zpYY4ID0IiNP/IDrvsvPXsviUGljFijPQjrzoN64FrzqXS5fRCirn/Z0m8P/z5lw0OBSfeJQbY8n7JW2+Po3zAA6CSgTb+2xuBLPXQ1oglkpCIGQEV4L1FrxGkTX/15/74bcErIHN4t2xNkLEAzhI45LqhtvIVl+IrP/MRbnIG2xsYrkK8qjf10MKsci15icm1i8Bs3EuxlGnVzOC343h7MVo0QatYhLqHur80HBEhBVLGYfnYyWfmVLjrkWdu9N4BuOvTGAReXQ+KAZrPYPzgN30xzn0UEhFFoloSxARpEa1YOD8jZMCqTM02R1uDlPqTKmxWfk7OLQiLgMZDGku1SWtJIIZIqFs0tW8nEHIuXNPe+tPf+hymdqTS8mDvHV8zW2L1VzT9h2945mxR+/4ISZEiYkIbkc+wbRHbujgDusfFs262XcNPwloZV9bWnTYj3SIyzMrJoprAWj9taZ6QxNqE2CIlxGQpdk30T/JIlDzgFTAPDiAGnIObuXZ1ga3DR913//gl1zxjPdhpbI9ttHfrc2teNNuF2w79FkMvvUHLK02KPqpLoORMnSkBQpyYDRzZJfYG9qpeE0hbvugELIEgaH1yKFN56OgXvWAsYUP35Mdfvr4a5+OJWyXzo3pW2tai15zq6VXzdUuLuuhBywqu9c3CNfwgzNUIBbQEO/NZoa1Ci5N3jNzsnmJzOrRA3qRIVjF6UgygR0kOeBn1sOJjX2O/aUfzdq0Ns5aKhnuAFKqCsuXC0cyInZTzInlrmiq0D3v8+ImfD273b93b5ww4u7Z3gsEPgg0MwEE1zprZnNRM2SBL5QreZQdEpHYvOqwu1S2Uzv+90q7vqAC0Tv4zvzmiPlxNUg+48eusrn1R7PzIzsdmeMsS6mU7RGQgt0GNQTA2eHgYm6pGQRLrPoBJTMWQVJKcP1G1XE9eNqfpPDi106Rd6mHl4vN9KL9LKzkS69LP7poAHAqTxNw89bOeoklSSmamCTe97wPMXFVY3g7sukcXFYOXct3LRsN+JgZqrQcnPr1196/86VsP9sdwtbNsiq7ndQe7AKMJk699+nFgIp22cTkEED0o7XHoAx7zIC0DLlzdmpumXl0MFgtI2ckHGWfWkzNxiDA1kfevt/OtjYwXc1mSYimpDJsn7gFwOkvFyiXt4l9//iVPue6El4StKdSZhqzOG2xdGMn14RTl3U3v5CL4BlfV7kBo/XDShjkDB+reOBaLkj9Kpq4DPEuHF1iKWpyfG/eH9T1QBOZdLXLN+O3YHIV+0zOOf86THo04h0RTNQOU3dzQhhZVcgTahq5zbKktJ4MN2DmencHiDGgjFTWS9rYcLJpF1WSqiIRkHFPVRF9PAMTt+at++l+NbQqF19PxAmYelnWfBQDS9tOvxMMf8+ik3G0vJEEUSbsXov50DzP1cYp2glmrjZ6jZqParGSK5pzaFDFhy/wUKS10LXYYrjydOgFOZfoUeO02sJTvYQtuEATewIzBpDdbSS1WH1X+51/+rC983uF6e93tuT43Dl54XBcHZuWoCV7grA1W5+XPq5aivYgyIQi8oEyujN6Lc8oAEmMasFU9iLNnJEwhpNh0FZ73JYeLEa3sKTgTsTUf4BTrjGNTLupyOm740XevbbCvtc9xyElBZ8WdUw9fXvLgMr8izxRFgnFcbL/2TxH9tCqngjGVPTbQttCpRXUyWW22IJubbBe+ARbCtXDbhKjkvIQqwZnOfLFZuXnRtA5e3LQwZ23j6HO++99FxtwWn3YBOAFEVDh1pp0tDDkm8+iOLOPwcQ8zIH10sOjFeWycVC1FY0vOJU+JnDpvnhKZwMxBkB8hSsyRKXqIN2WYKyWR9D214qNPtYhs0mBlfnrjhmcfuP5zfRq/v1gZzDHrXXbwikeJGavLB8xZ5z2U68/RzEi8CosIO80KH8OU6qLkStOhpxyeY8GFeWsLNK5NaZVdQxVvUzWlpK5IU2thKYscGpkoBCzkzWXNEDbswC8NnElCpICxGimcmlNzCp92SVSqWTZNSmSS2oXOFzRqbfWpn7U2QGlNE420mN/+YYjWzQLMbecjRZQbup/44Y0IzigwXAUpLUETcdi33Rt8wBQ2e8v0ROwPJ/Xcm0U3BA1goSt7cQAKaIC4E2ff+flPuhFWBRMDA6VD05S5q/KAxx4audY0gLnQK9LPf8NnLvT4jA4HOwkT4VKZYVOgmfvxwo1hAnXt+FEv/sObwfWabtcoBQxuQCgB8NiDKwA8KAAUvadg8Qvf8JjHXX4Y7TmEOWSKWPs4i8ygGrLNbaKmj7QCAG4bIUZ2Zr0ylly37Bht2xQDHhz39cee9dRLiA4d2FAowdekhhSFEiSVrRKIW0Et7QXEEz17dCqUfaDKRdEwRjMbA7/4HU957o1XFVMe0xFsbqK9RUQgE8Sz3Gxhrlj0NHmxhEUBKdX6sCHaPhqPZAtEpAU1KdRWNoshZpifKZyrW6bq6LGt9//FDz77qgqgyngIf2xwAUEPHy6BGoagJCgvAX732x/91MML+AjvkRzE0E5dM0VcQChVAkGjmJGhXWA2oWZOc6vnYeSo2robzQJSIPIj2o23/T9PdE1DdYs2oomQrH3jNVeG3RDQBNeCCWjgH0ylds+e3wDks9tXAZRL583KMEqDvCAndwxf85NX/YffOH702lLgxMwsGlo1M0lp22HLKwujDloHaZ0occvFwpWsLjfiImt0SThlPrdyZFoUVntrFawoi1SO62B1D/BB66KtttxsHLdbHSzm23ud/yCy9TBGaBkFkIbHVn74JSvhxFYpieEjygWq6LyyVxSqFfVWF3ZYtFBjKh0GixDuWUWNc4eKta1UlM6fKmW8NVy/5glX/8xLjOMDHpFLx5tMtSIi9QjbDoLERnfXnDIkIxIYhCS3vPsPQG3ZaJ+qxmjOWAQXQwUdsIvKkpga4ploYnIeocChWUmQUmTYlEVVkZ0Zx3UIglup013Hmu3TB8tnvOiX28s/s3Hot8NPxx4wE+34eZMBhHuDhz+h8g4Rm0VIWoJKADUIlBSAmLFl+m3XD+7QGETLfrwJKUxTKDzftY2r+00LOsU8XG3sI8eecPlzfmi9nK810rPEslYPcPBpX3/qt35osKJ78atyaNQMsV5azSizSQRk5bJrCo/KBVtsbLY9Nk4poSR4J0ALM7EmpoxYFs2xs2MyWVbqz8UDWzaDc7nVLd+Qi8w5A4Tt/NnpRZ/X86GuTqB69dXDtm3JcVGElpo2CYDCw0w/nlfdJ7Jl6/BuZKD9801tGR5VU/hf+H//DOpBbRAkXgDRWSJI7le5QNY0wewpj7wiZOKW7aCLHpw54lKFyNIXPiJ8x+n3oT9mWefegb0wH0LpT//y7Yuv/6we6kwz62V26h5f7Eaffvlrr/jnrz347vdM0DMsPuKHRYoHc+Va80zO/npiXmthnRUZM1dga50ohcUi3v1X/+mfPumpjx3+8Z9/ZLuwMKdE1HhCKzCCqImaCYk+SBaNH41tfi3FX/znN/z0pUf/2//6Wxy4BDJGMjiFa9UJMRsccUkI2klLMYwpfwUTqGgYmGhKyqLNbAIKdQu44Qn92G//8ndcVyBYu+O45C7QSCNn4OxR7AL3oQfBv/j9z/knP/B3i/W7R94Wk1rLobgSST1vOefAJI7Ee8vWXcxgB9qeNCXaNUdOFndff+XgN77z+dcKrJ3tCEFnxkSu7BSyWHDR14nHAigBEwRgH6U49gQhepcAS4QpUIVB9ejHrP6Xn1r9vZ+9+c/eTNt1z+vCNXOiMhyVtl/gztz4ABjmjKDGAJo9tsQhroIUEHUJ1IASICDt8dqm25j6gDBqQqUWKJb9eKGIkS1ZvbEq4Ia47PoT/+Y/Hvj+r7vb2/qoqqOtmisUrdNFoVX0gDqDM/Mafe6+Gm/2V9vts9SvK7XRRnXw8V947Ce+B+vtXowmryNhEV1RBDBaBAWRRxmP+sAtUBRK4BVE3HX7kTvunJVrnsXp3JM4MGkPOoaWdbmztyClDPQxANu9iYFhXuEoanArXtgntNsfHg0uuas48qTv/wm57skQDJzOyvkA1adXAF7GwWw25sDKRiCl3aCGXXZrbLxHAEZ2MvLEbTITQyI1ULIsgijOOgNysozIycuiEYQMJkbqCka1Vac1U2GrUzxYFLIRJD7tRafCpWLrY3egdFuBcYYVxz8vbv8oxg+sJ05CagaDmublJkdhuAKpFbXh1TciifNceXxkC5I0iXgPC9QCEaxKixhVs8VvZjMvdyrLuEsGXRqi5QVUd8lNSkcp7sSfzUih0gVmFpga67LBbGYhgMjKMoDJyLUpeu+9ISmB4AClLGFwUWj/nYJJJ/RtJET7VkFhwMM+CLz53Sexdlnr2MkYzFAS8oAHEcDSpmHhZxunfuhbv3mw69wMnhDDxYPLYL5PEMBROAA84/HXvOmjbVOnjPd8gAyApnW9sUD52rfc9PwnHxswjHok63APHLBTURL0xrZ9w7OGLzrCv/mGD6A6Xi82UdwJ50AFEIz70AAJBCcUjRagCSBOS0dFir1yePRl3/z4Lz+EOwFUSHVbJYZaDEBSmEBEk8CiioAe1EOtCeQrcocRf+CfHv6nT/jif/+rb33frcq9kyp98BhubM6Do3FtPEdbdU9e3g52Io5AmkCD6kB1DMyQNvrbt33HV37Ji7/wc/rA0GogZQmTXNPYexb6LHfswJBEnC7hUT/g5h9/0vf8z3e94i0fxfhqxAnLHEYJRQoJRFBGzFGbQQ5KwwrTzRreqz/7H5/z6O99xtUSsRWg6rsTpqUYDgFAzQ5UCgpDofDOGkcPBrT4oGKwMZSgJTjCxf7liq2Vr/nV659/B/7wv971xt+Vc1uVPwCXokwMx7K+AKEF5TQxAdprH9iXtwkzpWwEybB+fmHgM1VSGR1pB267jONerWfiFf17huvHcPke+QgMQlCIrwziWKtL+NGjwW+8dvDjP1q+923VcH5Pb/1MCIN6eGS7J+SzYoOwJNImdNTjlRlNqmaVTTA+9h/+XfHEF86hfZwLe8AXJuVs5mLrUzYNK5yH+iz/6ixTRaRBQ9q4M6d19bJyfkooLKrVGiCywmIl66VGUO9evZjl/Os3AyVVFuEYNQqcp5Kdl8FQn/qcJ337j7duaAxAW9QVevt10/0+LqA563XZuh2U/9lt1sq79uZED1zVcUQeCWSeOIkjdVBiJTNWUmYyEIjJmXVWS66TaO58co2csWciq/nQgfajyqDiWB3n24967hWPeUEjC9CB9Qj2K2O1Cn3zRBQg7R4bAqLsj4J7pVjKDrFtbRgOnuA69UCuKj58B5IhkSBYKrAAIhjJ2iZpxhFb5gGf79ZRphPBABUo1DhDj4wUu1yEzToOEjobBjUTI6OuByzZtSjHZEZVVRF1k6I6R5ac8y7HeIIBjgwXKWRFYO6i8DL6gvaxDVxgioW84u/OuYOXIy4kiMgoB90l0cdDFd6zLi4/evCqIXycg5UcMSBdiH5QBk0ahYPAl8C3fM3T3vQDr8foGBbTB3zvLK4Atr562Y+96r3PfeoNHroA+rQn96kF+spS2CE7+RuPXP03j3v8F//Gh+48HYrFcXEmgeASyIA5KDkgFRVah+YwgpeiET351dce/ckvPHoAKOqZVQPM2lKp9goVV4uKmhJESVInv/agMuA2NIaBRfQZfW6eeYBu/N6nvOmj+Oc/8Ua4BEqwDQghMRl5hBia/NBjhyGgYiZgB2HoAhJDc+aLH3vkZ//Vd1yaBQilBieoZUFC6pr3fAG4NgABO1fAEsXJSqiG0F/45sc+99mP/Y6f+8MNGyiPYA1sXkwSmODYmLK9GJEBmjaS8/SkS4+9/Fuee30Rjbe3eTgGn4fP3tvA0dwI5FvqzREI6Hd8s0/6cFkuDOqhvch5bZ7TijDa0Ynia3/20i//fnzwr8697L9s3PFhKgi8TkZkntUBHlIheYDVPbAB16DtRLWMFEi6vG/Dc/OtCqd9Yddd9+iv+ko84vorx5edGhy6YKIFAZxLqL1zqNnNaRwOPvbYf34J3vi/b335T6zO11dIXZIg8dSoIdOcI7HtIHJ4u/Ac+/bUJ1/6XS8+465GKh0UtG30wOvw0XpiVRrFRalTUNWgayJ5rwIp0MK4onLOvdGTn3nlyx6Hrfc1f/wnH/yLv1hr2lJNmGs33PSeEEG6NHbbSS24EHamRVJnSdk3VMwpXPnwR1793f8JKydmbhgUZRK4uaBnrb9ItuOnpATtnEuqjpx1G0rtsqUltpCWjCGQOnNdeKPdyCA4CIzRRG0EBVNi8pwDEZNX01zgVjUiNlZRYyZ2nJU0zCwU3jmq42WVu8dpzRg14dTmkc+97nn/VdNCvasaxPpW9K4xjiWK7b5d+tTnbN/8O8453E/dSdERn9SWEn5EDFKz4P26XtEDVjxDMC+GN925XkdNhmpcNA4t0BixYDZrTCkZzCz/LECOSM2UiJYWC1CFcwBITTIOCyxqajm4ksLEWDuPh0z1oiUsx3X+SZZUkCRGjS4U6mkwKEWF8+4FZkTLGsJFLRBdebwTcNhvCF+NITxuufNDj7jmxKg92/pYtONFEN+VaFmIQlm0k81LxweefMO1PSwQQja0pQ7B5smai2aRcIDGHEmczp9wqP95Nx5en2wzDj/g20vUBK01HO8QqgoweE8QSl+bhtWjBzveVHajzG/6uuteB/zAn0w+ctcdMp2BS2j2sQkBGMx7W1zDbx309F1PftRXXXflFaV53EnxOCquASRHKaEnQF3M29YlMUMrJpLJ74A+CPHiBQYDwGcSnwsBchzp667gZ/yPZ24Cf/Cm9Zf+4ZvvWXAsvLkUrUXsgwhMYA9JUDUVmFYVeHL3ow74F3/9Fz/pYatHArwkx4wsRgIHR1lN1CFP5D15SK4LwACVjgJYASTVMcfnXhqe/tNf8s5z+PnfefMb3nk3aNDSAfgSnhBrOMN0E9aMDh787m94ynOvW31YCbYGNKeGBg5nPJ5w5eH7JHbLC7HFhbu8OobYWCjz+pzg/Sc5AFOED64FEsy7hOSR0HfYZh0jIgL+cPvYLz34888+OLkDt75z/Td/fnN9Y7q9bZbKkkRagYEopF2CSLwjCWgNbRM5U2IKKaIIVQhVv98/8hUvOPK4G3DNI8wd3EY5AigO1i7AxhJ451pASIoeIL7K8Vh11hv1v+iF137OF+Iv/2L+pj+59f1/3Ybpse1s1EmgAA6NIsEdOHzs8Nd+Kx732HTgBGb+sOtvVFhHc42U5SMe+cAbxLbnVtzR0SOhHoSsAGyIDZxHCxhicJ6NscFr5WhtPrp69Vue+xlfew6nb8PNb8N7/+bWD/xDu33PCIdSFJI2eGZmM0tiydSqniVObRmrQ+6K6699wZfhyU+pi+Ec4x5CBURW45ZS4eDrct8C536WoD1n2SYl47zLAMztWJTmuAtiB0eOlx65tAuTCYCznF4yS0TMlshijjWkBCKnptQ1YhU5XVRNlqscqSidq7wiRi0PzTfnYY0sncaRK77iR+dAH36O0NP3LN7705c99Vda32NgA7Zyw+fU7/ytwaC4P4iUDUJkIKXOR6FrG5g4X8jqEwHMUuppsV7QmdlUDa1JMR41sHmWrJxratSM2AxGyUBmbJCcVueUeFnBI+tKBjkpzucjMMkyWNp5FKplHemuNK3Zp0HJ2EiFPIiZnTfHQpxUM9ias6Ew3E7H6yIqtbs2Tzm7yJuH/Zo/lZ4Dly/56icY0MfDAmZOPCgpSpAAEKKYtOcdWQNtoAoXEuA7t7VAD6pT1wIFBw9AF5DpNWj/4Fse2wJre1ictkbERQsEwOsU0D5fyMRlxmkgBRg1IyQyHwaYfNkMz/2i0QyPPAvcBrz+pnqDyolQY3jYCp54CE8Z4JCiYrRp7sGkhywwWSACyLdIaBqkpqWANsEMIkgKVn6wPf4VawAHxyARNA7kbICEE5idMLv2GQe+7RnP2wbWgVvP4T0fwM0feldspY6tqha+PHTgwCMfdt211/HjR+gBlWFMRlpD4VwhYuy83ms/px8X2URIBM9dasgOzEApLRDAOJDwzN72s/7V007jaWeBuyNmUzQz9AhXHcaKx5DhgZWEqY+CRV9LxLWWIR5HkN72okc/YACeo4xAAAbpbIsyn2S7v5nKHihEKIORoMLiCgFYQSNEQYnADDibCoXF+Pr0uOsPPPa5B6RFM0e7jVveiztvbW9+36mP3lZPzqlqSklEyJSIQghFCOhfOzp67PD1j8C11+P6R2E4RiiT8YwORQMLCsOAQFggTAECBnuWOo2ZtAEDUpAguYFn4UjgBXpxyNUXfGH/8z/vMc0czQx33tQ5djuPYycwWkGo4DxodcaDQQ0bxBlmq+itoEDvyKX/+c/2CPwJPDmOtXWHA4AHXAu4Bjx0NIBFsIdizDAoGfdlAR+a4cH54EB59ZPKZ3/zte0UpNg6hfk2Tt2Ns2dQzwGGL1D18PDHo+cwrlD0W/SS9X2sqgkwAlQdAYQWPfJgqEfEPqXAfv/mjzlihSrI2Mgog7DEcl7L5Cy4wF3x/bxLw+4mcdeTSUA0i1DOkUcNYllDngwEMSMyI0BN2ZSM2Iy17BW+58Aimrydga0l7m/w+Irn/Uw9vLbELDWDg/7c1gd+5Ah9FGfuicevGqRJ4Uc4fmwxrYe9kd1PHNVUwWSkCpg7f65ksU08vv7zGVGJWPDhFhFJUSSvYdxfoG1RsGGxiNIKNJeZjTKP2cwZJTWDQM1MTbWjIWYxEXNmmf+8A7MyhSm4g1IvOVMqMN9hu5ZtYICUmZWI2Js1ufxAIGekmUd10fgpJgNYsWy6769kQU0H54z+0pKQbWCuhfWViOHYEgERHBECBeIKJi2gGRQCZQTpRA4uuvSXAG8NoIYxuTSKZ+BK3YOiWqJVSyWJtKkthnlFWgB7ETYHabDlEYC+boKDysBpQO9U2XBpfICKh7F71nXVTsxpQl2aIgq4qhtQ2W9UK0YDVMqFA0Qttl5ELIk6jinXTjr1K3qw9dLUwPdrYmRoNCQjegwDAxxwEDgMXGvxCWuLF35WlH/y2OzrS4CqeFa2ZJAsba/mlfwCJSEVqQns8+7IOvx1jr50gR6wwRHULc03uiYXFNSHaVnXEkrpj1vFcYrH0/wGrPAq0lquBnX9XEJqfTmazeBKlH6zhAOGZqTRuNgJursv2SidghuKeagugQDiPvkNYBQKcGGcJWzTcndC2mPWtqOZDBnoQQ2Tha5UfkB+DdWleOL1eKIUpCd2l/QzbW+ntJi7JNRxzzoGGumgbWEeyvlZarkXu5bQA4+GtFT28Ik0AQUj8ySYygJYxKkLKr6cYSDuYBhQOnSNB7mlbwZAKeNzo/QF2xXWEa+UhEbX+36VvduDCyytb8NaT1EChjhHGBSIcFXKOHIyBzLAFmQKHdS+ZwB0MSLzKCA9aA+M7UNHGXCXg8187lIACuRdl88WDTFp4eeFLop4sHVWcAQXCkeYEBgY7B8obz97wOBdZF7K20oKWZrD5efHqEublHe54aougbVEHUxASYWpY8LS0jXKjMnQ5dgwGGnKyR3BOVcNKniprVVIFWeb1Uqo7cATv6m+4nNKoJUBysa/91d1+w1zenTsD+bAIE6HOkKYNHWEsd0PAnBeEIN0x2wpC2UtmrR2xY0Lq4X6rPaxTWJGq0becenmqFvAK9q6Ta045zv6ci4GGGzZONdd+u9kIF0qiCyfpQ4FvcsGOC9gsrRI3pEe0XsLXxtA7I1iDrhElrW5Ke+PLqrCYTn3p65Uvmwf7FsGLNPkh9XiLPzUwqWkQRyByC0XDTKUxJozPPPOOO30sU12nOMuPgAvEnqAgntnmQtghcopwnAPSbyGegY4nTvXLdCk6yMe7/UoJY+V1IBU3GoECFGdA45KGRkOS60vByUII5Wxh6AWZGlhCGKOpp5Sp9HWatlkAqwhOXRWSOD/s/3QPIwLaIVoCC2GAArSElPYGMiI2QQzUDAaJrADdrS5AzsCgYTAC5QF4BAZsQdRZuJC1DlLjti6J0gAGDjuXbuP4AAQhBB9BlVlWyXv5sZc9RV1H7OCNaLfhpUBpgB5FA6uA1UoYGwcmt6qY/WQVTMztMbe9RwS7U7qdhZ6XmmsEsaoODQH+nDQttg/ut1eYwNxgFAkdgbH3EmaG1pGYVwKSkrmkkAdHFLPfFLwcglnWeoIlLnRm7+QO5/eCNISycFsywKYcV2k3EtlJAYH+AJAm1D4PVpFsURAZF9wm1cEQpsVMBR9G6KFFIhAwQgKWIHzgBNRIkcwsIQZMBzPMe4HUz8LvgUWvdTbI7O0ohHUQNEHk81KGrvoEXrwAKYGRBo6ggOEuGYMEAEClyJijuESnABaoecyfZ/SEmfAAFeWS4MeBCbKfMe+UV2wBztAWJ3FUQSorD1Xn24B2ECABY/s5bPT2g33wft0zywraEdbnxzvpMJCcMUCaVosjszDncmfs7hSmMIvEpXCFZiASGjJkTovYocWvDW0xaVUuC2nSWng9MCsnKyeweSzvgyf+1UVImlb8EC2Xmt3/FRvcAUVtNj6+/Hqc1LvCEfAXeVklBbE3gB0Xn2UQKJE1axalJQG9chmjad5EdbEi9XzlacdcUdcaufFZFGsvvn1Gwsa9ur5mSuwPgpOS2KTRM0mGMpCZAzTzDlMMFFRMjI4gymyBaIxKfIdT2KWENQcK1jMHMm9UMdsBgUJUQKbiSkp+5SVM11SM+equS9NTluaEFbV99UrGyqliyY27voJIyMiM+N9RIf64RBA7xBwKKuxuPNWOZz379n7dWe7199JSqn0nVXkg5jPPQ9kbGTXFaQw3PvR6JYHHu96feDjPGC+zKm2A3b5/4T77WAZCAgZ7McOGQ+QkYncgMgRAWg2aqohQ26d8lzVwdUgtlRCSnANJNOLXh/6y3Og89kPA2MQlkTqEksz153iwf3OfwkP5QDAcdh1v/xyf9S9k/ZOs5YZGN9rdlF3k/vdslHlXD10l3J4vqWV3+C631jufBSBaGeB9/fHFgFw7Jfzig/liUH4FMhzrOXzCvetwhddew+Ap51WtL/vG929UyF6gHnI9/q2y3dU6O++5N1fF3s+Rysod7Q0d0oTxc5vLnB+qu/0hM6fjdt1R8fLaccUMOzu397+xFwOUXbbTCpLAGHnWw93zaWe66rnYYlM4uXJ+V2Zfbjvtd51yUI3bT1oN9mIQWX+oWr/7vt+tjY6WCzBsdsVmPUBs+UdvXhaEmG7VI991hs2l3M9MjMRA1iZVYWImEBgqJE6r+16mBcHV9YKI4ktDaBlibN9WT11w1WXfM73NjZWSrM4GNAHp3/3H8ZgM/OkpNEBmXEfXMiuhZYMpJTJ8ZnvS9ZSTI4Tc7IewNmNiV3fXf3EwGh9odieAe8/M09lnMXFcPVSAYSQACeot2YkBpZdpF7d4fvuCBidF+IwoeXUyiKUSxkuk116R0t3Yex8QAZhSUcyJjCJKYCiKJxzJPt3o/c1931ofGKZenIIPteKrUEqOImywFxGChIUnTm7EdJDV+yh8dD49B/7CMI6X9W0e1Fc9uD7dtZAuVWhOA84Uo+AojQvRsziNeshp8I49yCVQAw2ZlPylLYuocEh8outGDhR4YxBzV0Ujj7rZRMfRrWbhHbEmL/961bttkgDVWWL1k69QcnIAVJkpMfSbIGWOwqG+og6MgxVQkVqThOczdpRePgzQa1ZUVHxujM4jXJkTd3jtdXBAskRKQg1mq15RaHNH6qWa3C8rEIjW8aoUgZ4qwEgFXK042ucuhBLZqaaD6ixmYlx7gFneFYymKJNSGIovBDBoepXwTnSjnjhsNwoXWTU3VWWt4eenE/5g6qwROTRRlBCSqyS+29qADSLdmaUHD90fx4aD41/VAF4J+6anfcApiUmJGOvdqf7Ju1uf4KdHrAhgioUwcpIjllKAsGcCasJmTCZUwbYPIytLbZXLj3RynpwFqnPWATQNl152Vf9wKw8MQRAH+hNHoH1f92fvGtL+hVnMHGiuIj1NKFRfxCqZB3ZieDMljohpJTKplwYIlll5Lw1ZAthqv0jDx98tCToPLph9brba1+EaJC1wo1cbU1JRQL8DDZrHfU7PgUyYgxZEYuNoJJlDLKfku3asDDIjMTIOu9169wXsp2wdaLTSpkTbGqAsYJiQiPqmROBHBWldyBHyIxj6moVF7tIP0AAfigP/pSN85i3jKwBQwlM2d8GYIUCrMSAE+KHrthD46HxjyoDpt2LcheMYZ0PL1RUUopkUFWDuHvLwNpSzp7JoWaotL6m4NjYg8wB4joerEI1KEwoWqkr1w3qGANZwz66NR9vW6DsPeyF7doXlPGMzte4f4jbV7Qf+5WiWeUhc0pqLSGYtmypcKjFsJixOWnNB1ZVMmiXTBC3hVTsGIWSc1FlwwEpjA4/8osLuNYVvQpngdffdraUxXbg6vioITA5gVLidqMO4httM/YgiwZBwbn4nB3QREkECoORF6ijjDoiU1XzLDBbuh6p68yRJDsEZ2kOLB2TQKZOHcpq0DLEee+5rueCtkAPULNOde/iI+f5/ZPLCDt+KP5+6obAefKErDlCAIM8WKFdc0sICKWqA3H65EsnPjQeGg+NT6sAvDua2i5fkWSmqY0ptabKptwZwuseC00CKlQ96ycjI3HKCYmMlMlgTMJmlJAWNFk5WKV+LJVJ3cKhqadFf2Xev3rlyS/ErIE703rmhd59678ab62Gvo6aKBxJk2oCVDWRLZxVoEV2NjRRiAGejTMm24ijA8x7YeHFYIiZum06fsmTvhSKlpFU/mrT3VXjSptNxr3ycD96VACJC4KN0xNtJJWFM7GlfU2OwaQGtSzea2pQIXKUZShJyRyMDUt+EUyMbVfLuOsKG+c2eaeBlK1iFJNF64sSRcGeDq6teTgmLAUomblTz76YwffJgB8Kv5/KoWDNDurOIzXQNmkDUqjCIsAaE3TBZZaO0Yeu2EPjofGPKAA/8KqhijSXNsbUcqbRkrIqAOEHrpJZNKCHQcU9qDIlTxzFgyNbp/UaBGxB3RDD464hT5i35J3Vh/zsrvmJyz/3xVPwUDZBVeHnW3f88OFNFA6NuAJzp5FdEhEhVlVC62UKmeTzYunkAaxzCue2aBZeC3KsQV27kJiKS/3hp9XuYCXqrZkV5Y//8Uf65WAxp/nQdCVE0zF5JKQJ6nMTbzzzjmPKodcMpEam6BScxRRLrnrWbAOpObckF2n2V+xkJkUtKVIXtXPfd6lPaZQVsu68Y+7LSogUFBwuu/JEV6MgI2QzJL14aOf59z8Uej/1gyAMdgDauQvJkApKjVNvLnGCccU6lxpxBitKfgiE9dB4aPxjDcC5p5v7u/X2JjNz1lNmQDXDr1QfuEpmBFCJUFJhFsk8jNXMOajBoETmfOhP5NyBYytSzbgpkls0tDK0qYtbR6786ubQM5twF6ygxdqAX7X5wVesGIGjx8HNcbk2m4NUTI24TVoiIi2QpgCgHU0XCjJTAhmaUDdBiDzUKTslN2mHj7zxS88CVWQuZ3dKuCkNq/ZsXQyOXHM4enJIjIIUk62mmdWBisQIO/xc2/FL77QzyVSz8bDraLy0K+XM3sCy5PvuBMJdPsHZD1g6qWejW2691YcQkX9IDx8+LIgdj5iWdGJ68ECdTwkv46FxnwdVYBTIX3fDw48OWWxYar0IWsYyucbAg6gzN3TYiH5worr5oSv20Hho/CMKwC1QQKEAsTIZkovbtH22sB1Rl07oKf+f24MpwaaNj+WBhxW9Nxjcgiko5gxuWpLCkpMq1XwP9aZuPFJxi2K4Es9EZkf9O8Kjx4/7+rI5daCeb7j+Af77+Vt/8XJaGB9tgme/uTozs8MctuI8FiuHhjUnNPesNJedrB2zUxda8VaJcXJW+9pK2ezj+ExSqHhwS9FeNSmPloeuxPFHHBRFKcDgv77PFior2quHhAPmWU6Ij06Sc/TR6aAOEy8jbbRzlM/GDkqqJEIipqaqkiIRQTPKm0m9sDkHJRMzc4yOkkRifL56bS6LUKoBsSDXqttu4vjNf/v+huZUrvlhMS2GX/IFl/QxFAeH4ICIhbeefyiG/v9YBlyBcRi45f959AXfeAIAcM1DV+yh8dD4RxSAO3MJAkgZxpD5dMJNe9G/wVQ0ouiHwSjF2thYXCBmDzhG1hdHWju8Ql4U4rFY0KC0VGtv7eH/pD8oJdaTyGtFmt7++u2zH+33DqaghkXunkIJ1iRbLbkCNczQWnH3x1RgSaKamYhqpOy+YMPUrocDKzyd65XkN7HoH7vxuZONs5Gno7h199rDf/tttx/oN/cgHLu02O73e1abgynRHFtnNhhQIkSDdhQiZOXn5WHSiVAayMEtlbbOC1zsSF+d7/VmG1PsiFNCDK20RhAFmN/+9+/wRc+KIirY6odfey0A6UxoHhoPjYfGQ+Oh8f9fAZh2ArGBKaZ2lpppQen+6soXHkpIyVAOeXzAzU5CDew8iMhB2ZwBVpQh9LixhVLi1Igb9GR7uzx26FGf2y4mUUDlmLY/du6W16xxHetD5mvhOWlgsIJMI/FBR+MkGwwbaNl88H0ObOSAlGDmWZ0mb+RQJsxLV3uGrmh5qlh9au/wI84uJq6qA81+6m1n5zwqmykO8uLKcUNYhTMwG9p7ttPWwrg0MDVipEtBZ73XIUoqEDUmZMpzh6BRNkdqxBl7la0MaWk+CLMlGUnNzBFbE1Nh6Jc4eXod4ThCQQX6rr706BGYLWVFGMQPlZAfGg+Nh8ZD4//62Ee+oHZ6tKRAamcbFucMMb24g6CmAj9I/TXzZl5SADtVDy1ghWqZemteXIRT5ymROYnQ0Bx+3DSWlOYtilBv2Pt+n8/d6VMiJFNv6im7GoAhUHfY0CfMzXSUcM9tH+DgvfcueC48grNAcFBnkXrjOG2oX+FspLXysc9r5ttrlQv1yY/Z2ks/KEM/38Ba/8Bs6+iw0HYA10K4wf/X3p/HWXZd9aH4d6299znnTjX0PGq0JMuSLMnziCc8AAmDMY4NhBgIgQckDMl75AFJSPiF5EEIkABJeEASvxAmAzbDM8bGYGMjD7Il25osyZK6Wz1313iHc87ea63fH+dWdakHh+Z1lZF9vp9S6dTpW/fuOtN3r7XX+n7l+MhJ450Iqo10+sXylC8vymJO4XQq0Lqm73zux0YaU0CNPcNax5GZoXEIVjT+lpaElofgMBDn1WfUyXbPUsEEmfodAmC0BNyiRYsWX0QE7KaNvwAAizpeDkgpVkiX95XqMVJMyRc7DyIHF2q5pwDLWYJKLugkzpGoaoyANBSduLIcB/l1ryBJzlIJX6w8svzEH2/DrCu96JLURHXXUjSjlFLH+US7YE5kRCZZtTw59SR7UMbioYG48MKISEaIAKfUVzF3ws+92u27uSajlVOB9GcfDCUyqs+gm3cO7jTFNotkMZjjFQyPLLOxmfqUAJgkk0SSoAkpNl8UI0QhaimSGlRMEhkad8L1aiwAYjCwrilpm5I0VdDa2EJBYEkgCCujFOERurWDBLezrx4CBEPzKgDOWqnCFi1atPhiioDPOXxKbXEIKUlqaLqsL0q1k1git/4OVzjLJBaeMnDGFMC5hS6pi429MODADEqj7tXF/FU+Dicp9TDCYx8KesbFAClUlRK76FnJYhBKVvZCfqBOlSYpyxLjk348ygeZZco5UcGlVAIxJiNlK2OY7clotbPr6ue9lcrVkRswVQ/FPf/pASNaWM0CXe2Hu/fniDMuOPK5YvzkKC5VYuRFQhQhgSqJmiiSmig95SuxGqmQgQEzAZQbrQxr1Cinq79TM8OpCjTJWigsRkYEzkJn5kMfudvnfcozZB45vfXrXgOLYCgETZUcWNFqFbZo0aLFFxhXuA1put6r0eqxkRrlhsszAQgAsY3EdYq+77gYzRCIIjcWhGRwppTIQMawzNII3LVtz3SpdmarFHZMnpTHP6GpA15lc1Zuo0zhRkIM8sYTrbr5nj3jOHFCohErh3pgKlShLncqVo5LdUREUAqBLOdTdWdww5sn3uVlXHHV2U7/x/5CS1jHjSaDrr+uqHLcoCPPcwxUS7b82GlOvnLoxFRUupg7n7Spw2qYWFUpKURJABGYgonU1q27yLCm6Muqqq6JemmDI+GUg5uV5STkslwVf/7ndyVjlxfiqlrLN7zqRZAxuNEmE0w1sFqhhhYtWrT4IoqAz22aaKqgCSYbK37/Kl+pnFhMosR5xwUmB/XMntiTC8yB4GSqMG1M6rxMUpgL8wd5tKCgUgiLDy8efTTFWfVLAkO9Q5NAVzRCkgMlrfOQDaKUUqeUUj06XTjnc+aMyFFZT5LKujy1GXs5u7jzWbtu+nrw2Rh78zb+1GJ81+I+ny1OJNG+mbirALDLewACjJdG49Mr3mfRlFWcikCapl9aMzai9SpoTY2+RtMcvG7we97BXTc7ahSvlLDWBNwsA5spgf1wWH/qMw+EvKvgUOTzO7ftnndrFhPnTlAb/7Zo0aLFF08EXKPjoADX4Cx08zSBYZR3ilhe1vsYhYiVXDRqN+2+qTrxQLeqU0/LZLmpj7WDmpoSMRMh9ZEfMd412B/NxGa2uyfw4Ed9t89YRDlP3sydMBEdz7uMnFcb8rFi++5817bKVgbVrpGzv/jE4d7kFnNnut3Vmmk1zghXXFbkmHm+rB/rd3a+9A2LcTJwufCxUma+6VOvQHZcqi72sj1rDlwdNEQp2MVsGMafO+Mt6iT2fTZiP8o0q4UksZmJUlKkZGaaEqm6FEUSGbH5tQjYyJQtrHkmYapdYmaka03AU9u5pglYVCdeuovezCTsONvRXaYrnW3P9/cPALgBgC4yIFsz0cz/xl2JAnOoAUWVITkwLEA8XA0VsDPyowTnufF7v8A69UrDKpAz+PUEDq1NVwmYmsNP/4HXLVs3czyTRB0CBMh0aEpnfW8HRgvobcMECGP4LiIsCXVs00cDoDIEATsoWQQglFdA1yqjp+xPlFdTi9ZNhWLqRe8F0KkrrU6nnmRr7utBgC04PjWQWQLEKK9Fc64kppQNcoxK9Moocz5B1VwnAplh8+siIxSYHhAGE4gF3BTPrlvmOICmigN+k2/3yiFAGVBwTIAin8qaNwPA2imbOjxv9ngae5P1QIU3XFe2tsGAE/AVvH6uYB8wuCmEnj6knEktda16ufU+agJYpYru7NXl2c+RqyDsAjtxLNN+42ZxFICBQggu+CQinDqaFh9/wiUDe1UjMDUKyU0PkMCRZ/TYSCVqimA7dfr4YNCru53C/PKxBRdl7MQCO2Kn/FjH9l7zlTPzV63ElZXkt/Hw/3zijpMnP4lih3WEbz7gB5nXeo6DIyVQdVwXDp2cqR0paxKGkYqTpJpMm0hXTUWb7yIQgSiIm5pnNpgpTbPQ2hikbzASbtqQ1AxmJOd8hIkhodf503d9mHLnHA19p1PIN3/tVz595oIjWAFyQJ6QAzCSiNJT7h0TkqaKlb3lTJpi9GGTCZjChjtk2hgGgzQPJvKAX9dctq2Y0fC5/5mRdwRA6x4VSEvwMyC/rlG2BUXugtBcnABADjCH1IU3CgC7ZgzkAPNIbvPnA2n6oUpIDn6NSCIorFNyQzCuKZxgvxVnC64GzDHMuYxrAJLVlXW6DinBqSIBDJps9hSlRmA+N4lcv2491o/NuoklY/PdtAzBwETNhcIO8EgwFuJmAPbUceabfnfpBVlhbq6rjTfUFc8dXsE+YCWYW4sLlABJU4nHy3ufhlwrFYD3UzGjeoTqPoPBZMloY6qbEOEc56IKEqlXEYfV2eVeLolynhr/GDtSUQNETdT5uR2WkkG0rlCNh5PFwc5eKgaTx8+GpTL0OmWWPBOJwvnJ/uu23fGGdHYU5/pzK0ffzzf//BOad4tYTvSWHXpNz6lcRVlXYeRcmVYfOsVLQuLImETZjCWGZBUUqhAlNSSBKkRMxFJSVXNT50aDNhxLUMCxYa0yqym2UlUyNjM0a8BTcwezrqOU0Qf+9P7uzrnK+VHoDtLRt772zU8X+jUXFT5V1ss8tLrr3b/16Xs/eObscbMeSznodLbv2feK13/9/mfeXqkHF37zH+g0DaEUZDAFAcQOESBBEz1MXQK3pKuLm/8EABFMM0I8/eR//5X/ewePZNv1r/+2f2qeCR7NsMGbfXw84JAMLNMPjdBh5L7bsJ8Ah0g2BPU3O4IhsDMFGTWsBgFQrx23c+EdYbMPzjpzNEyWQQ5/6s9//9d/ZXk0ecGL3vDab/ruSlGlmPsg8MC56tXNnhDINNTD9NqGYNppoY1iEOC3JkPgmtuHEsCEQAYggsYOwcAKpxvO0RbcX3SOX/kS+5uDhjW/nCtzCV3Z46zU3Pnm1MhDndR22QMVQg6qkuW1zHBvu9SHHLhx5NsYBkw/0nunXJt5jcqGswtuOAGIAsjBEjlmMJzBVACK0bPbZXVyTjMwVk6Ilt1ifjKyM0+e2dWbXbGoMI6meZFmtt324r+zGI8NOld3Vg9X83u+98/3oJC03NdtJW7cgRxFjHPeJSAD7Ohw9YlTHQ0alVxjdSyUFCIEadSxTZRVoaoiTtWSKtRIyAATWCBrYt/pA57X0lM6zYaQgAQwJW2qow1iXI6r5ToeOVat7hoX8zvQzfbwaPD0iX9rzDCk50anH/jEO37xJ2Z0cU8eZ4ZLSnlgRcXDxQfefv8n3vZDPzVz9R0UttDvlqZBnoEV7DBpJuxr6WhZOzOdLRgHnUvKgYGQ2eTxj1UdOnpyuetZp0/V9XTZFgQNpuA4/fsDoV7fD3CNZrUjONRbcJam8+21LDSBmdRNVW8jrDl0IcEnQrHpEV5zxsQDbEsf+vWfOzg+Mj9c/OgHTr/gtS/r7X4mF5nBG0Bg6Mxmny5vE8A3l/HahRSBZNRbU4XXta+tuLlIYaxN9akDnAEcgNSMzYHcuehXYQBtdgysa77aT5m1NBPuDcdEAIUl0JXJWPgreT+u/xnOmwsSI5NephAWGMkMoCiGqFneO7Aw/My2biilCuLSWJMlR+usrkkNJgKhurIix+nTXcpYyZKSEZOCoBbNG/vmpiiK2atTPQwdr2XEcBlqWuuJBw53sv6QTDMXoJllp1K47nkvSn7nrJ5YissDlN/36K4H6wwrY+mCn72bduZi4+3BJ6AE3BiTh87YMLEREWqpzYxVTJOIsqmqIglJEwdPI2AShQqxg+h0RVeN1VQFCmbAmuw0m0FBAjOwrlVjCbi5IpzvfeADH8+27cDASmJk5d9//cshFdzfvOXeiz+w2ANIS+98+//V16MdxDPHR93BrlCY1pNYVb47KJDtve468Vm1+ePxazGMwTfPqqaUzdBpKuTcega2sbDizWeY9fuLHKaHa7zNjQvR3JW0VY/O9QcHQSUlODLyACrAce4URAJTQSQOCtSAozzb5PEEgJCa7oGJgnl6LO59589++sFHnjw9+mc//fOgEM0bbcVh8tOHNRsY5nfs3X/o45+Zmx0Eo9m5mVLrnHOcm11vSQaFUNUTn/WaBS4yB5AQYHAMKDMxQd35i6CblLJQ4ibnJ5acOUQgoeMBFQQHB8S6DMFDALel/tZlVRd5ppKYSYkJpGt5FIBTqkLoXNHr5ErN+GwaBZtxb3778pNHVWvnLm+tTqki9YAaVZHEux3eH1A5Qxkj2VOMxkkNLJCQrIy1l1qJMBpqJbUvuK7hmryhAAyLzaPL4CL3PcWY6gx5eezJwG7pxFK3dimQODR5mCXwnjtfwHuur2yJJnvz/PBv17f/50cD8jo/66vn5XzzLm/1HnAPLLBgFA+PFx86xdET0FgMUlKYWNKk6iSxqKlaEohClVKCCqIQ0TT8BWDCsCbUb8SwNqSgG89BnvoSGmzq7AAzlNr5wJ/evegKzgdqoOXHvvNvvwmuwtMEDJDJ6Uc/c/Lowzu7fskGf+u7/+W1L/7boCEo4uypP3/fn17V2QZkDM224BFqAqImloqGQADEQQXBzEhq9h4gURZiELLNP0IErBma+LWsiBBSs/rDW9taRlYr4HwApGMVYEZFDR84JRFm9qS+XkIWBHna/DVgstSkfAUsZh6WoZqcOfLQu342mz0wG/aDMBEKDiwjRwk8u8kp1gRLoHwCeJ593T/68epzX3/m7NlvuOl5JvMh7zcxKCEwFDwEZjY3w0Q5AT4LsNoRJU2q8N5nUsP5mECeBXBgQlNguMkTdy9qRsQ5FDIC54HyCkiCwsFSDUesSSWYzyM2PWOxccJR5JnGKgSGlOoKgrJVRAywIKSQR6D7N42ApwseBgMShTC/Kz2uhpovc4JnnJzW0KC+TLbqdDAobqpWH6Vi3vgiPvBkyYnEWBWooxpEgsvG4kMdycEZQR1MzTdWf4hekisMZUy1Q1adXbAaZay9ZUZwhpCo9EbXXDN3yx2r0jNbGvurT+iB7/tkAetjOIkHCbftTJntrLGfvDgzYLCEE58+mlZiZiYwMuGkjfBko7HpRFQVUUy1IWAVMRGNCeya5yqZAIEMPGXjhoCV4JqcnhGpkU6VskjXfBrE+PRQV0/Xuj9DDJjrvW4fzdp0oe7pQsCw6vH7P31gdoelym87eO0rvubouDvTnekAfveeL/uGGzkr1Mg0+qZoY/MH1ayZBTKPMSZnH/roB9/73veWo6HWZVEUV994y5d95Zvnr3pWuYWhJwBDmJZmkibKhJKtJ+umy1WbPh4yi5wDyOLyb/7MP+9kGGc7v+pbvjfvzZArFOD6zO/8/I9nTuJg/99+2z8Cb34dNEHAChRsQRb/8Jf+XTctdoqsTsOsPPKeX/xXS9qpOH/r3/t21+tt/jnyBGlWKxwwOnHqT97zp8a+98ji67/5e8oavUyBxpO1WZ7eXFQJPW9sq6c++8l3/ubbR8tLk0kV8uKmG55x6/Nfet3zX6noJThsyX0FQEgNuQOQln7/V3/SBzpw84uf/dK/tXDort/+/Xc8dv+9/SIf1/Rlf+stL//b37QauQhb9BACEOuqyBhSopq893d+/rGHHxieOcFkw0qvuun2G5/z8pe+5g2gKxMEX7GjvVZ00JSleOQFmDL26TKroA2JNJIE4zrZcl33B9m+1WrobaAgY3XMWM9rk8KUVUQElMQIQFYUSeCjNyUCjJQ9q4AZBogzpWBYFa1ZUhyOGUwRiaGEjiADVjJ/y6tesuAyjrm6nuPP/vBdt5y1PmLekVi/as5v7yfoPIWeyLITKNJjy8OHj8EykppgZMqiIU27fgFVTRCFKURU1UQhqSmBJpr2G1nDuE2bEZTXbstmkWZNAGva/rtW/zz9/hvv+IPtg93HZ1aKtK309B1f90Ikrb17uhBwRPJWHti27XPjqpu7x548dOyhj21/5pd5MJmCmLOuKhl7Jt0KIRHCenuGR0K99P/85A+fPfLZnX5IUrNG0qJ69PTP/ch7vvyt3/vyr3zT5q8BN3MUtQ3LzgAShURTqw06V6S5BRMCUkAVmVULD38st/EZv6tHfx80l4A6ygD14iMf7/t4krYH/fZNJ2A6V8frUQGjsw99eHn50Hj2ap4s7fKry5/4PetsPyXzofePlrQ3t8lHqAIKCoB0wKQr9YkHhg9/qKrTPflVr/u73xayDjQCnhhmgPY2m4K7KFkmf/r//Me73/sbe3uYtUTkbIilz578zY//+fUv+Pibv/uHgY5Opw62+fc7EWC1BapPPvIxkyFS3Ln94Ht/8Xvi6tKzckqTVPLgrnf90uzc4Nkv/6pNbzvccOfkwcMqSPzl//IL/NDvDRD3eavHQxSDpc8tvv/+u15ww47s6pdf4bj7SrwRATGHJgF45/zu691kkRJBCEKcUkiTkEaktRhY6ot/JVUro1tS1UI7TEdHsuJ6b6L6eJBtoE6CIwhb5DhHqGAh5xU3PJPBZoactmOpP8odUwJVYqX5imlCNIHVhohxOd+Ph2lYwSiXZVazPpugU/kaGouJFDPP+rqvOEk9X9ZejxYe/+zhm/+w3Nub9Ip4ePJlO7LdBxV0rWkv0Ng7oPALfPhTh2hsg5pNlZNQFBOtVZJGTZWva1cLRaE6cYy+ji5GX0df1z5WwYxVSNUnC8lgZgRWhSViI4Zxk3IWqIJSAtXEQkwwxxwFi8N45JHR8fnTkP1lUcysLH79rfsRawOviXyiBmqgWvtqfkxYl976AsPBC/nBDc96sg6aub2D0e/8++/77X/9nScPPcaghGAIzExSEVDqphNMQiCrMqgHgPoP/uOP+JP37JFTk0nHZTvr7sGVsH11fPa6wcon/vC/3ffxe0QrQ5zOtDZnfkDQRHmOpEBmIwNgHCwCnEtVIcDqhOC2JBddcZapdhlAZ44nIYR9tIxiJ8znmITgYAhpUuqw0LObne8FUIObpFFmFZlC4oOTuZmgK2U5S2OYm3T3jLVyNJRayDZ94TVHAjiBSFHyTDd0rTzrrd4RF4foZLJac6dZVfCkcJt+ylZ98Yl3/trRT/z6dZ2y9HvGllb8gWF3UC2duaNz6sSjn/zgb/0cA5lGkkm5+WznkeWWLCPYOA1PzQVd+cRv/u5Pf/uho1WnmDtpexZi3kF1oFP95e/+56GFrWBei6RRgDE5oW48dp/d/w5Loaxkcfcd++545QrvvZomM4Pt2dV3XrnjcOUnEOwdIOb3Hhw/9vFAlYGNoE1vNUE1GeHS1Vm6fneIGcGLmi96q2f7vdmR91mNs4BCO3ArsNypKWuanKxmtpmpdYvQgVhwnFJKIiKlerA5JsCccQfREGAkVoN8t8C4Ys5JJ2XXunLNzi9/9ulsfkaqFdqbx4d++cT1v3bfMJudHdlRumMwf+fupY7tQDmLXAExogU5+dHPrn7uxIx0JzIBJWoENxqVq6SNXyBEoKopNorQaqKSJCUSa0yCyYxNzYw28CHbVG4Dbhr3N67AZmowFzJRkC/u+shfau7gDrh+JUP6ke+4VeoVGghh7G3b2vM7AREQIAFqmMFT+tt4w0LjFwBJV73ODg7c8ZIvf+mhT74vd9v6ycpT97z9R7+hv/Oq65/zitd+7Tf67iwcJ5jnTU/ZEQAKMDXi8vhDjzz46Z2cJN/1uu/6N1c960YwY7L0Gz/5T/TUQ9v94l3v+Llbn/9rTT7ivCWSL1asFeYzCEqsICI2woVKpzptAtpcNE9oaeZyHOD6//Y//U888Xv/6d/9lETD/N6/92O/CJ+ghqzoful5kczp6Y+/+xdnM6bezLXPe+1rv+aN6Azg3X2/+Z8feu+vMq985L1/8OI3fp+Sb2r9Nz9Fv1a5aFpkYTguc9fNB/t+6F/8i2xnDup85nd+5d73v5NSrKtlbzVoc6ssEuBBIGsWt5yuHn70vpmA5bQ02HnTW3/0f2qqnp9ZXj/4ZcM5Qf9KHSG+ojfk9A0FMM6RzYXtV7GVbCUsKkkiEmOoOYl2CbAay5qAJaBwyTy5Ynv/ecPRYp4HiROYg+XmhoaMDZGVxk+U3IWo9Pp+AD8TskEndAoXPMNrSTZhjL2bZGGklVlizpVKSH/XDl8ZmIc7hjtPb+c3vLy69rbZbneYts2lBz+YXvBvPuXHM8+qVxbdjf3+Cw+OOjCN+zQrJlZXZmOkhxbKu4/2x2wqoqXFZHWyOlmsrU5Ighitri3WGmsksZgsRquTVtHqNBWh1Kn3ETWCLAa2qUEh23oWms2g2hRhqSJVVSXGVQwf++TDdbE9FHvF7bo6W/7BL7uN85lVDBxmhEZCI6MJYLAc2ofMIW1r8hJrAbCtJTW/YE+mnAfkIyAv/cYfvPb2NxxbWgi+7oq70R/ZNXno8Q//xk//yHc+8pm7GBpT3JKIPFVgQAS4+12/OpNTYFduu37PHV8u2QHxBzC44S3/x7+pIrl62Y0O17EmkKp+iRAww0DrheIQhhHWrtYNTxWjrVnjJESyRADIV2BQf+j6mL+ujxiy7ERVSHFtSQcQ9qpR4BJfYrDPfXJbvpKkeGKlfvU3/0MUN43DtkS7b/2G747cyeLSPI0evOdjxg7ULNZtLnSNhQGhVLPxWDtv/vZ/zAeei3BAaedtX/e25Iq6LnOSgmUrxkMeIEJTUBnnu1msS+e2nzx58q4P/t4k5EvoqrvVb7t+fGXXla7sGzUicCAHDYO9NykAKEPIYPBKzIZg8r+aGzW9Hc7UGUKyrDO4LUo32dBlOSwDNY0h8OaUEcqjQvAEK3raD5gxdJh7nosA70RAyXHtufI0qmJK0dQnKwlu5zyZqxDiBP5rXnL13htqmzwp2Ux9+HF71j9473iY77aVVRzE7pv3su9Y6W5ayjorPtWCiYTTOv7Uic6CmVBZT4JElxI1toOiPN1WlsRJXVJOwkk4KcXIKXFKpEYmMHEKqDlTqLGhcUOaNps2yhzWrHKRTFU4RFTNZR/+2KfNz1pXUUQk/3duOeMXF+o6zhrn6g09Q0/QSQg1cc2oHWoPQS7IBUEQpDljaJYXv0APiASxBF/A7XvxN//IP/zldzzr5a9bif2aOmxxIEtz8fjb//2/eOK+j3e8r+otGKfUmBYdn7z/Q15q51z/4LMdJgyNQI0c2a7OjmvQmVkp64WFBbUvFfYFQEhkUykwOxf1Ki5Y0TDQFigrbXx8VAJwJgDUO3JwviJfAtF1IvUFHib4EsODD923NJSY93Ze/5yK+sLIkHnEyNuR9wc+7czi/fferWABST3egtO0fud7WEpC+ezMDc8dA0LdOswg6ymFPGSZ4y2o+eCncLECfu6Zd67YIGRzO4v6M7/xz//L977mV37gbYfu/otgQ+CKxQBXNgXNNiXOJoGch13XyaMdtkSxCpmrFDAPKFn8PF0TtP5GZtMUlmE4ol7/WWV5F6wPY/ASpAdKYFJwTxbPjk9mPi8j9fdeu3LyDKtJZewdJsTeUTSJKmLOaceFCLgEJp/mZrp79z+5NL71hX936bZ9vHoYcTDIl492rv769xxcKpRXRtg+cM/fP9w3T8nvnmCXYpyVgtAZ0/hTR6qHT7iEMjOYhkmsyZMKRMkMSTGtvZqqX3FSlWhJoEoaSYS9w1RnSUmN1NgASWSe1EzUmMwAIjEVhdL0wKhSBC+v1vd8+rPd/rYxH4+uuLq8+5ueQ6c+8Y5x4Snkjvrobc87vcH89mJuexJzvivgBCRh59abS5maRg5mfIEYhHwEuglIvmbXy3DHc958w3Pecrp8/Inf+6//QY49OIdl35n90B++45pnvTDPtqC2TAwAcTIgll45qg227XJaGgHwlSDzxXhcZ9D+YHDy5Mk9u/dsJdOsI8aYXNr6hXwiAhhEAItI5sgzl8nypodaIjVZLKwJhm12zmIqw6k5MbTyHEAxIsss5RSLtRclIrgMX2Iox0vb5g6eTcsLJ1cUcD6aBuiy+PnB7Fy1PGTE5aUFIhBz5jf9+BBsLYXCUGHOJonA3UbgNAEwMohpUtoKafOp4iyhUVbIuIuZq173th9636//u8643OfcKk7U4yfe998+2f/zF7/5B3/hSq2SX8k/rMk+NU8gM8AXxn7+6ttPPPqprkWvGlWVWOmckvPF3mSqbsCNnuXaK0vvBv4ZKX2u1oVAiUigOXhkLpC4TEpaecR23OIlyMw1VC+pq1HDMiNPLgsoTSd1SslirE+fpb27rVIPt+Cx60XP3XVseXLznXPVmUP9eN1COt7f9Yb3X/dE3QUP2fn8ec8IV+1aYczV2D/GareOabk72RmfWDj7sYf9yrgOTqJ6rTUKYWo7SCrW0HBT6izJRFUUSVgSVDUlVoUzqJEZqbE24a+iaXJ2zZGkaX6aiGFwrGoqbM5nef+Df/YRsK8IXufSSvinL0i745zkZ/dU49NuMBNTVaqSO304KPdr64bO9pn5vfPbdtL8HsCZOWk0LR0BDikihC/IAyIZewJUPGeJsKzo+F5AVu7f/9Yfu+lPfuK7lg9/pqBy4fghSGUUtmCikAEwDow6m6N6JfP5+OShyD1GZkDhgTQpbOzr5ZR0bm7uC3LcYozEBrfVEycCqQo5kJGqeibUldbjPJstq1HIcziQmXtqTcNmRlRr5QumzggQB8AkURbrYV5UDkNIDiJln/C06Q64UpjrOhpNOtmqLxplhnqcQjfrsoojJAQi7fVnHEDMUVLY5EUDhzRV36VGmWvaPleYkNXMGQAyZQgAg9v8y3uqAtYsyFXwuZ9/xsu/9hnPvv6JD3/g3j/7o5OL1f7OsNcZHL7/rg/+wa++6o3/4G9WCroJVXVdD06EOdTw/sAtKHZ4H6QqHVKjnmGX/lyl6RegbMpIDGVo7ayyIgu3Fr155Qm0AEWAKwirC+zcykMJKdQ0zvbznMcsbMZohjHL0lMawM26MBO63Xxy7BTYFOYrWXWM/bv2Pvv2GcjjncVicvPpzH3Du7tPnN3ZWz6Orpt7ya3u4DZMrLesOybgWuJq8kvdcHi8+LGHbWForJqq3rjMRjFKkrpKsbJYax21rqVqNqJFQRKqE1K0JKgTpUgqUDMRqECNbC0OtqkxRyMJraA13StSTaLKlJvmJ0+vHDtyzPe78GS843n0qa+/eSeNiBhC3bwmSHKTkJW+G1NRLuwMZ/r1fdWxdz/5mf/66Af+x/F7/2hy/F6PheCjmRgxQvEFe0KQYyx7OuNT5WoLPAGiWCiKAOLe3Ix6X7OjTgduKxK9ahQAZR9Mrnneq5jcZDIZPXk/I4t1lQEBipUzw9VF4ixGt3fvXuCcR+SWwTl32WpzVyjdxU2tDjOZskqv8E8++lkAnTwYEk6ecEgE5a2rsp8Wxys1ihwAhcAESZoizEAE8zwVEP3SwnW3vGQcR047aXgitwgxnyEiz7C6vHByFGmk+Z3Pf1HTFLUF8gHeDNPC9QAwmzoIkBqx7g3E3Mgbb8EMjteFyZrWbQODAgZ3XvPab/3an/yl7/7pX+3MXbt4Jh7cMfuJu/9kE1LfV2xqDI2RnVNThYN2du+7VhWs0kR4ZpboUjVY1pCNmU099xrRJxMLriaTdKA7PweuoD2iipRLrQM8weflSSPK1ZU8x72Me0w9ph67LoW+dwPv+467NJjpyfKqQUGUk5ducQpp6N0oP3zt0pzwsb97zzV3D6/ZtXpEZrq7ds6Mr+sUOsmr8U0LsmuhHonOLnbzk4PVB55c/OxRTjrRCqnqjWNR6cQUU8NBMRETbWqeoUlTklhLqiUmS6ISNQmSmFnjb9OsS01LrtQ2Ps2VIGZNqRbYmFkVk3H6s/d+kLsDMRWIZJN/+bontF4qisO+Hh/vuJk61T5IV2Oeap84J5FoAi+ci9/Nx7OVh0989kP33/Wek4c/K1oL0eQL15CkMKQMw/qnfvRb//C3fsaWJ16dp1GBeM97fu/eez6eXBi7MLNvP5i34I40M4dKjIj0xV/zjWVdsc+Gxx/70J/8fuGTSyVs/F//038Ig/kV68b+VVnImqzsFtOhiABYXl5eHW9pYZGoNVWBIHbM/W5PqurP3vsnMAOonAx/8v/342zaqJpvSUR+rjtciMChAsAdGQ+9o9OLi2fOrE4LXQGHp41C3BXDVS/QuW2VzEKrn/7XPwwNOVaCVne969er8WryuWS9W++8UyQCRluwkmKNOeJUZb2xsQKiEoN8WsvOsimfk5fZzOFQ0wnCjGRSQiYE+eRHP7riwnK2A3RjNnfD8+68btBZKEcLIT94RVPfV4h315MWnAUADr4D1NiW7bvWjn4ypQg48AjmKXVBF78HvOCifhQz49GEewvdvItb3MwQiw/mcEl9x7vSqKPD+Th79rG7jt30kljB4Tbtv89oD7lV+KihQu3UzaN7cjjeOesmXVs5EXbsLQ9ffXLPUT/nfOyn4Ar/r/7k6vcsbIcdPdPt6k27ezc+c7Z0rNpzrgZZTL0JhSgLh46MP3l/z1RjzKCkNiSDSqc0JKXp5CE12yRJVSEJZkjRR/FJJWllZsFloo1PEinIxKAGUYhqMvZTG0UlJiJTb8rUIV3RvPv4Iw+guE5lgbKzmFz3AzO/cd3Bl9v4kKbcsZ8peeQ01DHR9FxAALFpuzbRGOql3K4lquX68ZOPP3H39hteOrv3JpWydgUDmVRgJMoVyDDZbKEJBsHK0498dLB4/+Sue37nQ79UcSG+T46xcHg7lR7zsXJvecu3SQKzbHarhDOCOd/oW/T37XvuVxy/+93X5Wfv+fX/897/94Bl/Wx4wp/+7FUHDn56Nf+Kt33X+q3k3OY8vIwxVUTzGRSgXjyD3lW9Xi6xuiar3/WDL6w7u172xv/tmS9/4xDYttn5ebJIXoAi1dlVzxk9/tFcy+79//U//+MPdRZOzAzy2bzatn/vk5+6fzXfM6HNlylZ97Ul76UGdBsP0b+K+t1x3bkm6O//k9dZv/9kXXzPv/yl3r4bN906wwwEhRdGYUulQxLfr4+fmTkwqE+lbGdz1TurAJfIb7q7F3de8BXf8ZFf+7d753rHj37oZ/6PNzNSR4b5qbs7O69drsP1L/lakPPs0Tx3NpuDWUbT53zp6+UOlcN8N4hZ6pHrBAAYdm3BxmeHg52EevOFOBLBAJfg1fncRnjyzz7582/7s1++Key81rJuMTnmT31mfqY4VvVe+NJn/82NgC9IkQE8N3/9i1aqylC65Fm8UmmXicQTQslqKjO9+Zu5f22pxDQm7ZibJN1lJOXKEb+SCj6rcWB8PXojdDs8w2GuQ4NZ3rFovblev9T+alzt5LwwpL0LgfpFZ1ZWs8L/s3uue+dj5dzoGCSfufr6q/dem/IsVakoqT9EMYRVHMs4fPL4mbvvL8eTVJWSao0p1VFTlJgkJotJYi2x0noa9WpMFpPFpHVlMWkdm5epRLKmnmpq82uiDTbkA0xhiSyRJViCDavhBDurY5859MgQehQhXrXqt/Wf+ObXP69bn85kyFY3v5hAgkumGpp6L21kP9J4hscnH/jw4sN/yZTcWgy4ldcJpwl5fd97/sgRk6Fw6JP0dZJPzvY7+UrKl8Ker/+ef5Htukl8h7agUZEDyAsg8EB4/bd8z75bX3a47O7llbnR4cHKoZ6Ot+858Mipyev+zrff9pLXbGGqYM00LRTIO7GsiizPs9Bh6jo9dP/dmQ1nt2AcNG0wgs++4Tv+4Yh6ZTY/5hkMj83OlkdOn3neS//B677j59T7bnZ6fOierQz2vMvgAuAAn2UV03IWVnudclCUc53xfR/7ww5WtiImP3fb+NUaizGkmQM1PNgrNrqqbsX6vXJ+86u+8sVv+IYjp1Z8HM5Mjg6WPrezPu5333hkha69/WWveeu3gnKbNnNv+v0uStaUWbiO2371ON99dqRmCRymQufmhm5bGhwcWYHN7zzUqUnjursofeSuT5Vh+w14dMeZv5w/fVdv+eE9s93llXr//pte+uq/dcX48cd+7Mc2N7THhKmPvEfpdBqfzZIz88lVdJliRuImpMTqzUJtvtPr16tnMh05LYTUtAOqACL08+4gxgE4V39auTJv8N4CNB+rm+n45WGPfbgl5GVZ7CrNU3W8i/xdx+Z+6I8Ho7zTRzlz8wu7z7iRqTOiupt4rnIzI6bKVKxeXDnzyfvCkZOiCU3LchISJUlICSIU07TkKiVKzc6ElDhGEkVKVAtH0ZSSqvPMIYcnZAFZgPdwAT7AsXEwZnEuMSmTMozgnKuy7XvrI5/56BEfKglhWykna/7pFz32vMGkI0sdqpJI4kwQ0Kx1XUL0p/HMAJhMCUnjuGsVTU5Td1fozRmxg4HMyBPAkM0uRHTsYHrb7Xc897nPP3LsVCWhUicIifJt+254xRu//ZV/73/vHbyjBBcA2wS0uTNio8ZmCgQwe/ji+he+bO+Bm4499nAVKQlR6D3jua/86r//Q/ue9+qJZmGz5wSk0+cSYCAmQA0u3Lhv532PPnlmuaxdd+f+G2589gt2HnwGs9/0OZOJkTPAEaMIz7/9zkeOnD4xktxzd37n1377D1/3qm9BMdfL4/5rr89mDszsumazU5pERJiWBxAIRDDc9pIXLp4oj54aU75trL07X/qVz3/ZV/vuLtBmny80TaUMBaKK+qK/97pn7bnhjqtvfk6yoIAnIhiIaPMFcARw3u941u3Pu/P5Dz/yeKprVTPOd97xhte96e8/56veotYTzmSNgTZ7PAaCqbfI0IUzq3uuv/3Azc+/+pnPBhVEYCSnqa517/W377zu9qufcSv5zc1ZTEN+UyY2QCRt3za758DVRw4/MlZerTSFue7+Z9/y5d/8mrf904RZvkK3F21+zUgUBAe1xXuPf/Ld3RSVqPLm5PJugORjJiB1iQpzLrOF2ckj5eFP9GhUYlbckktB1C9ab+6Gtyz7fodXBIfIf8JpFixXW0E9o1blw4UFP991r6Pu/EJvOYz2BffIoeHzX/GrRwbZwWEQuvqG+dvuTN2CEjp+uaBBXzibGDTVcbR46LEzn/zkjqTjnJuYFZoaJQ21RGqUFGspaBNlMdOkqiGqQjVFjuIVUaUmyvo96/fR7Wi/i34PncKKjnUL5Ll1ihSc5EXMg3gmMkfSCSFyL913d1isVmWlE2Ynsu+1ez7wJ1+VFlYrSiWZInTGlgl5Z8lbhLlLZDQF5mCekJzXVI+LPK/G6XR+0y2vefPEOh1KMBHKDfCIm50CKgHfmADKGJbWXBYV8GAH88b9EmBBTiOUS+ju39yE1IbQhKeVIAYRsEMaghIAuA4oL0WDC27TkwTTEs3GioMJBEmxylyaluhBERXZwKhbKjqbPRyrFVkksCFgDCsBgRicg+Zw/RWCQ9WzCoksDDY9yLO0UQ5aFY4BKGIFx9AEqZEUnZlkQd2mu1etWbjr1D5WazBDBeRiYsu6Tfw37biB3/wgOBqcgikO2Uo4BXkIgwAXojD5jk41U5qr3W/2aDwpaYTUMIVzYAeCWsdUnFMgwRQSwR6iCJvsFtU4WloCcSXwjp2NbbKI7i6SMSjBGNwRKipB5q7Y0dn0ajfVIIwEy/vPmN397NUn73KkTufM6su8vwZmI1ApnCI6oG4KB8JcpYt3OapVayVyFHONK2cP6b5bNRHZPtBxxdmECSOHz9mvVGFbRqARYnIdjPLq9Hjuqh/749XK3barvM/vfO7wptsmvg7DgoEZ6WQCeK1UfD0pH39i5aEH+kkqjSgBg1lqLI8M4tRMlBv3BU0k1rgvkCipurrZFqSYYjIwBw9TUtM1RwWYNSlowETFwAmmgIgUmSdJnLQ6dG9c8mVRdsuZEgf2zz70Sy8enV5Iwh5UgCDqjYg1siW2KJcgBifRAIETclGNfDFJoJBlaWV49hhtu97AjfaHbkmSLAcUqMHm+hvzctOHAoGBAiCnsAzFZi9xrj+GpvnoxpdQXRgBnTBfAIBW4MarlBG30ot3akwIF0K3asovCAxFDgXLei/g5kZ4PC37IBi6RFlTN1oheIYBDuoAo64GXwK9zR/PUw4RN73HXIYOIzkGe0buBa5xuNrSRmDycJmA4eCQfOblqYs7W+LlnAShAhD6AX0HJKBizECbFI+dY98m9eM3+xqeJnxDJ8HrlP8qIzjXWPqERF49AkC06UVzvOEqyh0LINTlbjEGd90s6QSkIA9o10VYBboyE4KtaIfjxs6cZ3rPfOmZMw+7eMalmi6zPZDVNV2HhuiUVWhCg2L+JtBitfKw01nw0FR6GJxcuZcHuy3vEoGqWyn7JGgJsg1uAeaq0GUsCvVBE1oh7tAf3dP/408vDYrD1f4bu9e8OlFFw2FvMtPh2mmW1YghkasWDj+6+OlP56NVH2ikVa7UePNCpenVhSaYWVJSw3r7b6MIrWq1AmYSEUWTgMkYJkmbZnNVqJrCYKowndZiKUxMDdAq9sitnjyDY8voAzpbWteXD73zdQ9tc1gK27ieWNM2bSBLbMqmSpfMcBiJmTOYAaakxAIm+D5PFk4e2b39egU7Enrq9bmZGdahI+cwXXm1tZLW0FgFT20jSOAjcaQw2PQVvI21l9qwHgNzU+tZATk3fXpCt8IxnC96JrKNkRbMQddi8c0+ZVMC1qkCc7NU0RRjjmDeSw7K4VYcOKC/NTOT5nTYhjA0P3dCPeA82E+HvGX97gxMRToVYHhsqFc1TPUONh8Baz7SGRQmjpDDNTkDPrcwtcUtbQ7wuna/O1qvYKTz9m/682d6dri5lRisgIB71hRs8zRFDRY4pvxKnbJNJ2Bh+KaNmgHN99/yysP3vKeni0KXZ2nMNooumQVKyMFQG5MNfTG7405m1bOLIikjDZa61cm4+FC9+zYGnG7jdC3cIXAJV0FmgrC6TnSJxWWheMSu/te/fXjbzqsLK23/y0vm4jR56hQpdc0LwwShrFcXDi8//GA2WXVWSg1HhKazUI2sEdyAqpJpk4I2UTLRJCxmqqZJalOImZGKIygx8TTeNVVp7LthjcwkYGIqMFGYESsy4vHZs/Xxk13kUdPscGE5i//z1Uefk1UneKZcXupltFZGr84SYIlILLhL9IEIexityecmAhTezDwPV1YXsS4pCmVwU4K7yY8pB2PAYMmh+bhG3NBA57QMGecUOreG8NazmlNZUF0BuUYa3iN5NK6Fmz6iDSnN8/5BnnpqDBDYptfRrLWOoHlU2fTUaIb41KaRAEi2+UsYshb20wY+M4CEwb7JTq/NqRi06WeMpksGfN6jVqa31TTz3Dz0bfM5OMG7xlhz/ew0Hmnco+lttp5v2orba81plW3DlWHwaxk3xlP306aPZ62KHuyghOSa00dqxIrc1mbiCi/wVyqj4zf/wZGgHgr40pz322/KO/fm1alRfZlrz7SiyMUKL0RRPacqw8RhNc1dO7jdJn+RhvNmJeuJgWxfXnqo3HOjk4HxxMergBKdu0kGsJBbNbZBnS11htfGcPJ/3jU6gmsGxx+V575qe75DRnBUkBRMURKzXximQT5eWXzgEVk4zlk1MaFkAZk0bGqNkoaSKdRE1ck0BQ01RElrUpSpVrARGRF554QgROulzs13Xq9RhhlBYUYws9yF1VNncOKUc9mYR25ycLm78i+v/pOXDvKjNNOZVNt7LpW1ETdaA86SgpXzSBnb5OJrMGA2cmbOElFE03YMgowJSdYfFBvTwZuJEh2iaQv8Uwx1iGTaF9ismU1yizlwpVJAn2/Kt0GC9lwUzp0KoQYc0IESKgLzNFDfzKWc8+Vq18ZFzqaz9Q1DpU13P5jOz0yJphxMUJiAnFhuBPVRAUEnAJluOuGtxZe68fgQAKeGKFBB3vi0OSihxFYE5edOGk0LGmxaPGgGmpK0bgnjacO+FgEvFBKBKITz72yWc57Km420Nv/QNV0UEngHbfZPk+EGkEtboAwCbYRBeP2CavzkMRHkMp2+RGgChaah/MpM1Da7CEugDhHQhLwE5xiF6uih9//2jKwO2Y19YaJ91UxTYqs8/GUWZ0VyHa0H8Swv3ZdWHy5YNfbruj8qdk2u+yq13qycjaGCP124R8SvxngQ8fp+2SmLM5/r3/lt3x+XZp4oZ79ixzUvgA/mQlM00WXkEryQGx46cfJTy2fvzTCmlJFkAjHUpp5NTZuEs66HwmyAGpKwNiVa0zDXQ9QRnDdynlnZSXAWfNXpWjfTbpcGPXR7sVOkXqHdQnrb4CYoZkEFTp+m0yeCltLpWay1Kr7r1qM/dtvj2bhcCV3jKDqX2ejyzgtl3kpn0QiCkKbabxD2u25+xeCql9Ta7EqgxgzsS028r0WLFi02F1sQATdmZExgBzA6CLNX3/nKJz/2x5XGwBNTVXXRIGYmppeZjDFaqWUwoX3ZDNTV5fAJnyY9yVbTw34xxJ3PXvKhl0rU/VV6CRlcfqhSz7DKOg99Lh5bOi5W7Nh7gEpnbOBoZojCRdA4KqvR8uHPnD37SO5rM6EkqlEpKmqnao19rxhMpsYJZmIG0akGlhmDwMTeGTE8iyMmr+zJMQUvgad5XihE2KZvxSpSrqA/368XhsurGBqyvJY5thXV/Puf+ZnvvSGVo7CcsSJ06tDHkZLmLjNFVuuaJ5hCoYkBMl3Q7Prt+5LKtI5lmrPj9lZp0aJFi6cZAQONA1JygCcYWGOXdz6zu+/Q6pH7B3WpEo2KCpnCWOPlCvl5QoQugtntnJ29g7XD1SFOi33tpxMPDbNdK7M3ZDZixdB1giAvZ2oDM40w85u/84jr5oFvdJMBE4MqJYW5IN5NasTTy6cfXjn5YE5Dn0qSRObMwIhGNScB1hZp1dDIWZlNO8zNoOaYwSBHcKxMxs6CM/ZwTpk1BMpccD5lgb1TJtVEGmBCYrnjMDw2LA3jRUgXxDvlyGm64Tuvf+wf3jqcq1dO0+4QTxUSK2wfc/dyHdYY0YA4FUGXabYH5gf70d1GTdXDVC2gqUFu0aJFixZPKwJesygBKHn4aKB8YFpve84rFpdO8/CQV6lYExuZscnlLhZpnNEwTjxi6q1O9m/rzIvlyyv3uHF3EJfT0SPJXzv22zyveDqOUHI9R44iyuVxfv9nauuPs3KuWweLpbmJ5+SQ+8SBJsOVz66evCeks46Sacx8oXUyiKEmitTIOE+bjtb1pVIjBuDIkyf2Th0pE5Gj4IyJQiB27L2y48wl78l5DkGDM8fKMEwLu/JqaSV2ICXcjjydItc9jV0/sO8vv/sZx3kye5x7OZ+ZKetEHLMxZOBp9fLOi4oS67SRRMnMQAY+cMPzYLkRK3RaG2LM1N4pLVq0aPF0jIBJQdZU27tG3o+zDIPrX/K6B975q3NFkUTEIkzI1OgyjUrUQ5K3EQnIiqW6k3evq3OdPXmyFp2bfDYezYcHvixqb85OR85Qq/kq2iTPZq3MkS10jPzqKhwbalBiDFkkpdOjMw+46phDxQaAUzUxdWZmnAgiUZ8yyTBmInKZkRIROWdMQmTOIzg4Bjl2ToMjF+Acec9Z5jIHHyQ4lwfJQl50ElMEUi1VDJ0iTmrPcbnqHcToxM88+5Gv2Fv26oXTfnuRFmeqk2fp+iU/M0jHZ6sTo5BfXgSsMZGPRAwliURcWdab373t4I0gJmiY1owSCGRAy8EtWrRo8fQiYDfVFALAgPFa8VtC4Yvdz3rF193z/t8tMjGtiVyt7C/TKUz4rItg67KZ0JnkrKSeZLdv23likh32y/d3JvfZ0vZ8sNfVqNBPOubgNcY6LvtU+soknsbolK7V36uVxCsLiw+Mho95t6rGimY1VM0iAIgCIKI1kUcm5mYPEakPICJmIqeOzHnyTp3zzokjzjJygZwj56Xw5IOFjDLnisy8V+cMJGpiEYEnI9lNiyeza3x1+tde+OAL8yMr9c4l2yFYzOpxqXOLHVatQ2UVjy1d3qmMkEQsFGHCKVnojdB/xm2vADV9igqgiYkJLfu2aNGixdMyArZGAg1r6kIeamABC3puz7Ovu3Phic+8x6dVuEJ4AJlcZnhdJ8vIgpES1wJLZWTqPpnmOjN9pZyWn+gf/wTSjcPO7shjg0xqdsmCRxHGo0kW5UwdT+fWJ+vCAqic1E+Uw8cYI1KvxkQOxqBErERExjCvQQloFGXNMZEjZhDBG8gpM9gROziGD+xYgzPP8MG8Y5+Z81p4Dd67QjMfMxZCFcXA6hyIYdVeOnHcDr6od/hnb39g1k4tUb+bliaWe10ZaRExyOsz3VSZZctZnl2mXjlBhZKB2SKTLk/q+RtuzvfeKg37moKY1uypCQltFXSLFi1aPM0I2Ghqjt3ojDT+tgQxI84Z+eyNd2QPf9DJ2VpiLZpdbjGReeUoFAXOUpYBLo0Ld3a568Y1it4z99Pg6tP3PXH8+OJVB7M8MrsEMJyI3PjMgx+575ShrOqVftYjy4BcQOPRacMwDz7F4NgZmJyBGqcQZQuwrPYR4EZHndgTEZEDM+dEREzemMw5cr4Jgi0QvLfgyAcL3py3PCA4UG6eE2spYsRGa/7lmTsuB/7e3qPff8MxGh+vguVuVKuLXM6UrvSibmluUie21azMa9bLP5VCABJpncyy7o4bX/zKBcln3Zqvqk5FDXiqHNQScIsWLVpcSWyBGcOlUAG5GQhAfeSB9/9GffyhrFxd6u3o6CRoFISKO0qc22qhwwrzl8cubGxgJGfiJHKK5Wi1V3RGvVm1HqNKLj46+Yq3/fh7B7PUPX7ADrxsrnd1BivLe04vfcBh5LVPaabMKqJ1QUZaRyIhODgmImIHJmaG49LDETN79g7M8Cye2bvodsMnygxZYVmHnHOcYOUpnzFzVAcKXK9mSDGbExvcSJ/6327XV+Hj2+PJlTC36rblUs7I2RW3/fKOssu81d4qTPXwPAHOUjSGy1iqnPSUbbvzjf8433YwN90CJ7IWLVq0aPEFJWAFWAXqYNAa9Zl73vGLOj6s5gwO5gEwEiBGMDDZ5a1DCjFDCeZMMwCpZjKIlp0qpavUOghHh372d95/42+/n+uZx/vC1H0Fz+xbrj6iw8/l1TaxbsxXZ+NknYAbpVJmJiKBTUmX2BwbEzMT++iJmZ1z5LwyWQgUPILr+qGyN9+BKxKFiQsrjiZkcF2oIY0LKyvuGIWd8cjXXMdvO3jElo91MaKQLVOv4k7QmOsk0/qyzzGEoUIs5GCeDWwqjlwah5CvurnnvvatnYO3At0yUeHb9d4WLVq0+OIn4CiogOBSDouoH//zd/zc7PKJkrs1dRxiV1adydh3xtzvyegy396DlAwE5ca+TY1Mk9NEPlJw0suzYyU970f/+8yH9eSuFa4S+SwQJ9R1UOcQwZPa9wEQkdKUenEuDCY4Nnbm2YjIMbGHY7Aj58gH8U69h3fkw7CYB1WJRolSUgdzDHigDN28WrBitqLdkMlrtj/xHbseuFUfcpPVqrtjiWdqzoKWmU7YYKDLpcdMKyEW8krNSjyzNQvAPOPKsyVd9Ypvuv7OL4dFJKpDL2vviRYtWrT4Iidgg1EUJCAnsBNAFtLq4Y+9/ScSBSX2VmdagrTiTsV5IZfnSKV0zm+pEVdmZjMj67BbSn4k8ZqeSJ0Or+x90w+8/fji2T4wdC5ILMAkblQ7CHf7MkazkE0EXlv0JfLcGFiSeVYmZUeO4RjOgx05thDEe+FpQdZyEFIhc4oBeAAS0FlgIU9F5eZh9cuKx77rpqVr689SHCXKIDzhTH3mq+VttJJrGSkfu/7lrvVmWiV2NYdGPd+rNWKv5vJhWd3wgtdd98q3TtDLAEZMFkIbALdo0aLFFzkBY2IIskYnbt3zfPET7/7V/9jVoaQJZ0Uiz1C2CLu8Plejje1PWPe0ISBPMK7HWczqnYWMV8NoMbzulx7PP/6Ro0LbNEdtE88uR/KyHLF7vePI1tjXmDz5Juo159SRMYE9mJBlxqTslFmcUyZir7C8ThMfEAg87sZVp26VdsDtYjn6ivlTf2fuoefQQxzHQz9TU+5RqXUYKVjlrQI0UTHhbuROR4aXeYbrRFmiQEiuHvUCpQj47OxyuvlVX//MV34duJtQVIAHckyATntXtGjRosUXMwELRhtcuqcOnWwgPY3JsT/+hX/lbJzIC7lMq1wnCZfpAEs1pk6bjY/jdIPMZTaEzFXZilIRqo6zJxzNL81ddffkmW//dP+Jk7yrM8qqEyOdW8Ez8uzUVHGDCUzrHAywMRGzeUbT8ktEjuEzEAlDp+rXgBkASlUXk0A8op0xzYDGN3Yff+Hu1VfRo7twJosr0Q0E1pdlNpm4vlfxVjmkmkPJnUQZm2Zau8s8X8KaKAixt2rAcTIauu6OkYY7XvT6q1751gqDnBJAY3gGipaAW7Ro0eKLnoDT1Ni18V6YcqRCAXa6jNVDv/cLP+HiMlvkv+Yf1sSsT9mpQBb7KT8G7bo0pzxJvsoJoUxjdz27R1Nn71+c+bL/cWjPcReQ1E9mXOeoEYzICMZrETBRo3xl7EBE3hm4+adz7qw0tbMlKIME28EOIe1xx94wOPJSevgaPkXl0lxWLUkuSpTKOp9dcdtzneyIJ1f9TDNtSOSE2CF1pMy1HLvBZR6HdQKOLo1d1jtWFs/98jfd+sqvVnQjZR5wlkAmcAJu14BbtGjR4kuBgNVhCDhor2FhwzCizwBPFlmOvvNff1+hw0j5hPsZLi/1SnpxW8NcZCXrwC0NxnMqVTk3LuudHS1nJlU9SKssZH2mHSex7UHef++o+4mTB2zqPE6GcxycyIMJRGCCNKbxAK1bWxoMIHOm3igQvnzm0HXZ6WfyoZ3xKJdjYh/ZlFJCr6DKmSZlBwsWDa6m3KES8kIAKZsSYGAh7+zy3CqKlCJnkVywyJZWpXj267/llte9ZYxOx8SIa1ABhSzB5SvozbT3RIsWLVp8cRPwpTGE9WGAJdRPvPv//ldnH7xnz6B3UkDIVJDngE4IAstZc+W4qaNZyHaNuHeWdx53ex6rZk7Z3KmYr9ZwBgMncIIzMw/xUCZLLhtw3J8ND7jFa8Pirnh8my32Me7XC5s9pTFi2HTa4UwIiWCRHfssTspe7k8vjL7uO//p/J1fvej68+2136JFixYtAZ8HA7QRkY6rwPJf/MpPfebu92/jTo2R71KlnnSGLDiMmIdqvU0dzEAWknFESBQ46wBgMjY94/cISOESHAAPcaSesGv8MAAYK0EURE4JRBSxucldtqTEABtIGw1JGEihEpCSwAb7vukH/i3vu1ksN1Hv22RzixYtWrQEvJF9DUJQJMBnBtQV/JmP/7//7dF3/kro9KtEdZMHhjpjVlLe3PHXyAAYOUemEjOSDMkzIY6bnLCCmJlMWSNMymK3mZkJmUDNoKRiZuTDpo7TqQIwghIboNMmLJ539cLqpH/w1jd/309U8zeICx3AxSFCv736W7Ro0aIl4KfEv0aIUw8AOIWjMWg0ufu3/vt/+e8F3EyhdTqtZAl9sRlH400dThFXBV7ZK/kENnI01X2OBlKwEYsImXoGE4iDmZkkMgXQfIeJbnLEyepAQqaghGbBmFnBro6zN77oa/7Jv6swS0QBkJScb/WuWrRo0aIl4PMxgXVsahUAIDoQwaMexlOfescv/vPy2MMDLpJl6HdX06iDfHOHY6QbyIphU2ZFAmAblJOnXDut6GYjFnIKNjCAzKpNHWZEx6F2Fh1inoel4dgXvbLSF33D99/2mq+ONGMuywBYArFMG6RatGjRokVLwOewAuvD2BhApYiMLoxHQF+HqI9+/H/8/P0f+bN+kQ/r0rIs6OaOhi2tUa+uHzIApSsu+noFM0AQZ8mZOFNCIsPkMtuH/hoEzFQ7qwhS1YJiNnL3O777+8ubvza35FABbNQRwAGkERzaq79FixYtWgLeGHE24wKgNuU8D6BG9AhOgbh05GO/87v/42e3eceRbEtCOQUZsRALvBEpuC8rAAi6YeAMQMg1NNx4SADceCF3dLLZI2QIoMJ8emzX3fqyN/6D/x29XWPu5YCzCYyECwECQBZBLQG3aNGiRUvAGyAGEBgTgIF8uhSMSApjVwEOHKpVyOnf/fHvrE/fl8KezR0PEcHYlKBkuubWi0ThogTcpKYvNq/Y9CpoIzVw5fJXv/Fbr33lm6Nurz330qK6XqSMgKxxl0KowXl77bdo0aJFS8B/NYwMXpEDIE2MEjS59y/e99Gf+bZdB25aqDAxokxzskxdpjnZqhGaJVgj1v9V0dGliqkVl/hNkktE8BcPydeZ+6/4/k4KUG0cQQkksMaQkY0rQQ7LvWqQ0jTWPos+75Vnxn7Otj/zTd/1ozNX3Spgdy6X0KJFixYtWgL+6yMaGkM9OMDShJxASmj1rv/wI6c+96E5FlROeZAcVy65qRIWYxqkNqqUn6dr6eKSl5dmbr2s97ncbqm1z13/FG4mEYossxFRrDhU2UyM0quX5zF+sNrx2q9+03O+7lugfQuzU+Y1BXF7lbdo0aJFS8D/H7Cm7awAFI4hVemCX02TgY/L9/zpB3/zF0YnHyl6ncXSXGc2Wdb4AQPK0PVfZbs84vw8FHmF3ucS0w2XAGb1AJGesyDsJI6s0UdxdVWVnWJmPLTrn3HLa773p/xg1gTwnbVCMAUUl2lf2KJFixYtWgK+gIBp3bABDIaCCJGGAQUiwZY/+763/8Uf/bdcxgX7CfI1rtW1mJL/GgRMlzo8dIn3sYu/j11mJB2dsDkyz9NQXkEGJNY8MYzUW0nQ0s2+8i0/eN1Lv7ak3AMEqKmn9bgfhDYCbtGiRYuWgC+LcJ86MAIZxEgUSnCAayjTGYw0AgzWUZWF0b3v+Pef+PBv5RU5xwwyiBopsxr5vIgxrr85Ea1vNyVUG/evfe4lh3SZR/riDLxexkVE5306G5MRg1KKHAwuMWNZsx05VQsroX/g1d/4fTtvfzV6c2aWyFHTpoxEoEanWvGULumN4ydqF4dbtGjRoiXgv1IAHBs6NMBgCgJ805SrBiWQIhDi6GzRQzr75H1/8Msf/csPI1WZJ4m1C15A6wuiG//qZlvBFz0UV+r4PIXUN2w37cUX/iupZyiTkRl7mqQSwTnvJ9UZobkXvuqbXvj6b5ViT2TnvAYveErJFRm8NPaLG/6K9U8xs5aAW7Ro0aIl4IuQ3DphTMNTM7XalAA2o0ZsWWGACgTaIQ2GErQS05isJ3V/Z3E8rS7e9f53f/yD70G90vEwiSklcvnGj1j/6IbBztsJwOyvT1TMvOF95KL73Vp1dPPHrvMiIYASIxFrFGS9ubMr47m5XS986Yue8/pvnPRvGKcss1hQlUyTyzOrm7cGOWbPjV2xmWd3Xqx/IfW2ZNyiRYsWX6IELCLnx6OqtgGqqhCoM2UomZmRGmozsZLElQmVmCPueM3qauxQl3kf1bCvq31duv+u933wPb9PaWyxhs/PI9rme7oYKwNQXJnjwxuS2RsJ2G+IgNf3E5EQMxJzMgC+UJp59evfdOcLXnao+5w0PjPXp4RYcwCFHJqpIAQlBgWCU9XMWWBi0wRHRA0fN9+bjY1jaAm4RYsWLb4ICXj9/dfDWaylQBtmPRfjbiDd8/Y3WN+//sqNG6raMPfaq8nM1BKkdjruu3Ti8MN3feD9k0MPxFip1SnFoihEJCVRReULQImICaRmjZeRGSxsHPY5Yqb64gcUxZS4p8SmDb05qgEYgchh6lHoAMAckTFMU+x1i1SXEmMIYabjF0Z1if41t77o+a/+qpk9V5fsE6hrgdewkU3P22jonNZw3uunWe5LbK9TcpuybtGiRYsvBgJe//FCor3U9vr3jThvv4isbz9lpyY1S2qq6p1RKuvxirPUT+OHHvj0Qw9++vSJJz0SkwVC8ybMnFJKYkROYKakMDHeOPJzf8il+Kh5PelaRDtl4oCs2Wh8kwAwgYi8r5vpArEjH4h9MhhodtueZ93+3Bue9ZzQ3zGMoLwD55NpzhkROeeccxuZtfnROXchMa9vr//KRmL+PNsbo+QWLVq0aPE0I2BsyOtujFYvJNoL/+k8Ar4o6aaUziNpEVFVl8ZRqVaKxj5k4/E4xdpM0nApz1w30GT59Oc++6lTTx46e+JYrCadNAE7YidGUVSMFKQGIVw0Ar50f23aeHR1LY705h0RoGwWnDHMkTFzoEqIlPJEoeYwv+vAVdfdcN0NN/qZgyAWcyEvRCTLPJPleTD4hkrP4+B1it1IyecFxxcNms9LTW/ccG66ftyGvy1atGjxdCXgBs1a74Vp543fG3K9aFC7vmd9W0TWyXh9f0pJRJzW0Swm1EpqALiqqhgrBTOELUo5RD0ObBbLkyeOP/apjy4tLcUY14c3nQrwdKhs+pSI8FISWRskr9TE1qjLYZqyfmrK12AddmHn/oM33HL7/M4DnPcSHIUshUEIwXFwnhzAKsHDO2KXrxOw9/48Nl0n3Y18fNEIeOP2eTR8YRzchsItWrRoccWxdTJJzaO8yfQ2FIunLgyfXwa8Fng1v6g65b9mY2NMts6Xza801CJibMRImaomMYmeo3irIaoqAvIdsVBCkuW9Pf3n7r82xXo8XJ0Mlx6679P1eHUyHsaq9DA0tcpNStYU0zXRdN4A1lgXRERwxiRJwWtrq0SSrFKFy3zRK3qDHXv2HTh4dch39Gdm87yj7GofiDP2Di7kFFmFOJIFco6csfPsiIkvDEkvLLC6cE33wl/5PCereZONqYs2CG7RokWLp2UEjA2FV82PGyPX8xLRF92/MRG9MQV9qe0EgqhKVImQBEsmIhITSBVJLQmJQhVRRVVLqdiUpDapvdYO4kwkVpPlxZWVlePHjp06dUJTFJFUVykl786N9qntRkxwzAwmMyPnnXPk3N49183Mzs3t2Nmf3YGsyHsDuLxOIuyyLGNmx8wMZg7smDmjMYjIB3YBxHDsXAjsHJ2LejdGwBvTzhfmnC+Md5s9F80/b2RxtCnoFi1atHiaEvCF6kvnLQlftAjrwlLny/p+rgpaompSS2YmktbeE5JMdBpPq2qyJAaoqCqZwJqNJgMdsSZg6Zgk1nVdS6y8o/UceErnouHMZeRcCMEFzz4zaxqJmcPAlJIKwD4rQM4IzjnypKpscJ42EmfehNLekWMDmL0jf9E13Ysu7l40vXxhqvm8tPOFpNtSb4sWLVo8vQn4Us/x9fTmOn2uR8kX9hptbDe6KE+vdyKZWdNEJJbE1MhFqCjE4BBJScRM4GAwEYmw5MACE4WCFF7UjMmUlMTMyIwaJQ0VMmk4fH1WsfEYOuemIwO74KWZB8CEEUIgU5PYCYFMYeIcsThmJufFzAzUaGg4thTIMTMxw8wcsyP2xOZxIX02IfjnIeCNhHre6y/ahvRXP4MtWrRo0eJvKAFfLp7S6rO2uHte3Ly+5zyS3pjiPi+eXsd55L3xx/Pef/1HXFwhyy465qemo88tnW6kt3X+W2fE83jxvH8672WXen2Tfz7vnS/1npeSxmzRokWLFl+iBHyp8WwkiY2Ed2E0jKeuN29sIjoPG6Uuz+PajYO5RBvSX/kQX6jzvOH7OkmfR7fN/gs5eCOzrtedrQtpXahv9XlyDy0Bt2jRokVLwH9VMj6PtP4qv76RaNe57UJOvTCivZCJLyy9/vxkdt5vXbQO+VKSkBf9rY2F4he6J10Ydrek26JFixYtAf91SPdSFgLrkd//klEutB38a9PPprbifH6Cv/BzL/X6C//S88i7Zd8WLVq0aAm4RYsWLVq0+NJFq3DUokWLFi1atATcokWLFi1atATcokWLFi1atGgJuEWLFi1atGgJuEWLFi1atGjREnCLFi1atGjREnCLFi1atGjRoiXgFi1atGjRoiXgFi1atGjRokVLwC1atGjRosUXBv9/97jA3BMaJtUAAAAASUVORK5CYII=
const char index_html[] PROGMEM = R"rawliteral(
<!DOCTYPE HTML><html>
<head>
  <title>SUDU QS10 PLUS</title>
  <meta name="viewport" content="width=device-width, initial-scale=1">
  <style>
  html {
    font-family: Arial, Helvetica, sans-serif;
    text-align: center;
  }
  h1 {
    font-size: 1.8rem;
    color: white;
    text-align: center; /* Aligns the text to the center */
    margin: 0; /* Removes default margins */
}

h2 {
    font-size: 1.5rem;
    font-weight: bold;
    color: #143642;
    text-align: center; /* Aligns the text to the center */
    margin: 0; /* Removes default margins */
    margin-top: 0.5rem; /* Adds space between h1 and h2 */
}
  .topnav {
    overflow: hidden;
    background-color: white;
  }
  body {
    margin: 0;
  }
  .content {
    padding: 30px;
    max-width: 600px;
    margin:auto;
  }
  .card {
    background-color: #AED6F1;;
    box-shadow: 2px 2px 12px 1px rgba(140,140,140,.5);
    padding-top:5px;
    padding-bottom:20px;
    margin: auto;
    justify-content: space-around;
    text-align: center;
  }
  
        table , th, td {
            border-radius: 10px;
            border-spacing: 5px;
            text-align: center;
            justify-content: space-around;
        }
        th, td { 
            text-align: center;
            padding-bottom: 7px;
            padding-left: 7px;
            padding-right: 7px;
            padding-top: 7px;
            color: #fff;
            background-color: #3498DB;
        }
       
  .imgbox {
            display: grid;
            height: 100%;
        }
        .center-fit {
            max-width: 100%;
            max-height: 100vh;
            margin: auto;
        }
.button-container {
      max-width: 400px;
      display: flex;
      justify-content: space-around; 
      align-items: center; 
      margin: auto;
      
    }
  .button,
  .time-button,
  .engine-button{
    display: block ;
    margin: auto;
    padding: 15px 50px;
    font-size: 24px;
    text-align: center;
    outline: none;
    color: #fff;
    background-color: #3498DB;
    border: none;
    border-radius: 5px;
    -webkit-touch-callout: none;
    -webkit-user-select: none;
    -khtml-user-select: none;
    -moz-user-select: none;
    -ms-user-select: none;
    user-select: none;
    -webkit-tap-highlight-color: rgba(0,0,0,0);
  transition-duration: 0.4s;
   }
   /*.button:hover {background-color: #0f8b8d}*/
   .button:active {
     background-color: #3498DB;
     box-shadow: 2 2px #CDCDCD;
     transform: translateY(2px);
   }
   
   .pushable {
  position: relative;
  background: transparent;
  padding: 0px;
  border: none;
  cursor: pointer;
  outline-offset: 4px;
  outline-color: deeppink;
  transition: filter 250ms;
  -webkit-tap-highlight-color: rgba(0, 0, 0, 0);
}

.shadow {
  position: absolute;
  top: 0;
  left: 0;
  height: 100%;
  width: 100%;
  background: hsl(228, 15%, 38%);
  border-radius: 8px;
  filter: blur(2px);
  will-change: transform;
  transform: translateY(2px);
  transition: transform 600ms cubic-bezier(0.3, 0.7, 0.4, 1);
}

.edge {
  position: absolute;
  top: 0;
  left: 0;
  height: 100%;
  width: 100%;
  border-radius: 8px;
  background: linear-gradient(
    to right,
    #1F618D 0%,
    #55a0d3 8%,
    #1F618D 92%,
    #55a0d3 100%
  );
}

.front {
  display: block;
  position: relative;
  border-radius: 8px;
  background: hsl(248, 53%, 58%);
  padding: 16px 32px;
  color: white;
  font-weight: 600;
  text-transform: uppercase;
  letter-spacing: 1.5px;
  font-size: 1rem;
  transform: translateY(-4px);
  transition: transform 600ms cubic-bezier(0.3, 0.7, 0.4, 1);
}

.pushable:hover {
  filter: brightness(110%);
}

.pushable:hover .front {
  transform: translateY(-6px);
  transition: transform 250ms cubic-bezier(0.3, 0.7, 0.4, 1.5);
}

.pushable:active .front {
  transform: translateY(-2px);
  transition: transform 34ms;
}

.pushable:hover .shadow {
  transform: translateY(4px);
  transition: transform 250ms cubic-bezier(0.3, 0.7, 0.4, 1.5);
}

.pushable:active .shadow {
  transform: translateY(1px);
  transition: transform 34ms;
}

.pushable:focus:not(:focus-visible) {
  outline: none;
}
   .state {
     font-size: 1.5rem;
     color:#1F618D;
     font-weight: bold;
   }
.input {

  margin: 30px auto;
  background: none;
  border: none;
  outline: none;
  max-width: 190px;
  padding: 10px 20px;
  font-size: 16px;
  border-radius: 9px;
  box-shadow: inset 2px 5px 10px rgb(5, 5, 5);
  color: #1c1c1c;
  
}
.input:hover {
  filter: brightness(110%);
}
.clearfix::after {
  content: "";
  clear: both;
  display: table;
}
 .blurred {
      filter: blur(5px);
      opacity: 1;
    pointer-events: none;
    } 
    .image-crop{
  float: left;
    max-width: 80vw;
    max-height:13vh ;
  margin: 10 auto ;
      }
    @media (min-width: 1024px) {
    .image-crop {
      float: left;
      margin: 10 auto;
    padding-bottom: 15px;
        max-height: 20vh; 
    }
    
  </style>
<title>SUDU QS10 PLUS</title>
<meta name="viewport" content="width=device-width, initial-scale=1">
<link rel="icon" href="data:image/png;base64,iVBORw0KGgoAAAANSUhEUgAAAB8AAAAeCAYAAADU8sWcAAAAAXNSR0IArs4c6QAAB01JREFUSEu9lntQVNcdx7/3tXv3AawsyyKLiKAhwYriA98PNJqkLWoyatRkarWOsXVqY2ysVZOgRjMxiTFF1NFAiEWjxhgRqZOJFKWEaTDiI6KosYDKAgvLvu7du3ufHcxkJtPxsZC2Z+bM+eOc7+/z/c6c+Z1D4CeM6FWlA8086XTuzQ32pgzRG9EPGv3iQ8d1BPmnQNG8672p0yv4peXj4mdWjjPxRvMtgsbLHefy/vJ/gbf9MTM+6BU25NT+tkEvmwt438WGlgQ5E+f3Sj010KPkDW+nR8V0iGeDHvLSRKJYiQqrv/E1nIWsyK901m16/38Gz8sDubJf7meKm5/tu9pcnJ11QrMz9OKuyq8Q5oO8StJZ/pPLb/bEQMTJvfsmrDflfvCm/0QBuqqrTmbOLL+S8rhtrbewFjwfhMpxdXE6ZXxT8eJQpAYignfkZyVGTVp6S/fEQtZ34gN0Hvv45uAnT21KmZ/2V27nZXD+IORQCITHXcwXzl/8X4VzJ2atMmYv2w5DErgL1XDtfUf9/ZCNIy8umltnqO2E+19ehEQZZIAD0+Ve6d/9bH4kBh6ZvP7IXN0Au/ko239ULnQ2hNs74HxnG+Ro4+inV1TvN2hEemuNG7wogmAY6JrvSJTXPcO7Z+6ZRxl4KNxdkpmkl0I5dFrGZiY2tT/BxEDiRNzZfgCkxTD5+Tl/n2kcFru6/ngrOFGBrGlINhDovNDQrvP7h3cWLXA+zMBD4XxRyi6NoJuZpD5b6Kh4CrQZokeCs7gOSow5Y+Uzp+xJE+Irq6vcaHGHwcsqBkQx6CsGcfnsxQp/csMM5OWpDzLwQHjg2Ix42nuzWVapEtbBLyUYA0AZEWxS0X5a4InBMU+JxliqaGZZ+fWusPl8QwAuQYHdQGFiAoum8zdw/dy1FZ6jy3b1GC4cHbuW5G+/pYrUHSaJ74dumwTgqTWgq54pNQ6iJSaWqsufXjNFMOtmlH/twV1ehoEmMN7OYpSFwu78cg9anYNaKta572fggcmFQ1lXSKV9MEgNlFlG96ppQFu5CTzPbo5KC6+nY5nSt0Z81ZCUHvPn/ZUduM3JUDVgdLweUx0sWupu4HBx5ZsdVWtfixjuOfVyiv72qUaS4kGwCghGgwZADRNwndGDtKHenKwMFqG/svlnNTtSh1o+3F/hwu2ADEHVMDJOj5y+LMbGknhpyS6XjWtKOn+f3n/f5NzReQvIptqDBK0B3ZPRoHIkwCrgmkiY+quQVRIiQ99Zn169qt8w69FPu5P7ZQiKisxYPaYkspjhMODjd4/hzPGaqS3Nuyr/M/194YE90zaSrsbXodNwzwClQREISBq9jjVLW7tFIZmAaKSu/yG1eoN9VOyn5addcAZkiIqK9D46TO5rwHQHi8bT5/De65+sb2nduzUiuG/rhJ2Up20F9N+nJk0KRJkqjAn9ahmn219Pktrj3Q1cspDlLzjOfGmdaN9RVdYKv6AgrChIsegxqa8BTzpYENdu4tXfFe5tuVvwUmTwNWN3w9O1nNRrIBMkaGb1GzKNXEH36TeEK3P+Ukdps4MmDYSVevXptH8MYzItLzSWOREIy5AUFfZYAyYkGDDNwcLY2IjVq/Z/1Hb9vSURwb2bxm0h2nzrCFoG/URIUCnTOJ2j8whhtBX6DsnjaUbNFRJlqdaeM2TV0He/NjBEjLumExwfhEQQiImLxpgEFtMSWeDad9i8rWx75zcbV0cE9+2bvABu30HG5Ad0WoEmwaOzBzeo0dR8/5Ho12SjPBgJKHrMceo7y6zkrXRFG0JNPvCBAGRWD0OCFcPjWUxNNKClqg4lf7u4xPvFKx9FBG898ozNKHe06HkXo4Kaq7QQ79M2KSnEsFnBK+Q5GVLnlgHLf1GcvahyUIop2ltyA+B48F4/1LhYMA47MmzsvRv/5aFK7VKbkCwcePFuRPDuQ77ykQf1zvYFssy8qHyrKyGtkubyMEPhDZ3jLNE/zx59+I3EOQMnkYcbEL7aDvgDEPwcMKA/6ORE9LMZMCIKKDlwtoovXjg54iZzD146fKDO1XlZU6idos8yC3fFx7wUmxhy+bJHZBTNjp4z4tfW5i54Pz8P8DzgC0AMiyAzM0AMSIbVZoTSeAe3mltniwXPlfYI3n2Y35eyjJC0N6RkxxbwYoHE02PS/7kml52Ss95GaHCXlUPzB4AAB3gDUPU6aGOGIzQoFTpKg7v+RplcMHtmjx+WHwR8fmoeRE2SsxLJjZ9lXPhcXFMabYknfXUlkL0dgCAAvAAoCmSbFUL2MAj9k6G2tX1rJqVJ3h3PensN7xZ6t6U9HwoxV0ftyxkZl7i0yN9VgbBw+/uaNAWYjIDVAjnBBq/VCpnCF0YhvNBfOK+r15+JHwsb86aw00uG6Lg+ySclCBMJmgLB6qFFmaDEREMyGSFS2mWK0N4Wdj73CUB0v0UPHY/8w91HTcTM3zNCMpiGyXpDHEhKJTXFyZB8baBg0Y1HAX+8/2/nVkNMaOWPSgAAAABJRU5ErkJggg==">
</head>
<body>

<div class="content">
  <div class="clearfix">
<img class="image-crop" src="data:image/png;base64,iVBORw0KGgoAAAANSUhEUgAAAJ4AAADmCAYAAAAk9DzXAAAAAXNSR0IArs4c6QAAAARnQU1BAACxjwv8YQUAAAAJcEhZcwAADsMAAA7DAcdvqGQAAKMQSURBVHhe7L13wGzXVR/6W2vvc87MfO1+t+uqF8u25IpsXMEVbBxaeL4iL0AgAUQL8EgooSTXguQlDji0FEyKSSAvj+skJJA45kEiU2zAHWPJtmxLsqx279WtX5mZc/Ze6/2x1j4zX5G7Y8m6Szp35ps5c8o+v736Whu4SBfpIl2kxwuF7R9cpM+AVOlbmmuuf+YLv27jz//gv6btX1+kncTbP7hInz59zT88fu077p8e//DG4NLt312k3eki8D5LOnbstvjR0+nYfdh7tSwvj7Z/f5F2p4vA+6xI6U+r86+4d1wdTUCo8qTavsdF2p0uAu+zoJf937+19wMPTX+qQ90oiBNksH2fi7Q7XQTeZ0Gba91feViqm1quIYhhOm6Xtu9zkXani8D7DOnlP/Ufn3DX+fyj4zCslBiKKqxtjFe373eRdqeLwPsM6Ojx4+H+tvvBsxheBmSwdoAoYzA6uH3fi7Q7XQTeZ0D3v7196n2b+KbEkVkUUTKUQR0NnwBV2r7/RdpJF4H3aZPSAxvhW8dtvaKaocKAMgTA5kZ6xuvf9a64/RcXaSddBN6nSV/+o8efcvrc9G+E6YQwmSK054G2g2bBpk4ue/sfPHzRwPgU6CLwPg266ZbXV/d+7P7vltQtYTpFGE9A4ylo0oInG5DNdt+ffeieJ27/3UXaSReB92lQkzavWd9IX4/pmHTSohpPQJMEmkxRb66DWxlcmIQbt//uIu2ki8D7VEmVTp2cHO0mfDhMp6gmHcJkCmqnoHaCMNmETFJsJ90LAFw0MD4JXQTep0gv/KZ/sefC+fZomCTmSUaYtoiTDmE6QZiMwdMpME00PX/hla8+9psX/XmfhC4C71Oks6cf/NJugifE6Rg0UdfrOoRxAZ6Axwk0zYfe+a73fcX231+krXQReJ8CHTt2jMdnxkfRpgFaoJp0iO0Y6CaIbQJPE2jaIbRj5BY0vYAXHz169GKu4yegi8BzYP3hP/jhF9x27NiuPri33jFZmm5MXkK5pdwloBuD2ilC2yJMOoS2Q5x29neXgGl+3v3TZ11MkfoE9LgH3vHjR8PXbbznm7sHP/I1LwZk+/cAcO7jG8/OU72cuoxKCZwSuE0IbQZPE8K0Q5h2iJOEOE3I43xDN9l8wfbjXKQZPa6Bpwp64u30gvrkx/7xwTx+O9166y7AUzp3Jr0UKcSYKgywDO4iYpfBXQJSC+paaNeCOrdyE1UPPnjur99w9Fi9/WgXyehxDbx3/9RfvSI9+NFfoqwrdPCy923/HgBe9KJva7qJPp+6QENaxYgvQYUlUCdASqCcQSkhpAzyjVuBdvxcPHD28PbjXSSjxy3w7v75H9xTn7n7Xy6Pzz5tUjUfw42X3bt9HwBo23Aotd3TgwQMaRUNDmFQ7QMEoK4Dd8kA17Wg1v6OXUKeymVpkl8NXEwa2I0el8B75+tvqaZ3v+dvD9pTL80QqqvmnTfefGu3fT8AmGzUX46sK4GGqHg/AhYx4L2oZBlICs4JnBMoJXDuwKmFpgRO4MnpyXc+5znfcTFVahd63AFPjx8N/NH7vyOOz/xwndugRBKgtxOg2/e95ZbXV2fW89dqWKB6sBehWQXCEFVcQVPtAzRAskKzQMVfc4bKFMgJqYvXbGzIq7Yf9yI9DoF3x3vHX7m4/vGfHuS1AQuDlKUDHti+HwC85z13L4vGJ6JZQrV0EDzcAzQj8GAP6uEecIggIgAEUgAKqAKQDsgZmkO9to6/efToscXtx3680+MKeHce+5rnNmsf/5XldHZ/oowOEYS67Zr649v3BYCJjvd3dTwkwxF4+SDywgh5oQKGC6DBCFxVCHUNriogBiAwQAySCiQCaIduMzz9g3/xsb9yUdfbSo8b4H3kp7/uqfXaR35jKOtXdKggVEEJ6BDSeVSnt+8PADFWV1cIe2i0Alo6CFlYhC42wMIIOmwgdQWtamhVg6oGqBogVkA1BGIEWEEUw/lz3Y9+2Zf90EULd44eF8D7yD//7oO08dDrm27zGiGFUkQjgoAJOkhuA022/+bo0eNhXfibc7Nc88I+0Gg/dLgIHQ5Bw0WgaSBVAHzTKoKqAFQRuWbkOgDVAhADEi9e++H712696Neb0Rc98O5+ww/ukZN//i8W2vufK4iErAgqEBBYFYmrdFIPjrf/7vfu+7PLHpb48s1mhLB8CLK4AIwG4OEIulADA+NwUkWgiqDIQIzQKkKrAK0qgCtojJDYcJcGR89+aO1Lt5/n8Upf1MC7+w0/uEce+ItfbDZOf70gUtCMSgBoQuKATAEtV1285NK17b/Ni8uHUQ0WOdbghRXkxQYyjKBBDRlG6KAGqgoUK1AMIAcgYgXEChwjUBFQRXAVUcVqz0YrP37Zq1833H6uxyN90QLvjl/+ln1y/4dev3zuY9+0mKcsqAEFSDMABQmgCJhqHI95dUeHp8DVIcRQo2kQlhcgwwgZEGhEoFEAhrVxtQK4KgIxGIerIqSqoHWExgiqDIgV+GVn77j367ef6/FIX5TA+91/97cX+MxHf2l57cOvzogBAGrZRCZCZoYSQKoQJXSxuRAOHtzhPOZRtU9CxTIYgpdG0CEDQwUNAWoYNGyAqrItVtDo732TAsC6gjggG41NHaofue6bfnF5+/keb/RFB7w3vOHYYM9Dd/7MYnf6rwRqGRB0FJHBUCiUBAIgqABgSKjOLSws7ACexnof6poxGhl3GwAYCGiQwUMgjgZAU7lOZ9yucD6K9mrcLzgHNDEcUD3zgTsf+gEcO/ZFN/afDn1R3fxtt90Wrz39gR84vHn39zUYc6IKlUwRVKAIIFUoeM7TCyCE8zfffHPefqwY4yJiBR6OkEcV0pAgQ4GOFDok0KgG1ZUZFDECdT3jerEC+edF9GoV0Q0qUKgwyuG7972lvn77OR9P9EUFPPz5r776is0P/dRKOlMDAVyApoogAip4U4s2QAmkusOiBQANcYSqIgxr6DBChoCOGBgSMARoVIGaBogRHA2AqCpQCGZsONcrnE9jBakjUAdEpUu76ebPHPqKn13Yft7HC33RAO/N//qHnn5ofO/rFvTCklADltnNGdY8cKACUoIQDHxEm3OHmVGMA6lqYFABg4DcCHJDwIBBAwWPavDQgDcPMMQiat3H558hBBAzEAJQ1SBUrxrr5Gsfry0vviiAd9sbju05cuaO1x1p7zsSVTClIRgEqEKLSJ0jD6vad6Q7LFoAAMcagYA6QgcEjBgYAGgI2jB0VIFHA2gMfbjM3CoFcM71/HutIohNz+uqClWoRzrJP33o6M9dtf3Ujwd6zAPvj//VjywtnXnHvzw0+fjLIBGcCd2efeBLr4G4SN2KPYYQeSqKQkG7dvHUiknrAG0CdMiQRoCBAkMFhoSwGMCjxsRnMSoqA57pd2bpaqyglRkhVFWQWCE1FYgrDLS+dvNM9/dvOHr8cRfReEwD752vv6UK44/+nUP5nq9rdIwKwNrCQex90V9Bd+hKNyRm+tzWOmuDnojs6tClEDvx8Jc2CnKrlgcADwk0jKiWF6C1uU7MpRJsq0zP08gexQiQGJCqAKmj7xfBsSbK/H/ct/nANzzekgge08DbQPraw5N7f2CpG1dEgnPVAMvP/xqMrnoWlAaPXM8vAClAKoDqru1jNVCrzNDIyA1BBoAOFDogyICAUURcHAK1AY4ig/2VHHBUBSAyEO044n/HYKDsqoAQ6waT9jV7X/1Pjmy/hi9meswC73f/+d94yiXrH/mllXxusUqKhBp4+ldg9JSXArEBaQV1bY48y7NU8hAUUAYBCF2399guZY1UNRONDImANAQpul1jAMSQEZdG4KpG4AgKbkAES5GiEMyQiBEazMAoHJGCccHyPlK4vl1Pf/+SW17/uCmJfEwC73d+8ycuPSgnfm1/d/JI0CnGVY3pFV+Cw8+/GdocBHgAqYcuXc2HIqQOPAVBoBSgUNSp3bN8ww079DzmsKExGmorhTYE1AweANQoaETg1QXQwMJhUkUgVJapEiIoBnCM4BDBoUQ3IiRGdFVw7leMj4oCVd94/qH1b9p+HV+s9JgD3pt+/djyvjN3/uKlm/d8yShPkBGxsecqrL7kryEPLwUzQyMhNsNet5PeX6ygokq5xUGSF+NDd+wAngaco8AqIlAWoCbkBtAGoIaAhsDLI2BhiFxFSAyQyJBIQGTz54VgnDCyW7gz/c5AyMiV63tcD0n4Hyz9Hz/7nO3X8sVIjyngqSodunDH9zxh/SNfvZQ3SWiKzeYIDr7omxAO3ggNDZgiiBdAg2WImnFBpMXE8H8Zhf8R6WhxvW22nQpJ9AwCmb+ZFTIA0gDINYAG0AHAixXC0gASCRQiQgzg4O6V4r8rGSuhiOM48+dFi2RoDAAH1FwfQBv/wU23/PYXvch9TAHvT/7Vd7ziQHvXT43kfJMJWK/3Y+l534j6qhciSoMIBTRCdYhcL0LIbs/9dWY4KkF1BsZKc9WcObHjQVOg0xop5SwQEkgDtI0iDwFpDIi8UqNatmxj4gBmE60lXAbX+woQKUSEEE0P5LhVD4wRxBUC1S+948RdP4YX7dQ7v5joMQO8d/za9197YPOjv7Q3n1oUYqxXi8CNX43Fp3wFclwCBQKoAcIQiIwwWACUYfCaI4WbFwIWIKZU1+PJjrZiXPFpMHUCQdYEaYA8JORGgQbAANDFgHrfAqS2JFDEChoqIHg+nufmIcySCNS5YEkukCp4JovphuCaIocf2nPk4Fd9MbtYHhPAe+fxW1aW1z/2C4e6+55QSQcFIR/5Eux9/lFQXEZghYSIzCNobAAmNEv7oBwdeF4FBjbDoo9eKAgp1rq+A3it8DkKPFVVSE5ApUANaAVQbRsvMAb7loBBBQ0B2UGEEMx4YQKYjKsxQ5kggQxkVUAufr/IQAwQN0BCHCxJK687/C3/6knbr+uLhR71wDt+/Gidz508tr+7+5VBp2ipxtrKVdj/wm8E6sNAaECIIGoQGAAiGBFaryJThBKZVucZKqzqFWDWRSygrZpubUchzuHV4XmGTggEaTM0ZqBWdJVZtVwDaBRh3whhOETggBQJyhUCRaCyEJqFziyMxtFErRJDQwDFChoiONRAqMw4qQKUI5iG14030i98sbpYHvXAu349v+KKyUf+RiXjKBwxHh7E3hfcjLjvSeAAEBhEEUQRTNFvqUIcLCKHCHKeZ1aCQokhZDHcIEClygTZv/28l+y7aj0GPgMw0qQFMUFrRqphsdvK/HphzwC0Z4BckelxFRnY2PQ30+PMykUwo4Kif+e5ezkQmN0Kdt1QQyDl8PL19fSTOHr8i67X3qMaeH/6699x2er4/p9byedWgmZsxmU0N70a1ZUvhISh+zYAC7cW0NnG9QK6agHkAtXCZ0CGcUCCglURFUzK12yLp+EPvu2qaROqjzJHpM0WuRPkALSRkKJxOx4QwkqN6uAIUtHMkRzZE0INSPMbKgcjM4QJPKihMSAHhgQG2H5rafUNQ6of2D8688ovtiyWRy3wVI/xYHLih1e7h68jAjLXiNe+AKMnvwIp7gGDASIoRQjYI68FUoRQD5GaZYhmz0Qh1+/U/XsBqoQgQhHyxB1JLETaDOu3AqoyTsDUKtNaKLJ5ZEAM8IjQ7B9BK0agAGbT18ABCBESitEQIGxi1IyNCsoRmQOoGSAXH18IEGIoszmiabA4bfkXlr/jX1277Qof0/SoBd57f+2epx1oH/y2ijpOiBgfegr23PS10HoJTAoWAihDEQAibyUBf2VQ1YCX90FA7k4BuGRAKSEDBiAIYtq44o2vObbDidwC7+XArYwTZJygCiQVdJpdbCvSAKj3LQBNhHJAjgwJM4OC2MSuuuukuFAo2GcJBDQ1aNBAYoQG7g0SDQGINYhH19JE/sll3/4v926/xscqPSqBd/dtxwZL03t/cjWfW5mCMR5dheXnfCPy0hWoJCEIoCQgMSt1JoOc7xEAjhjtPzKXoWI6HgEgNaAqmY8vyuTSKp081B/GibvpA8RY0w5I6y1IAAH16VZCBt64OgQt1WYcBHIu5/pcsMQAcj1P/ZVCADEBgZAJCIPGW2FY2rztb+JXQ02K5qvWJ/nHbnr9O3dMkMciPSqBd/beO5+zLKdfGWSKbrAfi8/6WjT7n4CoAYoIKlHXEv1H8Y8UCBLAFRYuuRYZNVgUCrU8PFFoWXFRGUDEME8Xaf1jV/cX4DRcwOlAfBoK4FwLSgohwRSEzARSRSBCXGwQ9y0AEQhagakCkXE6Cgxi2xAICAWcxQixddBSCODRCKmqkOLWEJzEBIlNJFr6oXv++L3f+cWg7z3qgPfO3z42WmhP/XDQjcWWFxGvfg6qq58OIPTeN0BLCrG/99fC2AAAhGbfYeQ4MBboACUClBiAWbakGVElhC7tWApqMtyzpiL3szLS+hTaKTKZnge1wVNVxCZgtHcJUsHSoti4FYL57sD2noJlIVvigL0njiDyksuqQhgNkV0cB4pg9jqOECAhVknx9y7/rn9903Zj6LFGjzrgDc7c/pQ96cEXDrXDePlyLN3wIiivWGxVBdAM0gxCdjErUBWovxZSEOLCXqR6wUwKBRQWySjRDIUiQjBQpTq117sk7unBW24a1yG/L0iArCXIOCODMFWFQEEgMCkoAoO9I+SB5d31yQF9eCxAubhTPE7rYIRzRFVFRwIa1uCFIXKYhd2UKyhbTTCqpUMXJvzLV/xfv77D9/hYokcV8FSVKrTfOpS0kjHC6CnPBw/2g7MA1BrgSAFkA5lmKBKAzgCJ7K+GIF7Yi26wYnasEljZGGMfurW6DJaMBZnc+MbXHN2qPxHpnoX6NoaKbnbQtQQVwpQIrQNXoZCoqFaH0IXKRKhHKZQJwgQN9l7JIxlsIhdMxhmZACJkBTIz4sICdDBAF6PreNEMjSoicQXhwXPWz27+4xu+9/hjtu/eowp47/5P337FsH3w1axK7d7rMLrsSb2IZc3G8WTG+VQFkASSBJIOkARoBsQAGJplyHAZIHM0F9WIxToJKMjEIjHqPHlSda7dESWQ2P0FMzZoKsjnxqCO0KlxPXPMmHUblyo0e0bIDONm0fU7NyZ4zqJFCOYu8SwVCmweHlWIgy+sLKEbREiExX9jDTBBI5BjRR0t3HxicuFHjz5GncuPKuA1GydevJRO70uRMXrCs0A0QoZC/KFAxfKIVf3VwahptknnW0KohxiuHrDoLFHPo+w3JVePAAqg3O2v9u2/ZPs1Le5ZPKWMu0kJeW0CtAJVQqsmzgGzsHkUMFxdBFeh52DYxuGKoQEywM/2cXASAWKAliqiWlm0YiJmgCIQ2KI1IUDiqE5S/V9/tHzm6x6LxsajBniqSk3q/lIkDtOVy1EfvsYj8gpVc2Uo5a0gU+dwmgDtAJkAOgV0CtUW0IzR5VcjIYAVlt4EgrBAECx+SwpFwlDTKJ594Ibt13UHbhxTNb4jCkPPZ+g4AUTYVEEHRQIjICDXhObAEKgdZM71lM2ZTGQeZxO39moRDDJjpzifVSAQJFVgsABdWobEAEQgx2BhQGZQAFJYXNrMCz931ff8xmOuK8GjBnjv+E8/fvWgPfuViSosX/U0IA4t2CXJOjypQMU3TYCYkWHcLUOl8887qBrXU2SsXn41umrgPjwLkxnnMyZhBq8iQLnS6fOPbe9pchQyFH0PeQRD1jskEKbEyFRiJQRmYLgyQlxokJ3LETtn87+VzG+HQH1RkMVni7i1A5oBbuK3XlyALg7QxQCmgACPfrD5BzXWV5+ftL9y3V//zQNbrvtRTo8K4KkqrVy481UrcmY5L+xHfeBa89dpB9IEUoGiA2nrhkQCtHWuZu+N47U96CAtVDrw0j5gcb97/sQLfVxElvR3IgRkipP1p70Y92ytcSXSfaP4VtIuoVXg7BSSgFaBSTGD1bKU42JEvW8ECWJA2wI+BlcBXHlyqCcNaG+MWOxWCVBxdUIIwoywdwV5WBvn5BKGC+YP5AbKe77snI5/+rGUyfKoAN7tb3xNNdAzL2Ak4r1XgOpln/YdWDJYMgATq6QFeC5eHXAknQFVpiBxQEoHrofQZQOeqIJBliagmLnCnHMNNV3bIewISw2B2yuSk5QJODsFTQWJCGPVrerVkFDvHUKCWoSCDHhFx1NmCDzIS+w5e54wUCIa5C4f9zuKEqSq0Ozdi66uzccXLQJiW4XEg5B48G2Cwbc/VvS9RwXwJN23GvPkeV21gOXLn2CBB01QMsuVJFunCXVxWsAnBi7SDiotIK1bth1IWpBOwLFB2HMIQmZElOdiD7a4mhUEQS1pfzU+e8XWqwOuX3jGWgV5d0iKfH4MXuugCmyIQIkgbuxoBAZ7G9SjemY0MFtKFbv7pgeM+/HY3hPZe+JgwIQdV4kgQkAzQNi3B23jxksgEFcmuiuBVvVgnOLPHPjef/0VjwXn8qMCeDW6FzV5/TJa3AdeWDF/nSRznYiYe0TciJDZpppMt3NLVsXFbnZxqwnKjMUDRzyDxaxYA9/WvipEQC3diPPkGVsuDsAbb6bccPj9Skkw7oBzY5AAUxBaBwegEFY0yzWapQHAANMMULaZFbvdogU5EHsQmn9RRKAKBDF3OZYWUK0s9b5CogpKBI3Zgby8Mp2O/uml3/Xvr9t+D482+oIDT48fD2H60Ksa6gItXwINDVQzFC1IFKAOoKlzOvPPFTFLuQP1gCt6XQvVKSBm2QrGWL7qeiSuEDRBrAet6Xp9rp7XYOiEo05u1F3E1RDd25jTZswB4UyHqjO0bpZCcQ+hYYFBq+ZIJhjAxH17BkRLUCDyEFoBZp8Q4DFeqPsaBZmyWd9KCMurSIsr6ELdGyk5RiSOUGZkHly3kbtfuuSW1+9Ibn000RcceH82/aMF1vbGpMBw3yUz/1zhcA44VYG6Y9g44hwAi66nBkLVwgVt32bvPmBpGQCDvINAT+R2qSUVk4g8+S2vec0Op+y+4fDugXQnogI4O0E9MY7W9o5kt5IrxmB1ATmI2zAFaARm52bkVi9Z5GJLIoEbJeAZVy5TRJmggTHYuwcY1sjRrpvhTumgQGTKWHh5yoOfetEuHRIeLfQFB96ILxyp8/gqDEeoVvZZBGKLHmevJB0InVmzxWWiJVphrwbAduZE7qaQ3AFNQDx0GAkE3sbMyC0LUlhGcje9FDi1o5/K6K4T50eh+9PIAtrM4AstAghZzcFNgKWjBmCwOgAGZNyV7BsqHaqIwIENhOxgnNuYvQdL36vZrG/XIpEY0Dqg2buK3HhZpBssOTC0ishxGKcYfOeHH7j8rz1aK9W+4MBrZPrkoWzuqVb3W7q362nk+lsxFIBiPLTmJJYWEHMWI7cgKa++6RSkUwQHLu8/DAFbiMsf5lYyDlPp9NDygWZHAP4Pbn1JWgzt70TNiRKgp8eoOwIDSGoZLwpAGAiLAc1qY1yvB7frd6FYufa3wI0OYk8msIRS5dBn0ZgVrhBVZCg6ItBogMG+VXQeywV7x3liSMzIVTXayM1rL/uef/Plj0bwfUGBp6qkefKSoBJ5aS+ydu4XKyLUDYnt7hPtALTuMLbPzcgo3M50PdIpWFqQdhju3WdK/A7AGTAsgsZotF0Ynz5x+fZ9AGA4HL5zCJxmJejZDTTjjBqMrIrSRJkAhAFjuHfoZSDuPilfkrPHAjg2C3ZmbNi1iFvBCphlP8v6AgAIEaqlJTR7V5CjGSXioTVmQAMjV4v7N6f8S1d977/eYal/oekLCrzbb39NxbL5LDCjWlgGIyNn0+9U3WrVbMaD63dF5zPR6pkpRa9zINr7zhzM2VwsgyXr8C9WYGtk6p1xFTIjIyKxtu2uivm+vfsfGlJ9R00BtD4Gr09RCUzcwkBFsFaPoz1DcBV6PBWRDrIIhnE5Oz+HrfpfL3bdwlVVqGgPPuPNQCLFwr5VNAsLZuUGBjMh6ABEDXIMaMPgqeuT8PPX3PL6le3384WkLyjwBh9a3zPKm1enpgGPapDYkKpm711neptxPtfjxCxZ0hbQCSBTkBpXs9cW7CLaohgGxLBQI9GoV/ihALjkSJUWZgpScJLJZduvFQCe/5WHxw2mbx9qQtUCfK5DnQFiAaAIasDpgqBarhFGFZTUMmMcdKTWOMha5cI1Q8tCNjDOwFc4Hs05lFXtWkVsnY4UGMtH9gMNg0jBrBAuHBPQ2NA0DP7SZh784E2vf/2jJm3+8w68N73pF5vjx3dfPG692zgYdH2lWRoCFHr9DprcRWLcrgAIYp+rdFD31Zmh4ZxNLWyvzgVNJJuON1i0BVEsyDUTWsVihLtYSJUYurJlJ6dbiWQx5P/ZIKeYI9ozY4SJIsJanhVeqgRUo4jh6hDC1ulsxuA8cgLjcswMnitW2k49+Oa/75m2nVXriIOXHwHXnm4VLRrCHAGOUK7rRNXfuf/t8RsfLZGNzzfwaN/k7r9+KKQXbv8CAEjWriEeV/XCgmWioDMupsUlUmKwZq3Ou00MnMb9kIuF24LyFJSN85nlazFdioBU7JnI7jyeV/fIRiMAYMhgpyZodMXlh/5kwN3HIlXAhRa0nlG7V1DIExFgvfQG+wbWZ4WsNqPHvCOxcEHtfXvbNrbf9IBWB5qinxdKgBAQhg1WDx+w9rfsVW5kmTEaKky4GY6x8NpL/uZvPHP+fr5Q9HkF3vv+648f3Lf+gR/cn+7Ztc1qreMnRiCE4aK1lJBsJYgOrGJQmE8uQWXqotasW3Jup2IOYxIDmX1m+6i2YGkBEoRRYw/Uz0+8dfIrCEwCEl3YAso5euOLD27UQX+/IiBMFHp+irojFIdZwZZGoFqpAW/Tx+4rRN/42/YuGCogtOjGDKAGwrmEBtfzBICqZS0rARKApf17sLR/DyT48djjwRSgXKEL4Ui7kV779GNv2NNfwheIPm/AO3bsGC9sfPh7V7t7rxu2p3c4ZAFQ7CbPqJiJ6hoKAxFl6eOv1HO7Of+cZ6KQmjvFXCe22T7lc+N8kCmQLKslDAKQC8fYSUqKoApW3VU1AAAQaRPCW6K0uRJGd2aMwUQxVEZwYLACyoK4FNCsNB6nNXFZth5cW47t+8z59KjEcZ3juW7g0WV7L15zIhAcOHIAw+UhUNLtA0MZIFYQByQevuTBj8lP3HDsC9tp/vMGvJufdfbahfbe74g6CR3FHRaV6m2hyuvXRA6gACg2oDo1K9Z1PNuKnmeJArO4rFmx5uub54wGUHV/numGrvMFi1pYu8WtvrzyjlTBasuvPBKtKL9zRLoZiNGtTYH1DgMxrmfH90jFkDDaM+p9dkqwVCkHVw88NcAVy7YHJ5zrbXlKJZrhWqXCspbFq+YC4fIrL0fdRPsdw1w0QQDUSGEUNsLgex++/8K3fiH9e58X4N35pu9vhmfv/NHF/PARAohZ922v4Prgf33TMObxYRk0plznDOsZO5lFILQFlTw86SCut4nn3Rm3cyBm1/V6jmeiOBfRqxmRuGTkzYDmbjQm9bYYCqX8CDzR6Hk0vXfI6f2BFDxOyOdtDb4KGQ2AGkCEIlSKZrWCDATCZPFZAsBijSEdVEQEhnM2R4uCoRwgsFQqneN4RHOgc51PYbqisKIaRlx21aVABQN9rEAYQgMhV4CEwcI0809fecvrn7v93v530ecFeO36+MmDfO5rAzpEKEhldfaojSRt7A3U7Q2jyqzQ4jaZ1+myZxS7ZStb9L0OUl57v11xJM87lFuIc1DybOP+Snqu4oqTh78EMp271B10681PaWvm/1Cz5loZ7fkpqlYxVEIDtex3AEyE4dIAcSFCQ0kI9VHvdTgDkiuARd720QwzMMzQsAlj1+88u/xfGJ8ZrSRY2buII5cd6AEuDGhIIBYwVQAtHF7v+Gev+bHjO6TR/w76nAPvTW/6/mZlfP8PL+XTBwEBkaBCGrzmNa/ZwvFCNb0M1I7iILrPrehn5hhWTSCUWK1xNUuDn0Uw7H0Bp3O73jAxgBafn1WiZa/h2J2hEWDta4nXH8G70dOQ0rsqzeMqVOguTFFtCEbCaECoCKjBqMAYDAIW9gyhLBD2wiWYm6Q/B5njeQYhw2ERuew+vULFsi1cUD3Vqy/AUwEo4bJLD2J17xIUGRo9h48ITATlAVosPv/sifM/c933/+KOHtCfb/qcA+/KjZNfupju/pqBTM0xAYC122Fc0OaFGwM0Umw8KmGliioZyJ0bBg4w8cxiLSK0ZBwXa9Y3tZhtyUImsZhucbGodOZFc3dG8Z8RuWeNAUFQZV6fk8a70kpDdw6QHwAJ8jQjn2tRZUJNQK2KgQK1AlUNLO4dgKL0D930N8+jKmExuyS3cN2BzJ7r58kEHFzk+jWozixkhR2rABsQgDKuf+JVWFyoIQhQWHNyMCBBkWNNLYZ/fbw+/Jr/3evnfk5Pdtttx2Ldrv1ATWtLwjMFikSq18ztd+zYMY7jtesiqa0BoRmas/veCldLprPl4gwu4tXjsF5Tsd2FMr/NW8FAB83ZEkuhFgLYTqoQDpgo776i4xxd/64nnhki/3HNClZgem4TlBQVFAMCGgUGIFQBWFiu0AzM6g1ExdawayAFsV2LuVQA0FxywTz1sdt58erN1zyDBc4BS2Ohpg544pOuQl1bWr1QMLHLahwwDBYnEv/R5Xdf+uStJ/v80ucUeIdO3v7sPZOP/6WgoBSTV+wzRHWLHvHiF4Mb2TgUQoaSWOYJTQFMoHDHb54TpcWtUvS7eeu2D6vNuVx6H577/LJlJefc9uKtPMAtRAoFSRX41LZvdtCtt5KsDJs31Zq7CoT2wiZ00hngVDEAUEMRg2C0ELGwUKMioCJCJEYs+Xe9SDUoFWtWkV3e2vl22J/b/N+AiV2BhdIgESoBUMGePSNce/UBxJgtElKKjzxbp6PRNRsJv/ik7/u3+7Yd8vNGnzPgvfP1t1RNPvHdS/nCEKjAKmBkMDJI88Ibb7yjH7rVdrFhdJfEQACZccB56jqZi0lYylMRmaVTQBG1fYpUboGcequ2d68U4yK70dFNoePWWIoQSN29UR4fKYAAJRbUyw/P3dojUpD0vqHqmcgKjAl6ocMgA7UyagANEWolDGvG0soAFDNYFQGESKYLVkxg8rR451wAet8divZHlo9n6QjGKdWL3a15R+9ggSqQAYj/gklw3TX7ccmhVRBbkywT7QwlRUakHBdeurY5+bmjx97/v8W/9zkD3sJBffZweuEbKtctQolSkwBZhtdcs9qfK577YAPkvRTI2oWJgMVqLAxgnuzZRyZm4bFS7GNuFHca5xbkwKOy9RzSrd6U0I2ndk2GOCOyFhRw0ZbAabhn78lyrZ+IlgZ0sqF8d2SCasDk/BScFA1ZXXdN9r4JwPKeIWLt/XpACACih9KYCFySQnsdcI41u2VbjN5eVVAFXM/rObjafgovVlczREgUT7nhCVhcrIzrc+k8GkEEKAUaJ/rGdz7wh6/eUVv8eaDPyQnufNP3N6NzH/mePXJhUVkA6sBqFfKWLqT18smmP1dodADoAY7UO4pNbM5xrHkR27tKZiAzPW7mu5tlrRRjpEQ8OrAk6GQCStng5Q9xywOGPawU6rXhwUsv9B9+Anr52WvWh1H/sFIBOGBzfQodi3E7VTQKRAgiAwtLEYNhBEjBQT0X1EFHvZ0xw1h576NmgJxFMcrEKcAyLBrHE1WvI/GsGyKQVhgMCE9/2tWIEdbClyuAayAolAWZhsP1dRz7z+ev+Lwv3vw5AV41PvPMRTn11RFTTL3RINRz0wCwaj3YE/tzUYrLEW1DAaaH9eGuArqiqxWAuSWLkgDq1qp6NnLvJDbnsfqGPIXKGJAJ0uY60KXe67+D3HeWwuihjbT8SXU8ALj5ZsqHlxfeVENaZkLazEjrCZU6p3MA1qwYjhijhQhm9f6MNj4BQIAZHGWzcK2hye2OmQuoeLzh3A1zDBC+bhuK2Dbjw9wtDNIWlxxcxPXXXg6mInItpKYMCBp0vHjdyTPjv3fTsc/vslafNfDef/xYLRunfqjB+kom87STRqusQrYcO9Jq42TsC09q3VwhTAYcYEDKlldXRKdlD88AaZELj0hkAxR0Cs0lBd42chAWMPbRD2nRrq8h2FNxo8IemnEXe58oKOLgzuc0l2yUa/1ktLw0/PMFyvdVyAiJMD43BSVzpTRqOQI1CYY1mbh1blc4XSBBYOvcV6xd9sRkgkU42ENq/XRxlmgTyHL1DFzu3+sB5waHKrJrgRGCpz3pSlx2aAGMFgjiJ7Mi8cQVj1N984m7P/ZXt97p55Y+a+ANqvufupzPvqICESOjRosgAULW21fBYFXqYuiBF9qHK9bcUFCLKGDmQikWawmP9dnIxZnct7BIxgFlloMnHt0oEQ0rcZwC0qFdX5/1FN1hzhoJMYToThw9anmhnwK95hl7zg+Z/6imjEoDNtY6dG1GJEJNhJoCIgh1IKwsL6CuLYbKACIRArOBrs/Lm6lzpnUa99pCPlHmVT0UkWu8rgecmSOKzB1UGSyMUZXx3Gc/CYsDgnLnrTEqa2bOCqXRcG3Kr3naD/y7p2w57+eQPivgqSrp9NRfW0jnl+fEqvuhbDYCACM1A97ogSc57leSikhcDzNwQaZAnvhnLaQU88jEuJx0QHbdr3cwzxzEnDpw7sBb9D3TBdPaBCFblVlR7UxfsuWmCACIU2oWP0zm29hCx48fD7/1m7/y1O01t0SkdcQfVsgCZnTjhLwhsJU3BFEFDQgDUiwNCcOFgMBmTBh+HHRuQ/Ti1jkgQ+fSt+zC7V+76OzGkfg9lYlVbmDmZHYwAhDN2LNQ4Uuffh0izFrOLGCyyQAOyDw8cuLM2rHPl5X7WQHvff/jNZcO89mbK+7c2GcIRShZr3UG/H0e6Fpbw53HFOJlIA0oXMwjFgTjfqotNLsIRQmDtZ4cMJ0zQIrl6uIYRbx6MXfRBXNGOj8GZ/NbzRjILHOBALQUNyeD5Q/2NzhHl3fvuGbh1Nte94dv/vkdFWirA/6zmrHBTNAMTM63iBmIJBY+U0IkYDgktyrFLdlZ9jGRJZAWQ4M9vh/I0+RhmcxbycStxZeLo8VdKthmwAtDLXjmPWQET7r2CK69/BBCgOmOFKxrKgmIK5q2+Jp33/V733rsmH5WONmNPuMD6rFjvLh+1zfva88cymXG7UI+OwOSrQn74he/mJHlksDinLGDSGfpT17oU4q2ockBWKzbmYNYxHQ89ciFzBkVJTHU3DIZmGZML4x9YYI542IuvcgMi+bhweqe+7bdAlSVqjMfffWRzTueVT3wFzt60Q2H8e4hcHdgBVHAxoUJtFU0CKhBfZJIUxNWlgeIwTOVi1VrC2M5x7OCHSZvL1Ss3h51M2ZcROpMt5t7tdvzzxhCZJkuvRUsCCT4si+9HquDiKAVhCNygPkViaA0atY24k/8twd/bcc9f7b0GQPv3pdPV5bTfd9YSUfZa0p3I7KTRPBmAwAHDpxiyeOrOWSAitvEOJ8BsHXjwQL7rBa7NcPCncduMPR+vL4Z4/w2MdeLJsh6C9loexeDkYkqhelMAkZHzYcuGSyfnrt8AMC7/p/X7FvYeOCbl9OFpeFk/bnbxS1uOjIZBry9IlFmRjtO6MaCqIQGFr+tAFSBsLzUoK4IgdV6b/dGhovbAkJP1yMfwJ4z+pjadc9fxJxeN2doiFrzH3sF1GKZUFUQMvYuMV703KdiEOfKKgGAFEIVEoZXnjh75h+86Njntt/yZwQ8VdDk3PmvGcrZGzOXK90demQCOOS0MQSAG29Epm7jCmbTBQHpuZs11fZaWffPqZioJckgKuWMM/Fb9tkSn/WNKEFSwvrJswhd8Ip7u1QFvMrMxExC0NSsvOvX7kE7f/2qoOn5e75q1J54AivHQTd96bt+9Ve3tIa4lUhGkd9cIXUBgHSEyYYtBFOXZAEAFQkWFiIWhrXpb+quFAChdyaX4qCiA9pDIjJruFjgfWit6HX2KeC+u5KhrDDrQ9Utek+fstAaQCK47oqDuO6KZQRMTeQGyxtUzuhioI1Mrzx530NfX+73c0GfEfA++F9/ZHFp46HviJBKqbN08UcAnrH7HCvoMgDc85bbqwrtPg5wrcRSp3pQbUl3Ktss/FWqyUi6vj7DmjeWVmb2m1nkQjA+ewEh+4NwVlEKaUroKVPV5sG+P7z11lu3WLT3vOUNzeKFj//VCK2IEyg9/MxwxZlL5/cBgAbx3QF6JsDKF9fWJtCsqEDmUAYhkGLQAIuLAzCrJZ8y9Xpc4WqBeItzuSQLkOt5BXSFisg1k24OaA5IsUSN/t5LEkEGIBrR1B1e/uKnYt9KBXhbDlskxrNYaGl06tT01hf96K/vWvb5mdBnBLzldOZpy3r+aQoCa+pTyXcjA4VUjHo/AEzX1haJJk0M2ZRYoO+KZFFHey3F2+pdn0yPa82NkjtobqHZOKG1MUv+aoaHRURaUJuQznVgIe+h7GwM5J1GA4AKKTQP8uLC+7Zf/6m73vacQXv6BUQRgVoEWtvXPfCRHVVzkxWcHBA+WgUAytjYbJFaRYQnAgOoQBY+W6zMcIA13CZWbMkRLXOCAPjqHOyOZrtuP2nhekIw+9c4XYnrbvHl+QSzkTYdEGV5LBWsLAS85PlPRc0diCJUAxgMVoZQjUyjqz/6oY//xOcqnPZpH+S2245FRb4lymRZYdkldhu7H0qJwBAOKa0AALXjZRCGHGwICCXb1gcVxoVApgMSJRA8Bb7UT3islsTz9pLrhd5DhbIbF7mDbiakdQUhmi9Q3f0AS3O3gSdM6uH7V648dG7+2t/2mz80lFP3fGelG0uEDFJCpR2Hyeln67YHsPj0w+OG8p9EzWAO6MYJ03FCUKCCunvF06SWIqoIMIIBLEifHkVsFqcZFLMoRpwHXw9MC6PBOZtL07n3ahyuGBZeEmRrhPiOJCZys+Ap1x3B9VfsReiNRVMDmIHMFU1y/XW/fufq52QVyd3R8gnowPTCVUynXsWaiaNA2UTlI5GgBmtixpqV1G082ARopez1B58qqfY6oBUEZYgmiLazTaaQeedzzhifGUNa9pCRuZCVtM/QsIFPOm0W33bj0ddY8YTT8P4Hr9kzOfvSRrNNBBCG0mGk559++419RSPget7CaPCWKDkFsuKbyUYLFtfvfKsBjIYBg0EAs1VTmDFhk8443szSLbreLK7svIpsaYJCM4t2ZlD04rd/7+nxth7SbPMfRla87EVfgpWmA3FCDlazaxIiIGNwycb5tR++4ejuBfqfDn3awFtKay8c5TN7iKegegJhC3xbIs5OIgUCCQnnSwGg7tKeBtPmE4F1VyI3RsjSuoHZxkhgTWAvDLKtAyXF+kNjIAePoLAJIwWCwlqWqSJz6Ghh71vmHcfHjx8NeXrurw3TuYMMWIIX1QgQVHLh2hTWd9SmLkf5iwHrw1UAWBkb5yeQZOK2nhO5w5qxuFiBOZv7DH49NGfVuj5n4TPuQTcDp+t8RXwWbuecTl23K/qffWfgNWZnYthKI+23rAmX7V/C87/kWgQkE7kUrA0HKyRGSjo8ujkdfNZFQp8W8O592+uGg279lgY5gscIYWK6haKfifOkqmB0gCoJ6JnHjx8Ng1G8vMK0YvLO5i4fLGnUMbwrleHxrQfi/OvWTbsIOQ8EDZZwqvaoCEAQsRASBYyrPR+M11x/+/zZLr9/dHkcn/g/OaRgYsfAqyBU0h6kdv158/sDwBh4uAryXkICwNjcTOimBryoglotQ3lYExYXKgQWE2UeTTEOZ9oakYu54kIhj2SUkJq6Re7DYc/AxGlvRDjYipVrkHTuWIYf5n4p6/pGSnjRc2/ENUdWETTbon9kTmUlQeZmdbPNx770m37RuiB9hvRpAa87/dCzmjz5EqiAQmf1o2E6Nw93kpAAiFhIa0//8hT2y+TBq4m0toxEx9D2H+1KRdSUDXNA3I0I3YYC4wDrPpt661DZHmTmiERB0mDPm5/zza9Zm/913Dj9yiUZHzZeI6hEEZChQVGp1Dj/0HOOHz8a5n9z411Hpiz050wKYkbXKSZjW5w5ApZ5DJieN6oQgo+ct6hlItfhZmIWPrJFBBunK3cyR2SAQj8qxbr1v+edy3NcsYjmPrSmCQuDgJe/4CmoaeyT2HiwTeAKWZoX3Hfy9F/efgmfDu2Oll1Ijx8PQx1/Q63ThqgDgqlDzJ3Nre1RFXcw2SAplvL51Xp81681cva7KSQPDDnrdx2kbLtxwt3Jf198ViW/RwmQGuunWmh2lwSZXmjfl4bZjBRCOwnhj+bF7Pv+/d9ZraYPf3eTc2UaAQEkLsoBRkKl6894rl62Rde5+WbKg8jvDpqViZElYH2jBYmJ2Khu5bJiNKpQVcFcKiXE6NyMAcDLEkNxHLNBrdyxIa/AzwwkcxTbuBUgFdCJ63gmnM3XV9xLBXzZuSBpxjOfeAQ3PfVS53Tsv3KuH2OTpfqBmz6L1mefMvA+unL7vkrOvSpiAkYHQQfB1PrvWk/yLURK1m9Y7XtGi4X84CsXZf0qcDJRqJgbvDmajdj2b3YlUvMDkrmIrZVEW2FyUiHKECHjemRpWqSwhUtUMeXmocHqVX9ejqUATe96zytH6dxTUMQa2HsaCyhHIEzAtHnduXxhh7jZu7L4zgayYe2zGZubHSRZ8J09dFYBGA0YdROsuLvvSe9uHjckyr/934UTgqwfHmCfl3lKBrjc63QzzlYcVdLHdstkJShZ+wvT+0x1qtHhZS98CgbRf+k6eSAgk2BKwy+5/8MPfednWp32Kf+oprWXRblwDTDx6n619RdKXG/7DwqpcZYZZ1KEGHoxUsTDI9GMC27/Zp7YwOQDCCWkiSJtKlgCGGSxSiK3aAOEMjKypnr1Tc/+qX9+fznSu15/y7DZPP2tw5yCcZ0EVgEpQRBt9qugzuODkXmHI/mZT125t6LwYSazFjbHU6S2JHzOxOagYiyMPILhohZk/jwyXG0xIAj+t3M60mLpli/mLmJOepRwmX1sRoh4u4sCTCsEtzE2zqhIKrjmyGG87EuvQ0BC4hrKigAFyQCgChn07U97H3ZtYvnJ6FMC3vuPH6sHk/W/PNQ2AlNf3mludnJhUTupFCL3Bcms4GjOTpu7cykU/SHK45nbtMR6tm9larvIJoVqxORsRkiVczgGNPQ2YOn8LkzrYTT8jzRnYk8fOPXcJq+/sFKAkJHda0IAFFYaSAAaHS+ItDeV3xV6CVGqA94VKIMZmLaC6cRayUb35QUCqkhYHEVvUGE6p/E11+VcmtrWa6dAv6//52M243CwrOIiWt1yR/lOYUygcMniZC7HKAyCgJAzvuK512Pv0tykRQZpNG2G6usfPNd962fiVP6UfjA4OLqyxvQFDIH0/eusWkuJLGd/F/dIYWaGK8vrByuoUotaqFV7bdlkpvN9auQPQ407iCqQKqyfaEESwQAE2d2vBh9bSI8xrpY/Np7I+8uR3va6Vw9H4wdviSILQgQiQabo0FBzv1CGghApRZqcepbqbVv8eQBAkt8fkIUJSAJsjBMgnm0MqzKrgvnzQpgBqwhPqHrribmp59Zt2cUAWk5o42s6nI+1a2UFVLNIxrxR4aeDdSEwoDrng+VWHtk7wkue/2TU6Ox8rKDgnUeJWTX+tTf8aXfIr+RTpk8JeHU6+eWVXjgEHUNlYmqpWKaDkoAre/IFMDuBo7Y8FDJiEwBWyNwy7o9Enw74CJbkyWCkTSCddU7n5zZFyIAnrMja6MPV8lvy3uecLUcJFzafvdCe/soGghysBjUobDVGANbyJ8EisIxKLzzrnv/yX3ZkbdQcPxpzzgSFIGBjs4MoLLkTZMkBBIyGEVVwzuU5eQVw/owdbM6LemeynWee21m2sb3aXCyczOJDfcaKL4GlMPQVRzPcKlZYT2cFIcG6H7z8hU/Gpas1GEBif+bKICUgD58sk/BNPrifMn1S4KneFus0+QbScYBuWomhmB5FaisNEpvWOYPJ3FQsn5Ig1Io4Mp+aqpquIVrmr52vP4bRDMjz7+f3KhqQ/ZglYONUi5hriwEXTlymOaxzZwKvx6U9//Ylt96aAOD9x47VunH+e2vu9rBYpSppQPAKVTgw7Gkbp48yPnC+3VidXYtRzfpRJmkNQISN8RQ521WyA5BJMGgCmsaC8f2G4jIpNCdWbRoZAP1v22UOgb6P/Ve+no2X9U4uulwRtz48PYAJOZt6pAD2LVZ4xZc9DUGzt8Igc3NTgGIQpi1uedIrfnJHguwnok8KvAffdvuldbf+PCVAuylYMlTUOkFYCS0ARmgCuLZFiJUEQuJBebWoBifwCBBq3dqNpndpgMpM54DCv7dIQ3lf9LSyqfBsU0WCLYKs04jJaTWfsltpwExnUiUEiZAYPloBHyr3+bC87+l72guvAClNQwYLgSSgIy0mkdWQKFsMGQmVpJU6ndsx4NccHDwQoGcZlmUybRVdC7CaoWO6nqKuGHVpmq0zMJH68lOALTvag3K+87tNArftQDQbQ1HvRK+wjqE9wHxyu6ElsGULMhTJxas4+BiMrLZITJSEl7/gyTi0t0FE9sSBIkkEQH3V2nr7tdvH4RPRJwUeJg9/eYPxcpAxtNvwtveFdfsNiQKaEGpFPSRwI+BBAg8zwoKAh4p6IYCjz8QyvQCbn1rEYPmooHCeF87/Nb8ZwKAM1oi0wZhuiAG6iBSU89lfCsbZsPQ/XzB65gZg2dTLG6e+vZZuRdBhuJeQQgel5ABwqxNwzufvtR2yYseCdUevWV2LzB9lbwrY5YxpawkR/j+YgCoyBoO658r9XRUZOk/+Efk/xvV27mJbkT6uz/U6XuFyNr4GyNnDMOvW9/WqNPGg0OKgwqte9lQEtLb4i2ukTAAoVm2i77vh6LEdascj0ScEni3Xfu6VFSZB2rH3LbE0VXLfWD9NVC2jnwVcAzywjQYZYShAFOSSE7ZlIwBsQBbnZHMitRetaovKla1XuuE+QzBIaoxPCzhVxlHn76WHoGI9UKerl/138ty7d+PdT4np/NFAE2qWCCtHKqTYQTi7HjV7xOWdDXqOjPTs/svyHZHUVXwnqSiBkAQYt8n1PL9mEGIAhk30JIttYCPMlDg7pul2WwA3e6dq92hD5a/9MBcA2oezfW1hGEFZ+tT3V0J2dQjCULEUgZc890nYvxLMuIQbPFqs6OGT1x4Yv6q/oE9CnxB4p//sN5Yg0xdCM2Q6tbwvIYvzCUG9Bwl5WrUIQcQyQVTZOxllMyzcYwI1oGwBX3GLSAGib2WQ5vctQNjye1iDmi5gelYRJc70PpQHUQaWkGLzsRgX3wkA7z92tI4P3/uDw7y5N1cTLB2KqBcSKCaTYfaznUQAsxC680/e1bLN+Q62tGmIEDbHCVo6kxVHNwODJlrD7/5yywn9DvovdBvsfR//vmfCvXvEdLX5z1Ditgp7Pv5eynfanxVaulAB3r8tYf9Sja98wVMRdRMgM1rKGCnVcTrV77nkpmOfUiH4JwTeZvvASyMmlyNl0HQMZAL1q3fYxaobCCSw4m3xRJVsXBHC0Fx+Y+GsntX3gJgHW+GoptOxbxaS803d/C+NCAUACN04IW3Akj51a7aMPSCCckSOC29/wejyDQA4g/CkKk/+Uo0MXkwY7VNQyKgHnioP+IzYTgQWQpWml3z4z963Y7A50v0BlJgs8Wky7SD2ZOfvFnVjxT0z5c0s253UI/MTkvbAmoGqB1j5DjYZ4e/h6VHleYgKskcw1PW/rIqggle88KnYv2TJq8nHx3iwQjQ8qxptPmnbJe1Kjwi82247FsPmqa+q0VKejhG6qaVPZ9PxSFy3806AdtFeHSa2qjZnU9AhAcjB3pfZJ3M3X0TD3Mw00Vs+26ZTute+6DlEBsZ2vQNLYT4uKpzKoCaiPG4W/5RuvVXe9rofGlYP3/WTjXaHUuiwfHgIVC0EgoVBBVLrplRSlxy7/XkjCJWkI/Tgx3aJWdJp0jy1R0cYTzukbNoXKTz0pajrgBDswHaOTwVgc8DchtEiVg1UM7fV/G696FXfr2xuWEj/e0A9mAYK0Ky4dP8CnnnDpeYz9dAbQUCUESgudhvT7zt69PiW5Ind6BGBdxWwOOTuWSEn5M3zVtEvJjYkzXM0QDO5hRlsg62/kJHtxsudiYKEQWLWbPEFmb6oIMkQr/0kX7tL1FJ9+ikrDEiAZoaIWW1CAsqAng3gHJHc+esMpNcBMwiJ41SbpfcBgH78vc9bTGdfEdEhLigW95nSDGTwMCCHjKCuU1FJijIrl1Sg1EG4HabxuR0O1LpbPxsljRXml2s7QuqKO8ZfWBBrIFbmF5ypB4XrlfYV2sdKC4TsGmZ80OarGFdzUKU5K1XV4NZPcv/P9DtXldwJbUfIUFVk9TtWhVJAFRO+4aufhyVSRHRm2cLyD1UVuate9e6Pv/tqv6xHpEcEXmguuZxFnog0QZ6M3YUiJtbERV02nc/E45yOJgVMBij7jW0WJ7SREdnKyYoYLTLBBiv17hYbGPtXyTmvnw85YLJZsk9MBxWaUx8JNn8V69Xe1Y//0T/8nlUan3lt0LyszFi+hMAxgaBQFYSKvDnibEwUM4lnvmiBSqqpkh0DvTJYOK+k6/DfdUnQJte7CFDnmiEyKivUMIE1x5p6/W320ScldVa1BaZzXM2G1n15/r1tRepYKvwMoOW9/QYScN3Vh/CMpx4CuyvNIrhqifIU9m2un33OlovahR4ZeDp+SUPTBZmsI2g3m5HZuF5ZqU2ycSATqQzJ6hzQRCXUOWMBlxjnUwdm8c+a9WFefRZzj5SbNiBHN0pcfKiahe0+QenY1lFRF1qlRdo8EQBIu9itTcP9H/2aPd35p8UM4kGL0UGCkBeAi1quHPfqNVAe4twrrE0FU7e5w5e3OogTynrWHBuENiumrT1U2G0AIEQGqioYryHnbsart4Jw7tifmOb3tPdbgGbDv8WgEL9GA1p5VrOQW57bTzWgCYTnP/syVGIjXHJrzKUVKtH83bd8kgX7dgWevv94HSenXxlljDxdR8gdpMRS4fpdnlm22asQSQlBg9XpZBhIk1m7mhmUPRbr3M+A6SDODM0EZBPH1kbVuWbLaM9lcKrADkApI5kJmgTSmT5JIEDdZ9bfkIltCNBA9uLUPT9Wr536x0yxroiw9woGxWyRDjdkiCwmCa/O6g/VvzNwBBVIu3Fke5H3gRsPTgjycXIdKytj2nkmSH9EAgegrmdOYnvgLhXKPcy/7z+Y8yeWTws4HESmrzmAyL4rS1ChCCuXSPNieCag3OhwoWYiF2ARvPQFT8O+ZTadHhnsE8YCAvWXvvlfvHOHm2medgXeyY2Tewe6+SSWKdJkDFaZTdMZ/zUFKxsXVAE0kdVlu++niGUIoNlDZOpcr8y47KvSlGnYGx/sAQ+GbjCmZwW6yaAugMWjGijuHAM+hEuWmXE+RwnBQ1WqqERGo7Wzf3OPnD9EKggrUzQH/Vm6IaQaLGLQczwrGXRmUDBnwIOgwnQZ2LqcwkuIUlXVHyZ/+EkJbfJAvR9Vvc4iVvYYDGyuQjjQzFuxFfxGBpQd1INv7nHNPTIt6kcPTNPrbB4X0KspNYo+saD/DQQQwsHlEV724hsRKYOoM4iqjRVLXXVTesW22bKFdgWeTtNBzu1qnk4gnRXWu647dwewE2kBDSBZrbQ1OwgkWLirVyYchEWP6y1kD2mpc0IHqWQCJUbazIipxvhcC8rsU9XEdQEyk7kk1DkMYEDjntvZyLEqKoCAjCZOsHp1Dans+s1PyW5Nm0JvlmwxMEoQtUQGjFMl6OG3vGXnWIZI5wteVIFpl33o/Ne+zFSI5JPFPi/D3AO9/2ArzfbeRgVo/kcBVuGENhwzHc441VavgU0Qu9Yt9bkQE6sd4wXPuQ6BEoh8uYhyRq2JJLziRS869ojW7Y7BAoAqjp9C1C7ljXVwapFQOZcJs+nui/2SLxpXDArjcCZabTPFn4sVnMnEcCoi1josqThgkwPV08yRKkhLIK2QNwPaNQVSADI7SAUAowoKrSaWqCm1rcStZEvLkSnzZrGaRiMkqPYJhssCEoVIcM7d2VLsxAgVufLsgJtjoeRYaYOCKK8u3fngjtldIZ3JljuOoIKUS+zU+HJWc0lwJEsxd53VwO0czffveYd/Js6FM2aAKmn9PccrCQHlZ73B5ofyz3vIEHlm8gygZSsZLQRYrz0Qnnbdpdi3kk1CSAVSAqsggpCn4UtObJx9RJ/eDuCpKiXhV1fIIY3XXcz2YN7C3ufegsrNuX9PPTwmmSAZyNnAaIPj/jzX88xnV/52TiYAZYK0bogogXOF8YUWMiUgMyRbbpxlQhPqQQCoswxpJM+ksKp41eg5wAHCGbwwxf6rViAhQ7KCSkKacz4VReULmswQNYsUlHsmFZDIwk0vuGQH8MB8ylQje+Bdyub+8R+r+wTjrFmqgWyOhLR3IM4ePfzvrWRq5swosA/NHWLfF7DN9rFXO3JJqZqBtDyfmeg2QyNAVbCyNMCLv+wZYOlP5hxSEEOszp49/WrXKHfQDuD9+Z//+iikzWdQN4G0Y1ce7cA2A01/M5qxYPVgsl2hKRKSLZPFHiRDEiF3DE0MTQGUGJQtSkGZTIy6RYxkBkc3tQp+m00B1EZsnu1AKbrYLqV6isFCYz49mH9QKXl6kzUGInQAT5HrMVavGEAGG0jIgDA4ZwceO0cGAkcL4G8bOnf1mq9QM4Lq6OMXlneIFQFdUCBnMT2vE0GWEh8tm5UCoCye4r/th9LB0YvKXtV2hDyCrme6mr8vz2gL2OY4YTm+6332XbFkiy5Y9iFAIjJZjuHLXvhkjGozMOauGiJA0Pq51133A7sWf+8A3v52bW8l4z3oJtDp1MWo36gHkRillNVCZVYobXpCP3L+8EnsmnRutCWTuVyK49kd0qZnmKhljUCKyFNLVS8sgqRC3mR0awBJ5eE5hSIjNBHKgFCAorIWERrsWPCilthh5UiN5YM1wGkWfSlGkIMP4k10tg7PHNkTY1Ugp6pae2DHWKasSTz8rgC6OdD103nuBApzNptYm4GpAMteZhxsO5khUoBWAGXH6kUyXKqUi4JLmnkQOpiL8VH21ZJU0MdxFddcdhD7l4Onjvk1kx8o8zO7+sKOfEXsBryhblzGMhmljXWErEC2MJkUUeiD0MuK8lc/TsWAUOMKvg8VzpQB7ZO/yHS9bJEIJNMJTTcMkK4o+2R3TgKWgJBrTM5nUFuBUwAJG3sfKrTpkHgM4SkSJSTK6DihjS26ZoqVy0fYd0UD5QwkNieoCCTbeThTr49SMVigPZebJ4+NIAjodL24Aw2SJVurDTEHQB9NmPOLobgqPEmzfOZcxsSix03nuHuhubcOnMI5zRq1Y9kJLH3Nvss9Z7P76/ftNz9weSniuPyrAarA4dVl3HD9QS8dJYOU149oogMDqp4+u8IZ7QBe102vYe2q6dq6W4MlCXPe6il3Owe8LeBz0KuLAb/h+UfX+49cHzQr1i1ab5ennZpRA/ahMP8cSQTagPG5FkgRyAE5CzK1WD7YYPkwY/GgYvFwxsKRjMVLE/ZcBVz5jGXsvZYhzTpEBCy1O6vV9EE3cMw6Vx9I40Kmj2H2JGAGS7F3w/nNHcAD2uRzH6pAToIuz3xpNjTW47hYuI6U/gjlx4oyyHYh/diW/bb8xkHr4Cuf2eeziSSwZ9CLV3+1Y89Eq02SktniR9EAmIcAX/HSm8AkzoxgDn4CmGo6d/rCVwE7i4F2fDBgeSqnlnmyAckCaAXO5GanXY32GjLM6tPijSz+Mnc0zwGxvxMRLxcsf7sbw53LEON6lAO0Na5og5XBYAgJEhOqTMjnGbppSQkh12AB4mKFwUHF0hHCyuURq1cG7L0mYvVKQrWSkKkDUgXTQRXSBWhXAcljztkMFyrObPiDxpy/xx+rwqzQ3dVnIHdRRVgFVv3W5YycrcY1KZCJzLgPhEzZMFe8AuL4c+AUzIuDxz4r5UFloC2GbGQieQvn60E509msfVkJIFncVsG26o9zOGuZaSA0BsT2YwimnPG0G67A6ghQj1+TBou1I4MxePYlNz048IvqaQvw9LbbYhZ+UUCGtFO7eD/Z9k1EIElmDmDA97dZYSLWWa9phX6WrZxTtfAE/6yIgyz2HgAgyGQAZGFU2kEoI6HGxjmFTiukXEM7BXILTRUSGFkzsgqyJrveLN75lmzLxfCxB+3tlyFJbV8p1z/35Pv3s7tTIt3g89kvtqeqjiNVsAXhLdCeYUNY9LxSaG0AKeAoHK2csfCr8s72sd9tJUURm/NgMxJ45KSMfTkXbGKVz4y/FO5Xviug9RXSXAICiv37lnHZJSv2lAs4y5RQXLVnMx2Yv0ZsB97aE8MqJD9BpxMgm3/Lrs4ORs7ZVPwz+ElcZMIzQQq4rBuTXcCW5ZCcJffkADSxYNVi/Yz3Gyh1nSDjmAIAzHmNDr11fXNxnZNCxXW2HBxEBVTFcDHXi+ma6kaPQpN6xGV+Vrv48/vxu9jmTnEtj8OFweQSa5IyR6OGl7NosAwb8wca4AyAtjn36UEy40hKFq4SLW6NrUgq0x0+Sqbd+XcFPDCQmYnjoHPOBp2B10A2K/Y2YVSOZ0cun2WLX5i4FcKwirjhSZdb/0INJs3UAwuq+zamGzvKA7YArzv5wKFKpguysQZKJlo1z+S9OYld5/P4qntnnWNYxKGAUj2cVaITyJYsymp6G3tBj1nAc7qkGDeCP3zA024ACE+RKQDagAT3pvrIXz07XfxnMhHplJAloKMOnFMfzpvfSMyBbYmrlpDA6utf+L1RmVA2D3rwF5phzx4McTx96sBM+ShEQkHVnbIKUAzQYL2kCvCK7mTO2xm3ATFEGFn8YXs7MRSOZWeYO9tM51Pnbv6pg9hVoi2id+ZvLcdUMmBiDrzG/XxznTDDDE4CgVnx7C+5DhGd4aa0NBECIzYMfv7chQLbgaft+cNBumq6dg6ULd+rcK9yVQYmA48BxQFpV2yzxUZr/k56braLWrll+ApIVVy/ciqhr0zq7cIYa9Xqm991zfD+82n/T5/vVv+IpYKdRRDkE7lCHoHKTFV7dPYIXLfrjYs5Ite3lB988Vt2Am88SQ+DNJueJJBA0ECm45E9ngyYvucuDuMqBpzeFOifg4m4MqkdZ9vIP9ymxsDFr3Eq2880GQd8eVz9+R2Afh6L45Jbs+QlDdKvO/2kJ16BJmbfy0KDBAJrRDuh527vNrDlj8ByWZAudOONmbz2HLrC1Vwj9RP652UQBMYJAc/dm8vhc5ELoN+/zKIt1jD8c593ZRE5eMUWtPYi67SxPtj7Kzff/Mb8rFv/2+a56crP84Q7a1nrA2TsY8dmomznBgc4OwB9Vrmg2Y662X2I4DRe85odMNicTi4Akntu0QflDUzZFffCVUzsGrhs33IF/ZzwT3ZS0dQAGFh7IJVzl2M4ANX2mx17+2+2MozZMVxNUoFo8VIyDh1YxtJiZT2pi7eySDPw1b/7uxea+evtgacA5XbjSu5akBemlG9YLaREZVaWG9SZVmH1qxYK67NTevYsvtmDNwZCpcOucdHCNcWUGvJhNFvPdUyJiAIICcbV6v9sV674QLnKG5584L9tTAf/K3QR0OzMnh0w8xub1aUBpHHuvTWXsFlNlmmXAXglFXlf4Ln5Y2pCIBClh3dbhmqtifWYNCB7nQibL69TwFZlEyQAbRYXpbNJbI12zKCyDYBzSJvHs44D5q8tz4I8d9JB64AT1b6LVM8/CgNwoBaHscAL7qGwWmJ7jhlq9dL+vAW2Xl0GsLjQ4PCBvbZCk0SQ118rKSTHQydPnlqaH5sZx1MlSHeJphborJ2Xit0EUIp7nH0LzOpTNd1N4XqfPzRPaVePAJQwmzr3zNms4fLag9xHq8yyGZOx8JSSIIMwocGFtj70j5/1Xb/a9yymm9+Yz2V+g+SqFTQg7yVU9LfZNv/Z7H2xxuxcNi2KKNrC7MjACNi1ZhCqevjg3B49BWBgZRYKkQSwZ0V7jkTyEoFOgOzqhT38woVm3AiFS/lY+VPxzgSze+05AWDSCLMu8OjFZRlqO1fhrCbW7QBbwDh3MeLfqJtWRf+LkfCkJ14FDgbqcqFKAqKwtLCwdPnclc2L2ncFUtkvXQfqdJbomX2kfPSL+C1Tx7jYTARbFRpBxSIKBkgbBBt1e8gmtstxZqJoNnJ244UEAuIE4SCT5uB/vPbZX/pnc18DAMbV/recn8R7KFfmjnHRsH2bp/68s6cxM5jUvd5baOsHWaucq+W+zdk8DTQcVkVIauvkhsq6EXTkep13cc6eRVIsXAOAPfQyTjY0pm5sX96h3EMBTaEeJGpAUZvVPq7lfk2szsZqFh3pJ0Hhko6nci3zv4ECT37ylbbwDfx5lw5YHMLa5saWbvE98B5417uqoLpP2yks8db9XIUjOXj6/+ZOaPfjV+RA7DmI19j2el7PCb2+wn+ruR+OGallbwCAUDBRQfWdGB34+/QS63kyT0/7yf91Yj0t/BZaKInrGP11zLZHelDk126D7206sJtVYUQMCNdpwsOHt38HAND8xCwhdCVWGhgpmJhNc1ubraimz4FTi26UvwGXKqVb6NZR6ivutC94d4CQv/pP+sdY+EQ5Ug8iO17P7Zw79o7lcowes7afwhjK5ZctWMmAiF2v2kUTBUpd2rIeWg+8IVAx0h60LajLoAwED9hrIgvs96LTzejCzdw1UYA4U+rLd8Vd4S4L61Y25xecG8je8+7j7aMhiOhoMW8MDv/ild//xntmO22l8bR6Y9vGdaIwc35t2/oJtW2DzvRRM4qkf+iF5jGoqhCuJpvDvTtW9FZVurDZPTNrhY7UdM4qIhHQQf3VON+0U6TkvjOP6WovWmc+SFKz1IteN7/Bdee5K7D/yd0hBTAFZIBpV+7YtselngBQTJUCLPsvz4n7AtrCGVWAAwcWUAXfAXCYAwKmEJsrbSoY9cCbxtyQpuU83vT62ewhM/te1fLqirVq+pzdgXE38Zw2e9hlEQ/txejc9RQFvogQYLZ+6zxzmf0AUQWbvPetg+G+39hNkS90IR+68/wkvj87l1VPq9+yzXG8+a1w4BlnLPrdI52OAMGJZ1y9cyn54x/XwUTo2iSETk035SoiW8YyOudqnQDTrutVAGv/PxuvMnb9JRSg+UMvr2XrwVh+4r/tuVTR8Qw1fsjZoJffmO4Gvxb7DcrfKOLYAej779mzjLoOxnHnmQkYIjgC3NzjrX/TpDDgnEYymUIlgBEtguCFO5wV7OkVmsxZrJl6o8JMZ8tQNl8c+uhHyYw248Lv1zs9ESk4mNia5y6iDEKHoIIWQ0w4ntPVwz9x6G++cb1c8270wp/97fWNjv9L6oZ9P9/Zg2TPlnX9c8trcH3W6y6kPAyLTsCmyxYIqjK0GryHnnLrloX3AOC9d969vIlmKcO8CxQJVcVIIEzBSFAkUkwVaKfik9r1KjWjQ91pLGop+AVo1Pe4c3eVA45hehW8cTfUQQOrecUcsOEcbh60lrEyA7oBipBVvKsUnEsWwBmiBQaBwaBGExnIHpMhgKgGsUDAq3jRyZ0cL3XSQFMl024GEDFLqXAKuyKfMS6ecrKbt1CUcwmQH9qAZDfa34lxOlEfWAGHovjCyxpdN0ONSWiQg6SN4ZGfufK7//PbyvV+AtIuLPy36VQnxZhBLhEU2woAt77ORJqq3csWlPkfWxgyQ1npj+Y+6unUhbWVadbFpGLcs2JQZY7jztOSktozSp2lFJn4mrlPjCkVrjS7GPvIx8vf9uNbUNN/NdPNVO0oiuKI33qIwuXngWXnd12vHMeFqB236IFArAPqytLvFWLlBkSuavPKK4dP65Nle+DVddQIom48BospBMZOZ1xNs5lj1mBz5pIw67eINQeg+I2UzNp55d59cUIZVRN7jMK5iv0RoVojI8s4Lv7aVZe+6J/6oT4pPbN+2Z3jTbrXYrTG9ayhkE2oLQ9py1YeopVP2pXMKfhuWBVKLO1Um4/Mnbqn0WBwMBMNs/u/qCZIRWhhfrxkVSVIGWin2fxzpXJfDWgFbMVwmJHrc46GmZVbgNL/BS2+Ofe3yRxo7DGXEvn+1mcSooDMuWsBYnGxzE8UVSCEgNGwtlYmsNoR40MB4LA4Hue+1nYmanMnQVW1E69rdQBl89X1rpHCjTyTQ7M1r+lrbT2fTbN1jrIHTdZ9XbgfMEGHOCTzORc1lIBMNjRBOjCmkLD0jmb5up+im3eKs0ciuvXWNM7xT63Cja3gvCjnhQv6EyjX3GdIl4lRrHmyNSY8DW4Ly0uI63G4eO/8uQudH3eX5YwGfqxqECGVu1IATIkwgZU8thNrYWZOYxuPAiaCjRfBOFD5rIhWa4LuSCr63zxGUf7emhDgvKW3pouBocW4cJFbBF3Zem5YQKwOTCWEwBiO6hnzIHbGQyAKYb1KOzkeZQrIylIcTO6S7oHkotd0In+AbtVqMnCykOuCbjikbBkiFpiEit8gZVSDAK4AQd7iTcyIgAqYOkx48PHx4PC3H/7O//fEbA8jPX48PPS+/2dHz5JCHegPuxZaKtl6F3uZ8nM+xbKpANnTsUTVGtWQeegLwwZMbEMJmRZOjZulk9vPDQA0Wn5yxxTNDiPEYYUcySMWBrwWwLRVtNPk0sU4SnGZkJqLp4QNC/gMfw5C1+XgRpOBcHYdfqn2ndp9289nOxmQ7PPCvcSjJAXHonacwukMcHO/VVvOftDY8wPZOqjKgDJDmTl1w37azh55qFiEuOtM0YUDrd/8CrQkgboBUWou2LM+5rlJyUgpXQLMJ6jgihEHEeptaxUzTlJnQgBjLS5MLyxc/beu+L4339Ff4xw9dMXvfXlef+uPbK/gL3RB432pkyw+eiJeUC5q8nbbZn2d53xg/lzmns82Iqgu3P7kNNmy1Gih9ZyfNymuEwZoVKNlRefV/J2qAbDNyN18B3xARfoCdCqg66/Lxan6xZX3vs886OBA7VmVfWKGn+/bi1E4qEp0wm98dooC+Bn41HVGgaVvEYA62tIygEsJ9pUBKHA35Z1WbRuUVYRC6yfy8kJkS3+i5O+LeOpBOdPbeg4iCnK/mMV4y6BkUOxQLTJSILtzUi8RZGREMDJaqtPG6PA/ecOp5/zn3Vwn5/7oe1ZH7cf/8RI+8oIH3vVdw+3fA0DQ+FBqKQdN/gDdB6bOqed0TvhDZ4G1JnMDR71DlPUnsCdVsn6nHFTrvb9LN78xbz/3az9wamk8bp/eimedhIgwCmjZCy9J0ZIiC9BtZkjnHn6UdC03yhxoKBGL/gxqzXUke1rTHIdAcSKraaREyEXPljnDweO5BYD2x5xxVUBXeIkW/c/2QwGdT+YssJrmgigSX2XXV/5jCqnpv53jeG66hkzg0vukiKXiZvAaWdWZfgdnIP19Z1isFrM4KLJbvjFhsFxBYgahZDjXABiZBKwZSaDrgwO/Pa73/MPty7QDgL7zlkrk/h9jnL2pQbhsuctbgs+FdJPOT6faaUlKULvVGfCsR8p8E+/iHM8CiI8RkaUbWBKquSagGcL1GR6Mf3/baQEA7/vgA8+YaFhJYCTNCIMAHQRM4ZxOBR2s1rgbdzPne3+tNIvsoICiIKFwvGJUGJcwTWr2GSnmDCObMgU4BjzjWgYi5169GIfrfUV/c2xuSzTo8Qr24xmXU8DWNCF2PQ8QZkjudhG1U+8hWHQ8Rc8J1OsTTAF3fUnmuF+J65ZZ6pxQBaBkvd9y6BCXI6T2S5XsvMQyYawWVrFRHXhXwoHvf/J3/PaW1RQLndn46FcO0se+p4JSIF2Iurwr8HhpMJm21KpGb4/rbqF+gH1A5/4ukyjDsirIFWMhRVAgCEMI4JDBGj8yXts9VDbW5inroa5aBTIlhEVGrgktwaxa10A0K6abrUuN/un2HK5QuT7j2L75dz0nVLd+4aE/B5A9j/n7teOZnjb32RZAGrj6S5oXr7NL9O9L1kq5TvTLjAmZ/LVFsUnq0d5eOszcKZEEImr+OeNmMw42myo9p8sE9ixkyh76Kr8R/322h53RoVoO4AVC5qJR1MaG0YFU0CTBBq2cWBtd/n1Xfv9vP1Cua54e+P2vvQHtvf+00Y3lqAECGk2rzb3b9wOAYbx0Ksptcquyr6coHawSzAfp91O6HeRsOWblKgkE5Wyp+zDOlxCQsfCeJ327dY3fTl2OL2ipZghDIKiWI3L0uCwULVwxbxXtuq3uWMBWgLUdfHDAFKCRGyFWNlrSzkry7uz37L8VeMuMIsh6sHlnT1XAfYm9lYvivytAnP3dg7OYQmqxbYVZs+AIMEGZbWE2VgUu9LfTA28KQDX1vlsVL37RYhEaqFjMkGCxh2XfmeVYdEIr2LYH2nEHXgaqJVgtq+tamcp0agBiTEIz2eQDP37Nd//WO/qrm6O7b/vWPQv5gdevpPYqezodbBlY3rFSNgDkZkNLdo1dr/aWrKVBAbbCladHeWKDj78FYtyHQqq+roNpRhMs5WrP5b9GtFMVeO0HTi1tJPrqTpMZLLFCWK7REpDUVs3NsCQJGWekzc4msJQuqIacea4GOJAKtzM2BpUMyZb167b3DrCWlxJ/KXsYaBxoDphi0Srs2WjvYrENHqst4LVEBv9MbKpmgXsDXLcLxv2IWMJmU6bFHPDGmwpGRiBogM119TZi6tkaqQTU7ULMJ1YsRr+BnrM4ix8ImtUACZ3pImoP0pZyNzHboUkXBod+9vIjq/9uN2NC33lLtdh96NaG7nuBsgBq/U9CzoEp7CgkAYD2YQpZwSrW944E3pPZc5KSe3GTQjsr+OnbqM3pRma1uw+MMlgEwgt3dpLet/WMRu/50KmXn+OwnNCiEwEtLkCWakxpVs0vZGObNzpgKhZS8wcN52LlAuaBZFxlxt2MqxlYTVWYqQzzo2jHc0fynLNYYG+KNWufle+LgVHA6FzawVc+K8dRUmQRdCk5x3PAmWEBIUg90H6izqyMOm6CaUyV98EvjaFQIhHkNRYWfLeGi+bfI50ZIyqEkCNYGTlkDA/UkKqFRSntAks0Q8gu8jxW39fRgX+xm4WoqnTyzF1/ZQEPfgfrhIRa70BqvhzSdNn23wBAtTxhCNj6MhcdlTx+zAjZusn7o0NQc5qbvjJ7arbcKFAJ+kRUptEfX37HjdMtJwRw9LiGcxN58ZiYJAdkEoQ9FbrafHdmLarVaCXF9MIUMhUHirtSXIT5jAb8IZnY3MrZCvezUlDjaVbL5sgrOlfhcn5bCgfo3NkKiHqwwfMZ/d56/c3voewnarFiVSBLxqQVX0vXRS4YEiJyoOkl1wz6xN0eeFWoJ8r1JtcRCAAHBke2V/ZqfnebqFthxvmKb8xvzBXZzB2aAwE0MhO59D9Rd/8TVSANGPPiw9oc/qGrvvu3ds3ivfDWo9c3euKng66PgloEApTAAmQWWH+xndSdH4cAstxs9Yeulkmt6r5GLUaQafsChbAZEwQvOieCUEBQBRDQcq3T6uDvlMVZ5qle/PDCmsYvywCyROQaCHsjcjQLsTxqwPIlp+dbU08cCPPcpXCwYijMRKz79lRdH7L35ff+45nFCwOLv/HfGXT635RvdQawMknsKDZ2Rccrh+73898lEUxatYo2IqjreMqMHPKFu86iz6Hsgdd2m61yWKMmgiKgQU3kRlsgD9HCW/Db6f22bmCIWI8VFUGHMWg5o9rnupgGZEQojBOyegsyXZyuxT1/9/IHn/nH5Trm6cG3fsXBdu0j/24gp66yBw9/SNlWlxEBJO3gkgAwCIiaJWpGv0K3ObPhDaaNW8PFr4j513x+GAciE7oK8zuyVshh+QN5/6H/b/v5AIBTfOZ5qZ+SRdGiA5Zq0HKDKQGJvX7Bj503EyYXxggC0z/nANDDpABqS46guv/OE/d83Auye2A7+ErUowBKimHhDKT/28VoAZbh2TmZZ7TMO5d7A6wYH0pIKWNzMnVjwupRhAOUgRDo/B24Y6dVu+/goE2kJzCoQBUBla1hrhHQqAbEaDllFLytlgfTTYyxtZ1QBRrB4qEhJPpq3hD3I4k3RVEIEdZo+XfCxqF/uxv30HfeUlXnT/z0Aj3wrKAtQj9rDUEFfMR5V8tyfaMNEOH+lO4ANx3U9ZRMoGR/J1ghizmKjYw3KwjZRK5SJiy+4fpX/fIOMXvsttviAxvtd42BSkBIJKhXB5CBpUABKCtGIGRCt5Ygm8kmRBGdLj4xb9EWQM1r+VKypcWMki2GhwFmJ7lrSJ2DFX+b63IFu1J0Ni3czt7b5zMOKCCL8/pnAkLbAZNpsvYXzMiBIDEAHFAFOo0bbugvrAcevfeSpMwnwnAACdIDDwV4UUERkGCLrVIgEJsYJnbtQhUZCYuHRkBjvU5QboAF5Ml8HQWs8cL9Ojjw96742/9x3I+Nk6rSvafu+PphPvNtlSZWJkArGwaSHnSQBErTXUNWXAkxudmW4HHlWVdSLZa4t55NbOvYFr12lnIvYEoIAKZh4azQ6E3bzwUAd60dOHJK6MsUltwpDaHaO0RXGT5Yy9LwBOqA9vwEaF1szlicv9p7W4TP+qFYv5my+UI2Wz5X65tS3Cz9IQuIi+icGRf2z1zyQL/ZPqa2m3pkoHTwOvez/4oRQpi2GW0rAAdoDNDAkMAQJjDjNG6dlYD2wMPRmwWRH+JBDYoM85iaiKWKQZGgQSHBQKiRgIgegBqAHDN4D0B7BW01hgAgrQCYbsYiUApoeXGyWR/6R0e+8019eeI8nXrTq56w0j382hptw9kawJSmNgCsgkETJCcVbXd14nKIC94OFOj9ivbKHgZUrzcUlR50Jl6d1/VsKCAhYxqWfuftS02/1Og8nV4PX39BqyMdAiZCwNIAeaXCJJiIDWCrMFVAp4Lx2bF5kgsn2aJKzOtsJhctLGZit7zaGiKui5Z9CjmK2CeQ2xozkPn3Jiada2kBknNG/97qLYqINY5XTlHErChhY3MTXRYQR1vhMdhGgVUE983b2jOOR1BN9AFarJWqCI0EtYVVQQGgihHqgFAROLJxwsq4ISoCRYIsdFi8YoBU+SreBFPU3Siwy611guYPs6z+ejn3POltRxd1cvoXBmnzKhOApqcIT6FesgjNVi4omxJlc1fgUaj2q0osvju4/lkcychqvf/EFsjMXKxthRUe2hjZZwFdWFzjpvrlm3exvL/3+PsXH8x6ywQVt0KQIGgOLiONAlqINXgkNR+/KtqxYHxuAljNvYPJjmXliq6b2ZOfBfWLoVHqKxxsqgbC/je9YLXaW8AWjFa42C6HK71ZnKOVmWZAdEnl76UXzXN6YC+aFYBg/cIm2k4gbM9eie2GYlQN+cPzYzbjeACoGt6FhpNUEagtY7boebB1jUGVApWCI9mS8BWgFQGVYrg/QhYmIAiqXNlFWudDj9cFbKJ6uG2Wf/za73rj+flzw8aMTp98+OZBt/ZScNdHtNULi1S91wkEqgkkG2k67Wbu8DlS6fYyCVkaVzRnsdjgisKb+wgSKSQAWtQFMvZApBZkV4CQ0NLKO7oDN+yaKfORvPHi0wjXazInMRYVcd8AXTTdrHGOAzL5NT7Tgta9JtlBRjBgGSczERq8Sz2pWksRsVeIWm9qF7vF7YK+VtiEogHEUFuKtAs2C/frq8cKkMTEZvmsx7I6lN3tMwNw0fMEJ05uWk5htIo6hJLkS7Jn/8p982O2BXi5Gj2Auh5rtCphigSK5lYhF7sazcdHkUEhgGMERQVGLQZ7Yr+2lc27AGhECmKzWyPG9cKb2rX69vnzFnrw37/qCmof/nsN1puQE4JUYKlBuQJlKyIBjHswCURym1k2tx8HALRLB1iZZyLWXCfkSxhYpoZzHF890XxpAaqVx5EtUpEpoKP435/wql/ekYx6XDWc6ehvbqKuSBNaSpB9C5AlRgcDsIk7srW5W8Lk4XWEThGz2mQonGVus1oKs2J78eoiVkV63x18P0JBytzmxwXg3bqKa8nFu7vF/GHN9lcHrT/HIo7LNZRohYHVRK0q8OBD59EpQdyFoszQEEEs44Wm3lJ7vAV4q1ctn5Jq4aEcFRo9QSIUjkagCiaC62LpBmgk5Cqh3g9g6IuqzbkNbC4nkCpaHZwJC4dee/0PvnmHVQgAIZ35zqGevTxo5/HfYDdIZXYb1zM2KFDElmPcFXgV46royookQvYYrWZrf5szrPqLCeLxY8tEMUWvtEQDgAmPTkx5dNylzRb6j7/57heckMGLkzBaBaRR4JJFTAZARkJFnlfnkrLbELRnNi1/0Y9WdDzzh3roTEwVQLZoCUkG5WSO85yALOCSzVJeZ2zIJ+jsOkng2TczLiYONOOJplzIXOSi1z0dqH2sV/13hYMCEA248yP3AKGy5kQxACFCY0Dk9tyZk+dOz65mG/Bw5JYxx+HtOghARabDBYWyiSMJDrwIoFJQBeQqgRY6hOWEzFOLd2IeLIooChCjqxb+2yVh4c4t53R64N+88tnN9Nz3IYMlM0QqZCVkShAk94EaD4K3axCN60GaXbNYOE+fyS7ibLIWUeGDS4IcAIkWbgYBwsmt7wxGghDQ8kCmvPzLT/vON+/oFvAt//nP9t1+vn3tpiw0mjLGgUD7h6C9DSZBQZIxoGDuTzXrevLwGGmtM4vRMzrEWEdhIVsAyGryrweYJ4laDqPLRueIKI7juYVlZjUi82wNPpbqALPrKONkBVf2t9XZzl/e1pBb+S5l4K67H4RwBY0REiOkAC/Kh2665aYt1YFbdTwi5Sr+AQ8aNcexAa13HgdyV4qt86VBgBqISwA12W5DvRGPcwwhq9WYoJpsxH1v2C0sdvcbXjTQyckfrdLmHurUMl0E5jYRMR0tW7Pn4oCyAaoeWmwGO/x4evx4oG58HZcyP3doEluiIgWbPLkCUhBLz1OyvntueRIUmSqMdeG+hYWVX9ut0Ojeje6rTsXRTUkiEgnaQQIf2YM0IGRRNBQxsN7zBuyJYnJiDWFiC7hoiUzMpWttBY9FK0jhup27Tdyi9YbNLgHc1vT9C/VMz3Mk7dDuCHYup6Y2brlBE5/+PXzce5NlDnw+cTYnUzx08iw0RGgIkEBACAATBk182xtvvnnLc9/K8QDknD9YLSwkKiGzyEAVQBWDi4VbEgkigCqjXvAFhV3G2kxzUkJGhRTqP73qqVe+devZjOoWzxrIhZeREkKCNfdLtgYtZzbQSfDxVeuuqQTR6i563s6Y6R+959/sDZoOcASoInBF4Gi+R0SGVgqJAgniC5gUB8FMeSYNEI0p1Iv/5Ipv++87uN3X/9vf23f/Jn5kgrrqALQExH0VaP8AqbKHP+Jg3N5DBOl8wvT02NUIYxU05w4pXMsm26ybgUru3SlbuJtYjNwyvN0IKRdYADyDTn9/ZS/Tz+Ccb5YOZqD0/3yfmQgu+6sn1Npn586Psb7RgWIFCWygiwAzOlTN28tlFdoBPNTDj4TB4ibVARTsgSGWSIYAtTmXKTIQFTwQoE7eqciUdMBmGDyVvcOgSzr8f+lZs+5Ohe593auHcbr+t5o0WbUSRIKksGWxFRHrvEviKUoSbQLy8tt3S01aOHf2khp5GGMAKoCigKOYA7wi5ErRcYawp4XAZLIl5bgIpgDB8P0yqf7DtsMDAE7l8NWneflJnTbIEKQBgQ/vQVogZAgaEEYgBMoQEqBTtA+NkS4kE+3ZsmYsPcwjEHnWjcG43zz45tiSc0kDLhCELLJTMpHduVw2giWy2vNxEJnu4kF+P5zrcX3zIJ2J0wJAs25tworY+iEg4J57H8A01RAmUAwAR0gkcOBTS4NmhzdgB/DGSR/SOLpfq2B6XFBQMLFLwSxZDexgFFQD9tSUeUY9I1VFJjrdyfL/2v4dAOT67DNiN31JlQOiCDKsMMhy/UrnKct4Nq5nHKmTOmugXTmohPgMqNahilZsMhcCpAhkWD+6QgQzhBTRXDUAJlxNJs2+n7zuR35vRxXZN/+ntx58cCMe2+BRndWARgcXoZcsYlwDJAkrgVBbKBgZDNkQrJ04B0nu+M3m0yvx1qK/FXeJ5d8XHc6QwdbJ2z/LxgndqjV92tGCuccxF681Uey7zBkG6pOvfFLEvul17lopAHTcWwq8QTRlwQc+eC+UK3AIpkbEiBxrVBEfGU26h/xqetoBvMNf+brNXI3eqnWtZmCocTrnfBQJVAVoReBaEGsx9bTn8VtJidFRuP3SK+OO+lM9fjSE6ZnvqvN4BWqrwxTg9Z3Z+4bBJp7UQ0iiYb3SrSZ6IZluPDMyIdTROTNBoumrEoBJtl51cOOjqAZBLbWIoJiE4e8P8/pt248NgN57avotJ+oDVyaJ1lV+AMQjS+iWGMqCERTLIAS1Zj0qhPb0BO2ZTVu0RvwB97qaljwzC4/BNw+JlbCYgS2ZXtdzx3nlzIRor+PNi17/vrzMY9T+nrlFeqMBhlZVzy52MM64YUaShK4DPnTn/chu0RIzUjTDoq7y7a+48cIOdWgH8KzMgN5IzWAq0a1bj9XmSJAKDkIAVQJ5Ey7t72IrZQ2qcfj79FVv3uEDu+fkyQODvPFS1kRJrLiYLM1uBr7Mxv0S2cwWE7lZ44lzk8GOOO2bvv+VTS3pyUQAVYBUamHeyqIt4+mkdwMAcPdJkRgZCRGtVg+jWv7RK/72n+6II3/Pb/3BZSdl6W+11DCrQIIiHBohHhpAo6IWwTICIjxqAwJPgI3716DrpreSKFjE3STG5cyCdTAlcVeKWLVe4YTZ9y3fW17/rHVuccm4fseA1cSJ+SPnTIXdpLaDyTmcOP+bGyv1GG3hhAJAiTAeCz5+3znkipFjhMYKEgOYRZYXqzfvVrS1A3gAkCh/ALE+obEGheBcwxR1iurvFVwJlLveqNiVKLSqzTt2swr5wsaLmk4uQWZTaTWgyp7enIGcCJoYSNZQxwAYgK4Gcn3nka+5abL9mMN872qF9kkxAFqrba6Tdl1G187UTPJiFMCSPRMBias8ppVfvv6H/vCD88cFgFe+6U3NHz64+XfP88oR4xIZukCgK1fQLhICMpYyYZUjQEBHhJAYeLjFxgPr4GQFUuTdVM1BPONalt1dQGdo0DkgFjeL/aZY/Nq7rQq3M5E74+RUADTHHArHK2K0t2Dn91P09RcFpPa9ZacYQANOPHQOF8630IqQK0v8RBXRUHuSKe9ooIlHAt5eDE+hGt5h7fHNOqFo+fMcGOQhNGs/YTHO3UkBjesUqx397PT40cBd+oY6IfY9kzNA2d0H6mn1nUkhTYYMzRGSIyDxDtCtO8C8rINLqywHYh3tmmtPcFDFxvqGCaO5LJTytJQIiYNmqv44Lu//hd2cxRv30YsfpL3/p1nV5gOMR1ZAhwaQShFzxp7AqJXsicIaHq8/eAHpQmv31pcSmH5mByp6my8CU9wkYitPmvGRra9w9u/Kq4iBzLl3md9mKdt1my/PgFkeuM7pbDPwzTaPhcyA5oylt3l73S/gPe/9CLoMSAjQyBBPnaNYv0MuHDlbxm+edgUev+qXpyk0v6kBSWOA1AKKCq2CidtIBj4YSMzFwz635knRIZzriHeIxBMPTPZz1i8TNfGhOUCFkb3XCdTCW5oB7WxFaG4J1DFSRm4lvHs3cETpro6Sm9hEUGALh4WAjQsbtngfgkUqPHxkaDeOkbU6NQ3DH7v+B9+8I/777f/yzXvvn9Y/fT6sLNqDENC+gOryRcjIDJ4FEJaIED0FqlJBvpBw7v510CSD85xB4FGJAjh49y3jXgKWBJIOlDpQ7kCSwDmDxNbw4JxB2axXgiGncD+GwurlzeBQLzUMgDme3XUCdx6b+lxEqgHOvD1uZBCQubhT1BZWgQUJplPg3e+7ExojEEagGKF1BHFAE+Of3PHGozs8GXgk4AHAgNrf1VDfw5WAS8A3WrSCKgWCO5F8isw0ga1ExA/QZLhDV0oXzj+natPBspALZTUfnniBUYaBT8y40A7IHXn4iycUw3u3HxMANMZnKkmoRrVZ5cSYrE0xXp+aAuuVbkGBAEFg82t1Wknm+h/dMP2zHVVuqkrv3dRvO8l7vwTSWJfNhYT68j2gfTUkAIOcsZcrBHP822RsCZMH1pFPbiCIPbTC4QpYVLxmIltya9/cUorF6/uLccne2i11Fj7+ljTgz0AtDgvnaJbwYDTPGgo380sxHa5wPn+i6gDsdUBPsii1Fg+fvYAHT54zLhcJGmpIjEAl6erDK/9jztTZQo8IvHs2cSZR/ScaYC6UKoAqAaIaAIOAzHNZrnoHKQAluv/I6nCLVaPHjrFeWP/yQZeCJngVv3tlMtuK22KdnoIEcDbrVhNBWkbuBg+Hds8OE10VRKn7clRANaws0tIq1k6ugST6jBVfssDcCBZ6q7ERBv9jsLTwK3SrGXPz9PLXv+kp99LKT4xpNWpiCBL48BC4fBntiEBIWIFiDwEBljsIBdIFxfm7zqBaN/GZJIGydUwgNxSQvchXE9jF6Qx8RY8rxoQDz6MYcH2Ye71sBkRAZstE9O07ZjAwzjUHVHWAeZ50AVgRqej91hZBUmQIAu7+2AmsjTNyFc17EGpIFTAY4f3VwoH3bxnIOXpE4D3l5je2OS4fz4iJAkMqy0BWr8eAF8SYgC0q7DYyG2ETt89SngHgdrxlFNr8pZQEkoMZEV4bYfUR3l4iGyitPx/b8qCJ0bX84OqBbkeo7AM//rK9Vequ5lpBdUCQGqfvP+0Jl5byRLAmQ5kEiQFFhYkO7w3L+/72blbsV7/+t0f3boxee54W95FOLYt6hVFfswpdCQArRirYw4xKPV8QBJko1u49j/GJDVuatFiVWsSsmGvE3SLc63XO/fIcyJKDrFi0KYGygZddTyxWLKHEdO18BNMfLWDmT0nnnlnhGw4ymYts2K7q8VzXTcv0VYJIhT97x+3oqEKKEQgBqa4hAVrp+Hf/4NYX7wiPFnpE4AGA0Mr/Um0+xIGhtZi+VLmVy1pu8xMcRmEB11u3fLrYyRKlfAQZQIrgjsFWdmvO4lLzmuHpP5auVCLrknEXveQPdnR9n5w9fVktablZqMEccPaBC8gb2XL5yK6XwMjsmoIy1ihuTkPzw0/+sdt2ZBYfPX48PLQm33mC971claGUIdUU8aoV4PAQEhWNCFaVMWKeuU+EQOcSNu86A95MEGRQVnDnIEoZmpMZGz13Mw63BXBZbMl630q8tv9eDVQ0l6Fs7MmhM8f9Ssx3XjIZ4NTYf/nbrddcfHZq+9h7T3t3D8S5s2N88M6PQ2MFxBqI1qojxJj2cPsnjyRm8QkQAwC49Gt/dVM1/FcBKUVYXh4HIM79TF2p2ZXsQreTdHmZk+5BYlBH4GQxWu289jUBmsSMuQTkrMg+iyUDTPHd248JABXJYYY0o9ECNtY2sP7wJoJEGL9x2CkjkyIqQBLStAr/pL06/5ftxwKAUydHz/qY7vvxSRhWFsEjxEsWUF29Ch0SiDKGolilCIYp6ABAU2D9vnNoHzyH2AmyZIs9J4GUiMUWd4oBTiXPuVM8wtFbvMYtDWgW+TAXilnsBjK3UxVl0tv1qOmSds4S052J2qLPzRzDdoz+sH44M0BK1nPAhz96HyYtATGCYgQqA18T6cQLn33TrpGqQo+EmJ7aVP+HNtP5QMVpbE5Z+EJ1tpynGxlORZcwXsgMHNtyTF1vl9HKUDqCJEVOhCTsy8PD18XwhopaxDCs7YNSanOzaxU/qny5VAihrXHmnrOeTucZJ5aQBoBQq2LCrOfi4psX9PDPPeu73rXD8vrLP/ufDn58vf4XF6rlQ+IikVcU9fX70O2tIAzUkrGHGQMCGIroQfN8LuHCR06DNpM1LPduWRamy+4jyoC4XpcFlBSUzMdHWcBZQCm7VZuAZBtJ9nw8A5665crqDTPVWloUa8DiAbZYFmDZOqyzLq7Zks4sIdY5G9xd5DDbwiWhJpVUA/78L+5CRwPkqoLWgmlVI3KQ1cXwb/7Nd7xw13S1Qp8UeId59IGuDb8TWqiyWMzW2xKg5yQ7uVohBjW48Y4tCmBs6oEAQebaSJTGwJrUFodxV4rZ8s4FrVhnmjrZ1TeUc3cpsvCZhx4GJcvZU3iLLDLdNHO2Vi+hfn8c8i3Xvvb3d6Tg3/L6d1Yf1uonTvLepyUVW79rAFTXHwAuG6EOQCWEFWEsBVu4ns2dBmxmbN59GtMHz4E7QLIBhSUhGPs2t4eLT0kZmraJ0D4Oaxxwi+sl+2dS4rPzhoXfwBa/nvn0COYwN3HrmSuEPp4xj695i7bfnPuJKogDHj5zAX/xgTuBKgKxQg4DoG5AFW3UmP5uP5iPQJ8UeHTzG3NMzW/IRMYl2lyaQc8HK7Yga540rd7el4IbVRVzFUsbW+/b1RGos7R0ss7UQGeimDJZtoowNPG0Cs0jZB1X+6IyoQOC2IK94q1kWcmct6TY5OZcx9X3Pfn/fvcOyxiq9O5zH/yG+3Tvd22GQSCtzBK+Yg/46hW0I3uQAwH2ckRUO6Y9RUI62+LChx8Cb5h1arpX4VJzFmrhcs7hNGdbaFjSnHExtyXz21E2fyB6o8JDcKpeBmkP1bTZ7Y7k+fucf3EDwoFl4TL7TEuEojdVGCkz3v3eD2IqDKlq3xogMiLlu65eoke0Zgt9UuABAFbCn07b+G4zA4sMNeejG0a78zxVVCoHD5w8WW/5vM6KhkBNML0iE7RjoGVzFqfgACRoZ05jMzgIyFXbtrTD+oQJ1X3WAaqICpP7DEVQ6/3Sodloq4UfueEX/uKPd3NAv+jn/vON9+f9rx2HOAgpg5Ig7K3QPGk/ZCWCScDIWGFg5Es5WeElQdcF5z58CuMHLiBmzxl0ztXrZ25cUHKDQQQkZqWiKyAzx3GxXjlns3pTgqYETaUBkmesYE4hK2nw/lCorH9RgjWwksfC/Uqso3etGO/sQ2hmaBg0zc0CjFvg/R+8B6hHkCoi1xFS14jayb4G/+zNt37LDgf8dvqUgLf/VW++ME7Vz8sGpsH9OhTMPfFIIdpChHR4YWFzcctndZjSKIgOAFS+DEAJi7VuZJQu1Z2BD4mso1OiKQJ2xGgBQDJq9Nm1RdQYUFQVk9C04zD8h0+7/9o37Aq6f/Trl31kUv/qGT54pXoOYF4FBk/fh3DJEMxAlYFFEFa8nS+bOgEkYPrxNazdfgLVhHqxyCIInYlTTRnqYIKocbCUTNQmD5X13ycDZEpANi6IXP42cU1ixoQBbZYISp4+ZX68Wc0HtnE9A52HxJx5zBsY9pm9mpWrACLu/PDH8cCJC0hsPjtUDFSKQcgnjgyxa8H7dvqUgAcAg8X0e3lT/sR6GwNEwS/rE1NAXmkTH5z/rIpYw4AnNCDwIFqalRJyJ5CutA0zMFr9q7cRMxsmN3mwq3+IJI/hviaF6XjFMz2NlMcx/sqeg3teR2/cmX5/9J/+08UT0/rnz/PSc1QJXVpAHgKDG/dDr10FKqBWYADGKgc0DnASgDugOzvFmTvuAz08QZUs0RMpgTtBSArqXJwWMduL0ZleZ24W55BpTpdzLok08wFaHHfe9LQnUbidYmZgaDEyiu7nr8bpCtjMiWybHUt9VUmFiw8F2jbhHe98HzI14HoAVJUV9pAgBv69pjq4o0P/bvQpA2//179tfdoN/lm3Oc4BFShEAAL2ZZlmDMR0P4V1DQLlkeTxlh52ujw4J5HPU6PIA0AGNbixq5HMkBbQKQNtgLZsYriLkI6hncwfahtVp4TYc9jIMn8JyBwxDtV/7+rFv3v1rX+wk1uq0l0PLf3gQ7Lv6zYxYEkdAo9RX7+E8MRV6JDRsYK1wyopFmDGKWVFygrdBKYfOoPpXQ8DKaPTmT9Oc4a4Y9iSOLUP9pvhYBzNIhheUZaco7lIJhfJ5suz45aaW6s0c30PXsNRQvxz7I09rFb0wBlYZ6yjNyoIEF8IWR2A5OLtwRNncd+pTaSmQa5qaGhAoUaUML10MfzqH9z6kh3+1d3oUwYeAXp4ePi/j8fhrSFnhAhkDuBcLnerzO1vRxFCCDfNcXuclbiug+qEDgk0JNCIgGEAGgY4ePq7iVttGdoSqHXjIxPzervrdXe5u98yqRSJbP0tkqjrFN8mg4Xvee4vv32H7nHs2DF+3s/8+jfeo4d/apMXqpgVObTQa5YwuuEIwmKDqECdBP9/e18ebddV3vf79t7nnDu9SdLTSIwsm8k2NcEOuCSrjkMDDnVWCkUGYiAJQ0gaiKE4gS4gL2oWLIYW8AA2XgyhKaUsJUDSJqFAGgSGmEEYjC3J8ihrepredKcz7L2//vHtfe990jPYeMT4W+v43OGcp+f7fvcbft80xhotr6BLCPVRAarn4Q71MH/rAajFCsqGlqsBHzcSKFgxlz6+ZqMJdfDRf4vLC8PPkOfx3qDxfAih/ah5DYFE+EsQArhG8hBEw8AQA80mum+0/0LKoGIDOMuIEpItRN+8cRe8ZyhjYNMElDCYS4yp/reeu3nzKb0V9yUr/gHvS9TL/rpfcfaufifvEDlAG2jEcQUnO3vynIgIlp8/+1e/3ojvHJzr96hZ+xHXDajGQMZATUCoakJGeq/gAvAoaD+UBPR95ky5bL/9QLT5ETOVTFIE4EhzT5kbTXPi5ed95KZT5yoz0w3mjBfs77Wu6pixmlTEWNCGBpJnb4JbU4NnQOUOjcJjwmokOYCc4QsG5wy14LD4o0Ow+ztISpLAwNuBthItFf00OVNlJXgY+HhyvZhUC6oC0Gzk+MQ/RCVH1HIDvy4AECHYEK0a05lD8yteXbSakbcTwCFAVMAXavBYmoy897Be4eDsHPYfWgDSVGiURMGRRsq2GG+4a65/w/mn8KH3JQ8IeACwlC7emBfqi9YaJqWlS2u5xgbCtwvhZe2LM6lYGmxovmjbDota9nWXJawyhqpxAJ2CqhGopqAyGVUfAw8fWrmoQlYuuObIPzWUDDd7ZY7qkN/tefpBv1W77JnXfm//yZcCoAve8alf3N2b+NiJZPV04vuAL8Grahg760nI1jSF/K2AtGKMeYO0AKhk+BJAoaDaQP/ueSzdPgvTj9oomkc7ABxsAFqIVKP/NyCCgzYjFzIckbezdgBAWMnlRlMbtV3MaEhpfARf7L2VJp/YczEwrzGyGkRYwyhW9GPQfkE7egYqr/C9m3bDAyizOnySQLMDIcW47d61tup/bfTD/UnygIF3zqW7SlKt9/S7+rDRGlXsXTj5wijESCgfS3157ujLRbP2NV/P5qmmQXWCryv4OoAGgAYBzWCCExnUXTkPVxF0gTpKv+LA7WdedcvRHtFncpVwW6l9ujH2qgs+fvPdJ18HAC+c+dCTj9j00/NonVayQQENO6ZQP3sT0k2rZMh44ZH1PMYrg1ZJ0AXgC6kP1H0AR3LM3bIfNNcDOSupsZBxEDMrUWjk3yIXN+D0BhpxRMNZuU9M6xCgMQKGs2E2SjC1I3lYCtSK/C0GkYIcEiUI0ELAMXhrpMw9UiaxwliKBjQOHjqGA4fmJJhIavBGBmzWq66dcvNX3vjB161I6t+XPGDgAcAGvW6vL+jDtvSVJdlhFf0LkfiYwPBQXCXO+xfxzPDf27Rn4bDP0n/hRgKua/iGgW9o+BrAdQbqANUUdN1AZRqs5VvpSq6xT542/LeGQgBXmfloW6v/VzT1H/zif//hijNaXvruK6fvbq/+5DE1eTbDQlcWPtFoPH0Tks1rYBMx86iAllMYrwhJn6H6HlQBVDB4ocTCrkMo9s0hLaQJx7GFqqQYgJ0V8xhr7QLgZL/b0PfjkL+NEW68VqiXIdmMcK0sNQwVKBAQCWc3+nx4jJbFy9uRJgnmNpjccCsQI9kBV0YoS4vv33QLWNXg0ppMdYc069fd4g9bmv8GKwxN/3HyUwGPLt3ufL1+ra+yrxiuYNkP95IRA1SBUYG8gkcKpSzVfXHxiTMv3jj4Gdt2WKpnf2nrxvqGEi1X1+C6gqorUI2AJsAtBdXUyOoAZQqcJQQufnl5zDaU51x76/5GV7/oOZ/Yu2La5kUz16y/+UjjU0fR/FXrU6KS4FKHxtPWo7ZlPTg18BXDFB6tApisCGkPULn0f3ABqCWP/h3H0N51D5JeLr6btTClnNlZUCWmlW01oEIojEYTfy76dPHx0CyjEk2pbAWqSqiqBNkCZMtQjSy1dkKEBE23TLPFKJcAoZfhwpgyCRiCPxf25rKSZcjCRkQ/T/ptlTe4Y+9+zC104ZMa2FCokNZIfbeaphNX7rz+rcvmotwf+amABwDrLt3RcdR8l+fsmEz+TEBeDhmuAjBZKHZgaBDspOsu/tYoYHTa+hdOG0dRBygl6JqBaiigYYC6AtcVfDDDaCiohoapayTKn42PnSf/yApyzvZd5UoE8fP/6D2r953g6+Z46jesq5PPGTbRqG9Zh/oZG0FpBpRAknvU+4zxSsP0GVQyXMFADuguYGeXMLfrLnCnOwBaBJ93Ft7HyPVkjRU03sghmi5EtFXw/4LWi3neASCdHQYSYeL+Mo0XfLxgTwdnwWQgiwfaLuA0FghIM9rgQ2N28GDML/Wx57Z7wCoDjGSaCA6kGOO89LXGxvG/iaHLA5GfGngAMPl7N95kaeIadsYJOy7fMuW11M+Rg2YPBwMiC8Od39g5ApjVl5x9mLLW/+JMs6oroE5AwwcfTwMNBdQBrhOiVtR1QlLD+rvuwiBKvj/ypiuvzI7x+Hv3Y+MlXTSVdxowGsmTVqNxxibYRh3WSitircuYtAb1HNAFwxceXALUA3Aix+Kee2EPHYMq7LBIc2BCIxUycowATgKGGHgMNeLQDwyZCyvRr2Q1YpQ8LIsSQjgCLb4WjWgwmwPQhQh2JDMRCJPwfjwipSLIcA7Yvecu5FaBTBbK9mTrZq1sF2vUwod3bnvDinnznyQPCnhEYD+29kqL+g2OPLOuABQhhJcq4pi0AjyM7z13Y5UOzS1t876WfYJrraNUTwRkDQLVIEcdUA2CCgGHbwCoO+iaXzMx1Rz8nJ8kMzMz6mu7qisO+onfdS7V5Co47ZD9wiqMP/U0oNmCKgiqD5gCGLMG9VyeIydwQUAO8EKB9l2HsHjHfqR5CbUMPBVgS6AqR4AihwAu5FytmFGO5rQSgKGqRs7hsXVCvVRuQLEMqJTI4cV8baBMou4hSNAg5ewBeH4YrUrLT6BNvFQUD0wwA/AKhw8fx+HZ44DOJBkAhvIKGt6vVYt/+R+me186+bO+v/KggAcAqy796iJqU3+cU+NuBxPmkbjAdEtPfPyGGvAaQ/kf/fPMhQOtd8/kqtu9bv61TxKmphYiualATQVqaqBBoKYCNxXQVEALoCbXC/LPWv6brCxbt27VXzzYeN1hO/3OymVGRdBtXIPxMzcDrRZQKaQ9oNEHxktCvSQJJHLA5wRVKKh2hXz/Eczvvh1mqRNyryF3GjSZ+G7ynKuhOR3l5QRwEqFGcEUtyFYAx1UoBIj0S+WAKnaZ+ZH8ayiF4iGvJ/Yz+nIcijZ56LuFeUFO2hLAEHMrOhChiYfQ71TYu/suQKXw4R4ASLiHyf7xXaeNF+9dqVH7/sqDBh4AtO6+4RZS4/+58o0ukMrWPgCArBWQD0hS0omv/v3ZG/x0vPf886+vTJV9CET72DA4S8B1BQ6mlRvymIJ/h4YBNZRK6rTiKqmThA5PPetXD5ar3p2jWdMWKMggXbcB42ecCW5NwlkDKjxQOTRzRrMATM9B9z24YHABUIdRHV3C3N47gOMnkJYVvJUMA7tA7p5yHvpm3gmQOCb8B1UmVgKQQJ8IUOU6AauVer3oL3r5AiNkFoaR69DkirkcZh1iM/YgqIjYHIlmEd73XgpFnXO487Z7YUvZPRxMGIgJqe911qf9d+5431tO6ZV+IPKQAI+2wU9saXy+0umVnskrr+Vbom0oftehJq6CRn46K37pSISPiY6/x6PxcXYJK+2lpyPT8DUCNQDUATQUfJODr6fJ19zm0Z+xkpz/2zOn7283PtrX9TVkKxScINmwBq0tZ4KaE8IL5kDSBxo5ULOEpMfQOcEVBC7F3PqFJSzuvRP24FFQWaLkCuwrAUcVTGo1GqUGTVYFfy6WOVWiwdhWoBhsuBDFVl5Mql0e9UYtSi5WwjKIg8n10hZKYfu4xBYsVIi00QGAZB/CrlmZBhI0YPAKpdJFfCdrPY7sO4ylY4vwCoB2YVazRspdv8bPfnqTxk9tYqM8JMADALpoh9Vj0+/P0fz7QlrmoXwynPFLJD4CV4bK9uuPfPzXBhUrdOl2N5W038fc/LJnD1ZW9mpkBKppUNOAGhJ8UENBNRVUQ03jz2fuE3jPe837xjoVfbzHraewlQ+9vn4TVm1+GpLGJNgSkhIwfUatD7TKEMH2AeQKKBSox6DFHO2796F9zz7ofj70tcoItmhi5XH054YmN5pTAdqy1wPo4nsD7i9qvwBcruxQ4wVtF03qIBoYkMJRI4aCzqD9pMwpcHjhVg8Bp4fssiAPdOfamD0wC6ek+ghew5CFRg9T1bGbpoj+/EtXX37KEJ4HKg8Z8BD8vbLWurzQ9ZvBirUflBkCIHhS0OSRceepxi5eMnovXbTDWp+9F77WljusLNxTYfBOHaCmDr6fgmroiZNL6gfCTHOL/f941K/7NzkTeatRW70JY0/eDNSmwKUG5YDqemR9j2ahkPYYpgdwTvA5oHqAWSjQv/cAFm+7HabdgaoCJ1d5UMUDH2yguazwd6N+n/hooahzVBNW0XcLGYmBeZX3B5ouPq7sUMv5UAE+csSu/2hGfZhzN/pcAMdwLNrNM6RqWhEcCLZdYPaO/dJTQVrq9cjDkcZ4cfzIBr3wxp3XX7HieocHKg8p8ABgw6u/czf5NW8qfeuQbGccBPEQl8Ij4TKD7b15/lMXLkt9rWmn3wA1r2Jfd4plcR1BOuFZM3wS1tsKmTyGLVMr/v7PfukVz5l39bc7TrT3HunYWjQ3PQ2ot8Al4HMAfUl7ZaVGUhJUn0B9gIvwfteiP3sYJ+64DX5xAaoqhaOL1EnQTBJ1SlAQASSmsxx5fRipxuskog152oHmlGsFsDGyFeDKZKkQtTKPbE0Mx0kgi76dk3U0gT4ZFEwNqorhZYWDLyocuecAuLAAA5qlRIu1gfFlby267/z+te9YcQDPTyMr/uEerEwd/PVvlmbqzT3VmHcwUCyz50JADoJH4rvPyDvty0b9NLp0u9Nm8sOeJ3c4XwPFhXvRlADwYRA4JXrFiOqCl75l1Vy/+V8Lbk1SVSLNJjGx4UyYxhpwZZDmgMkB1WekBSEtSPi5PkA5AX0P1S/hjh/Bwp17UR0/DFXl8K4Eu2FJuvflIBCQowJHzRYpkBg8VBZcynk5PTKMWFFZcFUuM81yr1SxiAkNrYUjM5Ojphs1tTJBdYRKwShdEoKMYHKJAVM6LO47iLLbg4QbDOYCxnskVekm3P5PrCsX/8cDTYv9OHlYgEfbtvnVB2/4fKFWv7XgehtQgynkHhoeBglIpzZ/6/7rLljGx41f9NnjRWle41C7ydOwvJ5YGnYQPjQQLeCu+WXgm5mZUUc6/DsL3PrXVDLYjGN83VmotdYBFUH3NVSXoHuMtOeR5QTdZQFeD+A+QP0Kbm4O83fchuLwvUiLNsiWkmutLFTpoEsJFAaACwDhEED4CMiByYyVx0MimQeaLj4f8e+qCr4s5TmG23miJhtybxwCB0lvxRImHrwvQcXgnujbxSAEANhjcf9BVAttkPeyihUMKA2Q4nXVob/9BT74rh2f3nZqAe2DkIcFeAiR7p4D6V/5ZPxtJepLYCUfIAkAyQM133tysyiu+N7HzktG7914yef3eTRfZnnsVsuppH8B4QepAnONmce/i63blwHvb78x+/Tcjr+NndbkNNJVZ6De2gBVJdB9guoRqGCoPiMrGEmfQX2CLwBXAr7v4ecX0LlnF9qHbgfKrmigqpJ8aVWBbAnYEmRLqABECoFGjHJV5UBlJVqsjNpMtBtXFhzMLofnAxJ5oOlk+KQikr9QGBcnlfyhgnkQwUqFsAtRLYVYw1PUhGHRNcva9tCcBjBDVSXyA/eimu+CvQF5BRUmQSlfYsyd+PaU7v/hzuvfd0oL6IOVhw14CHV3J3pTnyzTsff2yfTAkk6LmkzBKtj2Kzba9BQyeO0LPn+758ZW78d2V8jYkQQnzAnYN05UNvnsycMeraWttqxNU6VhaqsxNvEkENellKlP4JyB3EEXHklB0LmHKgDKASocuLOE3qF9WNp/N1Qumm5ACgd/y4cDVeTchkSvlECFSHTED4y9EpG3k+KBIUkctR1Xkp9lCnOnlQJpBcTZ02FFwUB1RY0XzSli43hYhjIwwQJIH+ZaengkVQV39AR4rgtCAYUKXnkoqqBZYbxa3L/BHP39m6/7k1NmQD8UsnJU+BCL/4eLs+MH5v4wzRf+IkPeclBQjgBvYcFcYPIrRq1+2dRbdpwyR2/2K7+9RdHC6wB7GTGvYzYHwM13Tr9g++doxOd44Qsv23Db4vRNPbV+XWkmMXnas5CtPwfQNXiSPnqC7PlK4VEjNZxUzxZcdZCf2IO5A7vAxXEoLkUz+NA3y6JKhLAdnpcDQUwXQsLex3ETUc34sO5zZNonB1KYRDnJ6ielABW2R4b9HKx0WFqigCSBq2fgRg2c1cC1FL4WzmkGrqfwWQaYFD5N4BMDmBQ2NWCjYDzDH58Hzy0BxNCuAhTBkkLmCtR8Z3at7rxy70ff+E/L/xoPnTwiwAMAnoE6sf45rzR27qrElRPGM6w3YTaFqjrpqj9be/nO952sxSBWgQ5+4VWrTK3aVBtT+yd+5X8unHzdM85/9eUn9OkfAtdIT5yB8c0XQNU2yjYyIhl8wJJqSglIBl31HuS66M7djYVD34HvH4FCKU56TPd5yM2DGjgImBABKD7VaMoKPsSRYa4ds7QzquiHIQAYYRM4ITRHDYdJggiktGg7FXa/agWvNXyawjcyoF4DZxl8LYPPUnCawtcz+DQDkhScJnCJgctSGK2RWI9ibh6+24P2DCdp9FDcQWjx7OEN5uhrd1/9ti89lMHEyfKIAQ+Q8bPHTxx8ua4WPpjZpbXgDHAKmgt0qH6srK9+0cY3fet7J9/3E2VmRp35d4f/96La+CKgjvGNz0Vt+lwQjQlKhnEziIGUVJio4sC+g6K9D3MHfwjbvxeac9nIDQ3PFIKiIaAEeAFoAVhizmK5EoaTmwYEr4AtNunEJcyydSgsZQ6PWYkrorQGKwIpWg48o8NZwMRZCmSZaLwsAdIMbqDxEnCawacGPjFIrIOdWwT6BUCSq1WAdC2BkPqFo5v46KvuWNv9Kh5EHvb+yCMKPATwHTl68JJ6NffBxPe3WCbokLLp0MRXp9dO/Sb93gotiD9G/uCVb137f3b2b/d6YtzV1mNq40VIWltkPC4ziHwoCJdejBpBUnmco8xnsTj7fdil26V4NVIWyoCZZKgOorkUHAuYWFRFAJeY1OUg5GBeI/aZGaCw0ZzisD4lZ4qrr2QdDpQJG5TiImrZhOgSAScbA5touCQBJUkwuQI0V8vAtRScZECaSt9rZVF1OuCqCu2NkrFQVAEMjNvj81PJsdfedc3bv/hwaroojzjwEHTQsSvPf5Z2nWu16z0nARE5hYKNLdH6T2vPOPOjK+08uy/5lfMvffk9S2s/67kJNfkUTKx5HlRtrUwPISvRNCsBHoAEDtoDrjyGhfmb0VvYDe26UtAQQOIhJRnEUlUtYArazAvoRMONvifajSNAB0iVCJVIBcCFoUfRrFLQbCq0d+owDk6HFa1h27VP5D02Gl4b0X5GzjApkCVwmZhcnwnoYDRKa+F6FYirwTIVHeblKsqRVUv71tHCG+687i1fjr/5wy0Pa1R7X0IAr738ezf58Se9pFLjf+88VYCFgTPE5bZ9+/ZdzDMz9+t3m5mZUSeOtp9LlZOSdQukuYXq9UG9HlSvB+r1QL0c1OuDel1Qrw/fOYbOkT3oH98LqtoymLsUesNXFlRK2TmsBUp5jnJIqVAVubsQ7cbHLoyAJZmqRSORKVQ4Gy3gSWQsP5IESBMJBFIDpAacajmyTMxpLQVlciDLgHoGyjKoTM6chZZDHcAdZitX3T58rwfFJTR7aGegnZHmcbI8Vi3s3JycuPjO6978iIEOjxbwoky/7quHkvHW73TTqQ/0qTYHOGTUmaqX7esOjn39gpOvX0l27dpFgJ7kClDWQhU5dL+A6RTQ3R5UpwfdyWG6BXQnh+7kUO02ivm70J3bDS4XgNIClXBzsYqEK8lM+KqUXGvg84SHi6SvNN9Ev02Tggpai+JhDJQ2IJMAiQGPgi3R4ESmpPtEyzk18JmRQCFL4bMkHKm8Vouvp2JasxSoZUCWioZLE/jQQ1EVBZy1YXqAhUMK7QkJKyTeu1XlgX9ajcO/dcs1V9w2LCF9ZORRBR4ATL7+xrn1m87c1m2u/+NCNfYQLJq+tynrnfjQ7Id/bd3J168klJfOlyEZn7eBXhuqn0P3e9D9HKqXg3p50H5tuPYRdOf2wheHQVUXKIWP82XIGFSlZA9iNsKVkO7yMK9YtuYGbRYApg2gDUhLQzoZmRsHnYCTBDBmODnTyHMy4p+pJAGlqTxOU1CaQaXxNXlO4XVKa1BZCpWkUEkGVQtaL03hkwSWCNWAUI6BEcGpOkBAZRQMLxQb7T2f2uwWXnn7x9558JHUdFEedeABAF26vTztjd/4jKtNXdLWq/8hh6k0936p6C1cs/fKi8dPvn5UzjrrLE4TN6u4gvIWtmzDFQtA2QbnOTgvwUUJzvvgsgtfLqDbvhP99kHA9oTs9aGoM/Bq8c9AEKefB46/mErWGqxlfgwF0ykmVPwvGC1AG2g30WpIk6DposYbHpSmAXQRfFGDiSkdmtV08FjVaqAkHaxwqphReg5l7UFiDOMtEvRQ97MLq3DwT59aV2/89ifecb8G7Dwc8qgEFz9OjlxzYSvv5q/Vtv2nibVrSzP+8cWJ5p+c88YdyzY8j8oLz33xv9tzuP53nsaU101M1J+JVnMziBvhf1EiR0aBvDyKpfb3UZVzUGSl8JuEMxt872PEGaNNKZcUEIYzAv8mJO8IJQIJBkBa9l2EIIJ0BLBwdKy0RLdahwxFeBx3vWqZos5GC7US/EJO5D1vDJgUSgIKyEBVF9oTiZR0oCGkLOCRcuFXFYdu3VTvvun02R/csH2FiVmPpDzmgIdAuRzYv++Xav32f/M5zumm4392uqt9hLadOukdAN502cz4/91x282FW/3kiggm3YTx1jORJeuEimADRYD3c1jq3olu5xYA1RBXkEUsHIjU+KkQSfaAEKafBu0n4AMUSYYBEFqElUSvPIhcQwZCDR9DE6CEl2MdVi8pLRGtJlnJFM2yJrDWUGHFOhkD1gmgNCoC+mRRMsOF/b1OeRAnA7wpOGiUIF901tKJz0wn3ffsvOrtp2zRfDTkMQm8KEeuubDFc/3XLzJdXpnkyrOfsuGq+6BZ6JlbXvL+hXLTWysNgjdo1J+K5vjTYbIxAE2QJ1TVPszN3wRXzYY253DzAIBRzYX/krRER45FMmwhca/C/o2gxaJmA5HQhxGUmmStuZbnpBR8zEYEDUdKS0FAMNVsjJhrJcv/SBv4JIFXBpYUCs/IA5XoiOFD7ZjygCIv5LcnGLKYLA/dPkXlu3ymvnjHQ1A5/FDJYxp4EK6W7vzg88/p9ewVvj71w/n2/FUXraD5nn/+S7bsnW/8c07TpyXOg6gO3XgyGpObkaSbAAf0O3vQXvgh4HtiTUM0qgZmcjTLES0uhVSWgI5JgoqoAeMIr4EZVVruC/wcB1MqhwYrEzZYi4YkE3KxhqGUBCesJRJmreCN5GlLpZAzI4eHEx4ayiVgaFjlQKigQycFMyPjYmnMHv3cs7K5//Klq7cdGP2sHgvymAdelFtmzkrzsS3j57XPm6P7SOece86LX7xQbfxUTzUmGAngCao2jVpzIxKTIV+8F7Z/OAy3G71TfDQVrWwAXDxzmBm8XOvJa8sCDyW5VgSTG8EFJVvNicR/G/J6AjxWkgojk8gGRJ2AtYZThAIM67zsmyGCVwTlAeMZpTFgciCuoH0C4gQpt3tj1fwNG9TCn49v6H53x7Ztp3xJHwvyMwO8+yMXXjhjFufvfP1RXvX+nCZahi0sDLzOYLSBCmVJXsm4bGA5yIQmCYOpI3gG1wUAqmh+ZY1qBCEPqkqiuY2+nACQtIEKqS8oCikwoWNiBoK1hiVCQYQSDMcEF809JPgRvUzwygCoAgg9Mu5UGXf2rFXtv5impX/c8dFt9xmMPRbkcQU8ANh61tZ0dx2vWfRrP9A3ky32BiADZoaikGaNZEMwlwhxawSaWN4wBUupAMZgWkNZjESk8WLxxwR04bGmkBITcEHLYzG9If2lZL2VUxpWKrDgiWBBEhELWzig2QbF/iSFnaQraNd3U+XSrdNu/iMTLf+FG65+x7Fw1WNaHnfAAwBmpmf/8mt/8zhaVxW86rSKmgQqJI+KFAQ17ColBxCkyDSUUA0kaDkFQFMoXwo+m1SOYJh/lVJx0W6KA9AEXBxA55WGIwWnSCpMSIFJhQZ4KWOQCXehuCGoOGLxLRlhSw971Fyn37SdXROme/XmZPELX7p62yljdh/L8rgEXhB63sWv3nK003j3vHnSJaWqNRUB8ApOWYClMIqIxcBGyoWEOhFHneC0aCGQ5F9ZhUporUHBNEOJFhNfUMqXWAvQoKXMCYEaYRX8QvkVQ/UnROeG6hUGQUGGdTMUWDsAhMRVrmUXF8d858tTqrg2yTo/+M7PGOCiPJ6BBwC45PdnGvfePff8RWq+Z1GtegYo0eQZllJUSgPKg2ChwVCsIatzh5GuU4AnHTQbAGIxmaFoM2o81qLxSClYreF1ItpKqRAtk+yphR9ygVFIzL9mKd9yZORLwQ6Gc85sWY5Tb3eT8s+1XOfLZ2ysbtm+bVs5+v/5syaPe+BFueQVr1hz59LkZV3a8LsLevxcVnXyrAOzH0qmVIWKxOciMjJHhGRfhorRbOTniOBUqJejSJUInyeaMPh/A8ZQtCbCKH/mQL+EfKoM4RFzbnyOum3nNeS3par4xzV+4ev/arJzwyc/8IEfu5juZ0l+boAXhLZunWnuc71/2/b64jKZePaSyU7rczLldJaCU6lzIzMY/SWL9wheSZpLwBfSXaH1kBE5Pvk4Yw+FPArAIyX9GJDAhcDQXEGxhYZj7ctOE/2jqS+/3/BL39qU9L+54I78YOf119tHI4n/cMvPG/AGsnXrVn10erruFyfHVM2fO1fSBW01cV6BZNqqdIPTtSmLtGa1NiAiTwpOGThoye2KMQwAk8wBhw90+L6H8jIVVbGHJu/gXJWy7ddRHk1d70Si+ntbyn+3nvhvkuvd23end3Ze/4bHJdhG5ecWeCfLzMyM+vbcXNJ3qxK4fE3XN6aB9DSr6KldX9tUwDScxzQpvdoBLSa0LEydSRGBFIcZYQS2BF8q+I6Cm1dczhvyiynx/Jgq79FVvkdnyaFV7I5VS532885oFdseoyTvwylPAO8ByMzMjLn11qWkHDdm0ZW6MEpRokzaJ6VNwj2klUkL1r0+r21Wdr3W1ezsrN2+fXtoz39CnpAn5Al5Qp6QJ+QJeUTk/wMzjJaXmA7rzgAAAABJRU5ErkJggg==">
<div>
<h1 style="color:#e56420; margin-top: 3px;">SUDU</h1>
<h2 style="color:#16a3e0; margin-bottom: 3px;">SPECIALIZED INDUSTRIAL MACHINERY</h2>
 </div>
</div>
   <div class="card">
    
      <h2>Control</h2>
      <p class="state">STATE: <span id="state">%STATE%</span></p>
    <div class="button-container">
    <button id="on_button" class="pushable"> <span class="shadow"></span> <span class="edge"></span> <span class="front" style="background: rgb(0, 197, 0)"> ON </span> </button>
    <button id="off_button" class="pushable"> <span class="shadow"></span> <span class="edge"></span> <span class="front" style="background: rgb(197, 0, 0)"> OFF</span> </button>
  </div>
    </div>
    <div><p></p></div>
    <div class="card">
    <h2>Session Time</h2>
    <p>Remaing TIME :<span id="timer">%timer%</span><sup class="units">min</sup></p>
    <p><button id="t30button" class="time-button">30 Min</button></p>
    <p><button id="t45button" class="time-button">45 Min</button></p>
    <p><button id="t60button" class="time-button">60 Min</button></p>
  </div> 
  
  <div><p></p></div> 
  
  <div class="card">
    <h2>Engine Size</h2>
    <p><button id="1000button" class="engine-button">0-1 Liter</button></p>
    <p><button id="2000button" class="engine-button">1-2 Liter</button></p>
    <p><button id="3000button" class="engine-button">2-3 Liter</button></p>
    <p><button id="4000button" class="engine-button">3-4 Liter</button></p>
  </div> 
  <div><p></p></div> 
    <div class="card">
    <h2>Sensors</h2>
       <p>TEMPERATURE 1: <span id="temperaturec">%TEMPERATUREC%</span><sup class="units">&deg;C</sup></p>
       <p>TEMPERATURE 2: <span id="temperature2">%TEMPERATURE2%</span><sup class="units">&deg;C</sup></p>
       <p>TEMPERATURE 3: <span id="temperature3">%TEMPERATURE3%</span><sup class="units">&deg;C</sup></p>
       <p>PRESSURE : <span id="pressure">%pressure%</span><sup class="units"> PSI</sup></p>
       <p>WATER LEVEL : <span id="level1">%level1%</span><sup class="units">&percnt;</sup></p>
       <p>HC LEVEL : <span id="level2">%level2%</span><sup class="units">&percnt;</sup></p>
       <p>OPERATING TIME : <span id="timerh">%timerh%</span><sup class="units">hrs</sup> : <span id="timerm">%timerm%</span><sup class="units">min</sup></p>
       <p>ERROR CODE : <span id="error_code">%error_code%</span></p>
       <p>Next Service In: <span id="ser_t">%error_code%</span></p>     
    </div>

    <div><p></p></div>
    <div class="card">
    <h2>Operation Log Table</h2>
    <table style="width:90% ;">
    <thead>
        <tr>
            <th >Num</th>
            <th >Time</th>
            <th >Size</th>
        </tr>
    </thead>
    <tbody id="tableBody">
        <!-- Data will be inserted here -->
    </tbody>
</table>
    </div>
    <div><p></p></div>
    <div class="card">
    <h2>Service</h2>
  <form action="/passcode" target="hidden-form">
  <input placeholder="Service Access code" class="input" name="passcode" type="text">
  <input type="submit" class = "input" value="Access" style ="background-color: #1F618D ;}">
    </form>
  <div id="service">
       <p>IP : <span id="IP">%IP%</span></p>
       <p>Device ID: <span id="ID">%ID%</span></p>
       <p>Heap Memory: <span id="max_heap">%max_heap%</span><sup class="units">max</sup> : <span id="free_heap">%free_heap%</span><sup class="units">free</sup>: <span id="frag_heap">%frag_heap%</span><sup class="units">frag</sup></p>
       <p>On Time : <span id="On_time_hrs">%timerh%</span><sup class="units">hrs</sup> : <span id="On_time_min">%timerm%</span><sup class="units">min</sup></p>
       <p>Last Calibration : <span id="last_cal_hrs">%timerh%</span><sup class="units">hrs</sup> : <span id="last_cal_min">%timerm%</span><sup class="units">min</sup></p>
       <div class="button-container">
       <button href="/ota" target="_blank" id="OTA_button" class="pushable"> <span class="shadow"></span> <span class="edge"></span> <span class="front" style="background: #1F618D"> OTA </span> </button>
       <button id="calibrate_button" class="pushable"> <span class="shadow"></span> <span class="edge"></span> <span class="front" style="background: #1F618D"> calibrate</span> </button>
       </div>
    </div>  
    <p> Limited Access : Service team only </p>
    </div>
  </div>
<script>
blur();
function fetchData(endpoint, interval) {
  setInterval(function () {
    var xhttp = new XMLHttpRequest();
    xhttp.onreadystatechange = function() {
      if (this.readyState == 4 && this.status == 200) {
        var data = JSON.parse(this.responseText); // Parse the JSON response

        // Update the HTML elements with the corresponding data
        updateElement("temperaturec", Math.round(data.temperature1* 100) / 100, setColorBasedOnTemperature);
        updateElement("temperature2", Math.round(data.temperature2* 100) / 100, setColorBasedOnTemperature);
        updateElement("temperature3", Math.round(data.temperature3* 100) / 100, setColorBasedOnTemperature);
        updateElement("pressure", data.pressure, setColorBasedOnPressure);
        updateElement("level1", data.level1, setColorBasedOnLevel);
        updateElement("level2", data.level2, setColorBasedOnLevel);
        updateElement("timerh", data.time_hours);
        updateElement("timerm", data.time_minutes);
        updateElement("error_code", data.error_code);
        updateElement("IP", data.IP);
        updateElement("ID", data.ID);
        updateElement("max_heap", data.max);
        updateElement("free_heap", data.free);
        updateElement("frag_heap", data.frag);
        updateElement("On_time_hrs", data.on_hrs);
        updateElement("On_time_min", data.on_min);
        updateElement("last_cal_hrs", data.cal_hrs);
        updateElement("last_cal_min", data.cal_min);
        updateElement("ser_t", data.ser_t);
        updateElement("timer", data.timer);
      }
    };
    xhttp.open("GET", endpoint, true);
    xhttp.send();
  }, interval);
}

function updateElement(elementId, value, colorCallback) {
  var element = document.getElementById(elementId);
  element.innerHTML = value;
  if (colorCallback) {
    colorCallback(element, parseFloat(value));
  }
}
function setColorBasedOnPressure(element, pressure) {
  if (pressure > 9) {
    element.style.color = 'red';
  } else if (pressure > 5) {
    element.style.color = 'yellow';
  } else if (pressure > -2){
    element.style.color = 'green';
  }else {
    element.style.color = 'red';
  }
}
function setColorBasedOnTemperature(element, temperature) {
  if (temperature > 60) {
    element.style.color = 'red';
  } else if (temperature > 50) {
    element.style.color = 'yellow';
  } else if (temperature > -20) {
    element.style.color = 'green';
  } else {
    element.style.color = 'red';
  }
}

function setColorBasedOnLevel(element, level) {
  if (level > 89) {
    element.style.color = 'red';
  } else if (level > 80) {
    element.style.color = 'yellow';
  } else if (level > 15) {
    element.style.color = 'green';
  } else if (level > 5) {
    element.style.color = 'yellow';
  } else {
    element.style.color = 'red';
  }
}

// Fetch data from the /data route every 2 seconds
fetchData("/data", 2000);

var gateway = `ws://${window.location.hostname}/ws`;
var websocket;
window.addEventListener('load', onLoad);

function initWebSocket() {
  console.log('Trying to open a WebSocket connection...');
  websocket = new WebSocket(gateway);
  websocket.onopen = onOpen;
  websocket.onclose = onClose;
  websocket.onmessage = onMessage;
}

function onOpen(event) {
  console.log('Connection opened');
}

function onClose(event) {
  console.log('Connection closed');
  setTimeout(initWebSocket, 2000);
}

function onMessage(event) {
  const stateElement = document.getElementById('state');

  switch (event.data) {
    case "-10":
      updateState(stateElement, "LOCKOUT", "red");
      break;
    case "1":
      updateState(stateElement, "ON", "green");
      break;
    case "0":
      updateState(stateElement, "OFF", "red");
      break;
    case "-1":
      blur();
      break;
  }
}

function updateState(element, state, color) {
  element.style.color = color;
  element.innerHTML = state;
}

function onLoad(event) {
  initWebSocket();
  initButton();
}

function initButton() {
  document.getElementById('on_button').addEventListener('click', start);
  document.getElementById('off_button').addEventListener('click', stop);
  document.getElementById('calibrate_button').addEventListener('click', calibrate);
  const engineButtons = document.querySelectorAll('.engine-button');
  engineButtons.forEach(button => {
    button.addEventListener('click', function() {
      websocket.send(this.id.replace('button', '')); // Send the engine size command
      engineButtons.forEach(btn => btn.style.backgroundColor = '#3498DB'); // Reset other buttons' color
      this.style.backgroundColor = 'green'; // Highlight the clicked button
    });
  });

    const timebutton = document.querySelectorAll('.time-button');
  timebutton.forEach(button => {
    button.addEventListener('click', function() {
      websocket.send(this.id.replace('button', '')); // Send the engine size command
      timebutton.forEach(btn => btn.style.backgroundColor = '#3498DB'); // Reset other buttons' color
      this.style.backgroundColor = 'green'; // Highlight the clicked button
    });
  });
}

function toggle() {
  websocket.send('toggle');
}
function stop() {
  websocket.send('stop');
}
function start() {
  websocket.send('start');
}
function calibrate() {
  websocket.send('calibrate');
}

function blur(){
  const card = document.getElementById('service');
  card.classList.toggle('blurred');
  }
    async function TableData() {
        try {
            const response = await fetch("/olog"); // Replace with your API URL
            const data = await response.json();
            
            const tableBody = document.getElementById('tableBody');
            tableBody.innerHTML = ''; // Clear existing table data
            
            data.forEach(item => {
                const row = document.createElement('tr');
                row.innerHTML = `
                    <td>${item[0]}</td>
                    <td>${item[1]}</td>
                    <td>${item[2]}</td>
                `;
                tableBody.appendChild(row);
            });
        } catch (error) {
            console.error('Error fetching data:', error);
        }
    }

    // Fetch data when the page loads
    window.onload = TableData;  
</script>
</body>
</html>
)rawliteral";

//=============================================================================

void readFile(const char *path) {
  Serial.printf("R FS: %s\n", path);

  File file = LittleFS.open(path, "r");
  if (!file) {
    Serial.println("Failed");
    return;
  }
  outdata="";
  while (file.available()) { outdata = file.readString(); }
  file.close();
}

void writeFile(const char *path, const char *message) {

  File file = LittleFS.open(path, "w");
  if (!file) {
    return;
  }
  if (file.print(message)) {
  } else {
  }
  delay(5);  // Make sure the CREATE and LASTWRITE times are different
  file.close();
}

//=============================================================================

void notifyClients() {
  ws.textAll(String(ledState));
}

void handleWebSocketMessage(void *arg, uint8_t *data, size_t len) {
  AwsFrameInfo *info = (AwsFrameInfo*)arg;
  if (info->final && info->index == 0 && info->len == len && info->opcode == WS_TEXT) {
    data[len] = 0;
    if (strcmp((char*)data, "toggle") == 0) {
      ledState = !ledState;
      notifyClients();
    }
    if (strcmp((char*)data, "stop") == 0) {
      ledState = 0;
      
      notifyClients();
            Serial.println(" stop");

    }
    if (strcmp((char*)data, "start") == 0) {
      ledState = 1;
       
      notifyClients();
                  Serial.println(" start");

    }
    if (strcmp((char*)data, "ota") == 0) {
      ledState = 0;
      notifyClients();
      ota = service_mode ; 
    }
    if (strcmp((char*)data, "calibrate") == 0) {
      if(service_mode){
      Last_calibration_min = powered_min_counter ;
      Last_calibration_hrs = powered_hrs_counter ;
      Last_calibration_min_s = String(Last_calibration_min);
      Last_calibration_hrs_s = String(Last_calibration_hrs);
      writeFile("/cal_hrs.txt", (String(Last_calibration_hrs_s)).c_str());
      writeFile("/cal_min.txt", (String(Last_calibration_min_s)).c_str());
      writeFile(LOG_FILE_PATH,"[");  
    }}
    if (strcmp((char*)data, "1000") == 0) {
      engine_size = 1000;
      Serial.println("engine_size 1000");
    }else if (strcmp((char*)data, "2000") == 0) {
      engine_size = 2000;
      Serial.println("engine_size 2000");
    }else if (strcmp((char*)data, "3000") == 0) {
      engine_size = 3000;
      Serial.println("engine_size 3000");
    }else if (strcmp((char*)data, "4000") == 0) {
      engine_size = 4000;
      Serial.println("engine_size 4000");
    }else if (strcmp((char*)data, "t30") == 0) {
      clean_time = 30;
      timer =30;
      Serial.println("timer t30");
    }else if (strcmp((char*)data, "t45") == 0) {
      clean_time = 45;
      timer =45;
      Serial.println("timer t45");
    }else if (strcmp((char*)data, "t60") == 0) {
      clean_time = 60;
      timer =60;
      Serial.println("timer t60");
    }
  }
}

void onEvent(AsyncWebSocket *server, AsyncWebSocketClient *client, AwsEventType type,
             void *arg, uint8_t *data, size_t len) {
    switch (type) {
      case WS_EVT_CONNECT:
        Serial.printf("WebSocket client #%u connected from %s\n", client->id(), client->remoteIP().toString().c_str());
        notifyClients();
        break;
      case WS_EVT_DISCONNECT:
        Serial.printf("WebSocket client #%u disconnected\n", client->id());
        service_mode = 0;
        break;
      case WS_EVT_DATA:
        handleWebSocketMessage(arg, data, len);
        break;
      case WS_EVT_PONG:
      case WS_EVT_ERROR:
        break;
        
  }
}

void initWebSocket() {
  ws.onEvent(onEvent);
  server.addHandler(&ws);
}

String processor(const String& var){
  Serial.println(var);
  if(var == "STATE"){
    if (ledState){
      return "ON";
    }
    else{
      return "OFF";
    }
  }return "";}

void notFound(AsyncWebServerRequest *request)
{
  request->send(404, "text/plain", "404");
}

ICACHE_RAM_ATTR void ONPUSH() {
  ledState = 1 ;
  notifyClients();
}
ICACHE_RAM_ATTR void OFFPUSH() {
  ledState = 0 ;
  esp_leak = 130 ;
  notifyClients();
}

//==============================================================================================
void appendToJsonFile(int id, int time, int size) {
    String jsonSendContent ;
    // Append new data
    jsonSendContent += "[";
    jsonSendContent += id;
    jsonSendContent += ",";
    jsonSendContent += time;
    jsonSendContent += ",";
    jsonSendContent += size;
    jsonSendContent += "]";
    jsonSendContent += ",";
    if (!LittleFS.begin()) { 
        Serial.println("Failed to mount file system");
        return;
    }

    // Check if file exists
    bool fileExists = LittleFS.exists(LOG_FILE_PATH);

    File file;
    if (fileExists) {
        file = LittleFS.open(LOG_FILE_PATH, "a"); // Open file for reading & writing
    } else {
        file = LittleFS.open(LOG_FILE_PATH, "w");  // Create new file
        file.print("[");
    }

    if (!file) {
        Serial.println("Failed to open file");
        return;
    }
    file.print(jsonSendContent);
    delay(5);
    
    file.close();
     

    Serial.println("Data appended successfully!");
}
//==============================================================================================

void setup(){
  // Serial port for debugging purposes
  Serial.begin(9600);
  WiFi.mode(WIFI_STA);

  
  pinMode(ONPIN, INPUT_PULLUP);
  pinMode(OFFPIN, INPUT_PULLUP);
  attachInterrupt(digitalPinToInterrupt(ONPIN), ONPUSH, FALLING);
  attachInterrupt(digitalPinToInterrupt(OFFPIN), OFFPUSH, FALLING);
  if (!LittleFS.begin()) {
    Serial.println("FS failed");
  }
  ESPhttpUpdate.setClientTimeout(60000);
  readFile("/t_hrs.txt");
  t_hrs_s = outdata ;
  readFile("/t_min.txt");
  t_min_s = outdata ;
  readFile("/t_sec.txt");
  t_sec_s = outdata ;
  readFile("/on_min.txt");
  powered_min_counter_s = outdata ;
  readFile("/on_hrs.txt");
  powered_hrs_counter_s = outdata ;
  readFile("/cal_min.txt");
  Last_calibration_min_s = outdata ;
  readFile("/cal_hrs.txt");
  Last_calibration_hrs_s = outdata ;

  t_hrs = t_hrs_s.toInt();
  t_min = t_min_s.toInt();
  t_sec = t_sec_s.toInt();

  powered_min_counter = powered_min_counter_s.toInt();
  powered_hrs_counter = powered_hrs_counter_s.toInt();
  Last_calibration_min = Last_calibration_min_s.toInt();
  Last_calibration_hrs = Last_calibration_hrs_s.toInt();
  // Connect to Wi-Fi
  WiFi.begin(ssid, password);



  count = 0 ;
  while (WiFi.status() != WL_CONNECTED) {
    delay(1000);
   // Serial.println("Connecting to WiFi..");
    count++ ;
    if(count > 5){
      WiFi.mode(WIFI_AP);
      delay(2000);
      break ;
      }
  }

  if(count > 5){
    hostSID = String(ESP.getChipId());
    hostSID.toUpperCase();
    WiFi.mode(WIFI_STA);
    WiFi.softAP("QS10P"+hostSID, "SUDU QS10 PLUS");
      Serial.println(WiFi.softAPIP());
      ipa = WiFi.softAPIP();
   //  Serial.println(WiFi.softAPIP());
    }
  else{
  ipa = WiFi.localIP();
  Serial.println(WiFi.localIP());
  WiFi.hostname(newHostname.c_str());}
    if (MDNS.begin("QS10plus")) { //http://Qs40.local/
   // Serial.println("MDNS responder started");
  }
  initWebSocket();

  // Route for root / web page
  server.on("/", HTTP_GET, [](AsyncWebServerRequest *request){
    request->send_P(200, "text/html", index_html, processor);
  });
  
server.on("/data", HTTP_GET, [](AsyncWebServerRequest *request){

  jsonDoc.clear();  // Clear any previous content in the document
  // Add sensor data to the JSON object
  jsonDoc["mchtype"] = mchtype;
  jsonDoc["temperature1"] = temperature1;
  jsonDoc["temperature2"] = temperature2;
  jsonDoc["temperature3"] = temperature3;
  jsonDoc["pressure"] =(int)pressure;
  jsonDoc["level1"] = (int)level_1;
  jsonDoc["level2"] = (int)level_2;
  // Add time data to the JSON object
  jsonDoc["time_hours"] = t_hrs_s;
  jsonDoc["time_minutes"] = t_min_s;
  jsonDoc["time_seconds"] = t_sec_s;
  jsonDoc["ser_t"] = service_remaining_time ;
  jsonDoc["timer"] = timer ;
  if(service_mode)
  {jsonDoc["free"] = heapfree;
  jsonDoc["max"] = heapmax;
  jsonDoc["frag"] = heapfrag;
  jsonDoc["on_hrs"] = powered_hrs_counter_s;
  jsonDoc["on_min"] = powered_min_counter_s;
  jsonDoc["cal_hrs"] = Last_calibration_hrs_s;
  jsonDoc["cal_min"] = Last_calibration_min_s;
  //uint8_t IP_array[4]= {ipa[0],ipa[1],ipa[2],ipa[3]};
  jsonDoc["IP"] = ipa;
  jsonDoc["ID"] = hostSID.toInt();}
  else{
  jsonDoc["free"] = locked;
  jsonDoc["max"] = locked;
  jsonDoc["frag"] = locked;
  jsonDoc["IP"] = locked;
  jsonDoc["ID"] = locked;}

  // Add error code to the JSON object
  jsonDoc["error_code"] = error_code;

  // Serialize the JSON object to a string
  String jsonResponse;
  serializeJson(jsonDoc, jsonResponse);

  // Send the JSON response
  request->send(200, "application/json", jsonResponse);
});

server.on("/olog", HTTP_GET, [](AsyncWebServerRequest *request) {
      if (!LittleFS.begin()) {
        Serial.println("Failed to mount file system");
        return;
    }
    File file = LittleFS.open(LOG_FILE_PATH, "r");
    if (!file) {
        Serial.println("Failed to open file for reading");
        return;
    }
    // Read file content
    String jsonContent;
    while (file.available()) {
        jsonContent += (char)file.read();
    }
    file.close();
    jsonContent += "]";
    jsonContent.replace(",]", "]");  
    Serial.println("Stored JSON Data:");
    Serial.println(jsonContent);
    request->send(200, "application/json", jsonContent);
});

  server.on("/passcode", HTTP_GET, [] (AsyncWebServerRequest *request) {
    if (request->hasParam(PARAM_STRING)) {
      inputcode = request->getParam(PARAM_STRING)->value();
      if(String(inputcode)==String(hostSID)){
      service_mode = 1 ;
      ws.textAll("-1");
      request->send(200, "text/text","service mode active");}
      else{
      request->send(200, "text/text","wrong passcode");}
    }
    Serial.println(inputcode);
    
  });
      server.on("/ota", HTTP_GET, [](AsyncWebServerRequest *request){ ota = service_mode ;});
  server.onNotFound(notFound);
  // Start server
  server.begin();
  delay(5000);
}

void loop() {
  
  MDNS.update();
  ws.cleanupClients();
   // Serial.listen();

  while (Serial.available()) {
    start = Serial.find('*');
    if (start) {

      temp1_buf  = Serial.parseFloat();
      temp2_buf  = Serial.parseFloat();
      p1_buf     = Serial.parseInt();
      level_buf = Serial.parseInt();
      level_2_buf = Serial.parseInt();
      p2_buf     = Serial.parseInt();
      current_buf = Serial.parseInt();
      leak_buf   = Serial.parseInt();
      start_led_buf   = Serial.parseInt(); 
      temp3_buf  = Serial.parseFloat();
      CRC        = Serial.parseInt();
      CRC_buf    = (1 * (int)temp1_buf) +(2 * (int)temp2_buf) + (3 * p1_buf) + (4 * level_buf)+ (5 * level_2_buf)+ (6 * p2_buf) + (7 * current_buf) +(8 * leak_buf)+(9*start_led_buf)+(10*(int)temp3_buf);
      Serial.flush();
      
      break ;
    }
    Serial.flush();
  }

  if (CRC == CRC_buf) {
    temperature1 = round(temp1_buf * 100) / 100.0;
    temperature2 = round(temp2_buf * 100) / 100.0;
    temperature3 = round(temp3_buf * 100) / 100.0;
    pressure     = p1_buf;
    current = current_buf ;
     level_1 = level_buf;
    flash = flash_buf;
    leak  = leak_buf;
    level_2 =level_2_buf;
    start_led = start_led_buf ;
    CRC     = 0 ;
    CRC_buf = 1 ;
    serial_con_status = 0 ;
  }

   if(timer<1){
  ledState=0;
  notifyClients();
  }
   if ((millis() - lastTime_control) > timerDelay_control) {
    Serial.println("*"+String(ledState&&!service_lockout));
    Serial.print(",");
    Serial.print(engine_size);
    Serial.println();
    lastTime_control = millis();
    serial_con_status = serial_con_status+1;
    if(ledState&&!service_lockout&&!old_state){
       num = num+1 ;
       appendToJsonFile(num,timer,engine_size) ;
      }
      old_state = ledState&&!service_lockout ;
  jsonDoc["mchtype"] = mchtype;
  jsonDoc["temperature1"] = temperature1;
  jsonDoc["temperature2"] = temperature2;
  jsonDoc["temperature3"] = temperature3;
  jsonDoc["pressure"]     = pressure;
  jsonDoc["level1"]       = level_1;
  jsonDoc["level2"]       = level_2;

  jsonDoc["time_hours"]   = t_hrs_s;
  jsonDoc["time_minutes"] = t_min_s;
  jsonDoc["time_seconds"] = t_sec_s;

  jsonDoc["ser_t"]        = service_remaining_time;
  jsonDoc["timer"]        = timer;

  if (service_mode) {
    jsonDoc["free"] = heapfree;
    jsonDoc["max"]  = heapmax;
    jsonDoc["frag"] = heapfrag;
    jsonDoc["on_hrs"] = powered_hrs_counter_s;
    jsonDoc["on_min"] = powered_min_counter_s;
    jsonDoc["cal_hrs"] = Last_calibration_hrs_s;
    jsonDoc["cal_min"] = Last_calibration_min_s;
    jsonDoc["IP"] = ipa.toString();
    jsonDoc["ID"] = hostSID;  // keep as string
  } else {
    const char* locked = "locked";
    jsonDoc["free"] = locked;
    jsonDoc["max"]  = locked;
    jsonDoc["frag"] = locked;
    jsonDoc["IP"]   = locked;
    jsonDoc["ID"]   = locked;
  }

  // Add error code to the JSON object
  jsonDoc["error_code"] = error_code;

  // Serialize the JSON object to a string
  String WSResponse;
  serializeJson(jsonDoc, WSResponse);
      ws.textAll(WSResponse);
    }
   
    if (serial_con_status>30) {
    temperature1  = -99 ;
    temperature2  = -99 ;
    temperature3  = -99 ;
    pressure     = -99;
    current = -99 ;
    level_1 = -99;
    flash = -99;
    leak  = -99;
    level_2 =-99;
  }
   error_code = esp_leak;

  if((millis() - lastTime_counter) > timerDelay_counter){
      powered_sec_dif = (millis() - lastTime_counter)/1000.0 ;
      powered_sec_counter = powered_sec_counter + (powered_sec_dif) ;
      if (powered_sec_counter >= 60) {
        powered_sec_counter = powered_sec_counter - 60;
        powered_min_counter = powered_min_counter + 1;
      }
      if (powered_min_counter >= 60) {
        powered_min_counter = powered_min_counter - 60;
        powered_hrs_counter = powered_hrs_counter + 1;
      }
      
      powered_hrs_counter_s = String(powered_hrs_counter);
      powered_min_counter_s = String(powered_min_counter);
      writeFile("/on_hrs.txt", (String(powered_hrs_counter_s)).c_str());
      writeFile("/on_min.txt", (String(powered_min_counter_s)).c_str());

     service_remaining_time =(powered_hrs_counter-Last_calibration_hrs)+((powered_min_counter-Last_calibration_min)/60.0) ;
     if(service_remaining_time>=service_lock_timeout){
       service_lockout = 1;
       ledState = 0;
       ws.textAll("-10");
     }else service_lockout = 0;
     service_remaining_time = service_lock_timeout -service_remaining_time;
      if (current == 1 ) {
      t_diffrance = (millis() - lastTime_counter)/1000.0 ;
      t_sec = t_sec + (t_diffrance) ;
      if (t_sec >= 60) {
        if((timer>0)){
        timer = timer - 1;}
        t_sec = t_sec - 59.26;
        t_min = t_min + 1;
      }
      if (t_min >= 60) {
        t_min = t_min - 60;
        t_hrs = t_hrs + 1;
      }
      t_sec_s = String(t_sec);
      t_min_s = String(t_min);
      t_hrs_s = String(t_hrs);
  writeFile("/t_sec.txt", (String(t_sec_s)).c_str());
  writeFile("/t_min.txt", (String(t_min_s)).c_str());
  writeFile("/t_hrs.txt", (String(t_hrs_s)).c_str());
    }
    lastTime_counter = millis();  
  }
  if(ota){
    WiFi.mode(WIFI_AP);
    int ota_fail = 0;
    WiFi.begin(ssid, password);
    while (WiFi.status() != WL_CONNECTED) {
      delay(1000);
      Serial.println(".");
      ota_fail++;
      if(ota_fail>120)
      break;
    }
    WiFiClient client;
    ESPhttpUpdate.setLedPin(LED_BUILTIN, LOW);

    t_httpUpdate_return ret = ESPhttpUpdate.update(client, "http://scada.pythonanywhere.com/ota.bin");
    switch (ret) {
      case HTTP_UPDATE_FAILED: Serial.printf("HTTP_UPDATE_FAILD Error (%d): %s\n", ESPhttpUpdate.getLastError(), ESPhttpUpdate.getLastErrorString().c_str()); break;

      case HTTP_UPDATE_NO_UPDATES: Serial.println("HTTP_UPDATE_NO_UPDATES"); break;

      case HTTP_UPDATE_OK: Serial.println("HTTP_UPDATE_OK"); break;
    }
    } 
    ESP.getHeapStats(&heapfree, &heapmax, &heapfrag);
  
}
